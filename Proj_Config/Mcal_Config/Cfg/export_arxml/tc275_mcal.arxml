[part 1 of 2: packages /Resource to /Mcu]
AUTOSAR XML (schema 4-0-3)
package /Resource
  module config Resource: implementation-config-variant=VARIANT-PRE-COMPILE
    ResourceGeneral: ResourceSubDerivative=TC275TP_64F200W
package /Dio
  module config Dio: implementation-config-variant=VARIANT-POST-BUILD-LOADABLE
    DioConfig_0 (DioConfig)
      5 x DioPort:
        DioPort_0: DioPortId=0
        DioPort_14: DioPortId=14
          3 x DioChannel:
            Button3: DioChannelId=7
            Button4: DioChannelId=8
            TJA1043_RXD: DioChannelId=1
        DioPort_15: DioPortId=15
          9 x DioChannel:
            Button1: DioChannelId=4
            Button2: DioChannelId=5
            LED1: DioChannelId=0
            LED2: DioChannelId=1
            LED3: DioChannelId=2
            LED4: DioChannelId=3
            TJA1043_EN: DioChannelId=7
            TJA1043_ERR: DioChannelId=6
            TJA1043_STB: DioChannelId=8
        DioPort_20: DioPortId=20
          DioChannel_CAN0_NEN (DioChannel): DioChannelId=6
          DioChannel_CAN0_RXD (DioChannel): DioChannelId=7
        DioPort_33: DioPortId=33
          KL15 (DioChannel): DioChannelId=0
    DioGeneral:
      DioDevErrorDetect = 0
      DioFlipChannelApi = 1
      DioPBFixedAddress = 0
      DioRunningInUser0Mode = 0
      DioUserModeInitApiEnable = 0
      DioUserModeRuntimeApiEnable = 0
      DioVersionInfoApi = 0
    DioSafety: DioInitCheckApi=0, DioSafetyEnable=0
    CommonPublishedInformation:
      ArMajorVersion = 2
      ArMinorVersion = 5
      ArPatchVersion = 0
      ModuleId = 120
      Release = _TRICORE_TC275
      SwMajorVersion = 3
      SwMinorVersion = 3
      SwPatchVersion = 0
      VendorId = 17
package /Icu
  module config Icu: implementation-config-variant=VARIANT-POST-BUILD-LOADABLE
    IcuConfigSet_0 (IcuConfigSet): IcuMaxChannel=0
      IcuChannel_0 (IcuChannel):
        IcuChannelId = 0
        IcuDefaultStartEdge = ICU_FALLING_EDGE
        IcuMeasurementMode = ICU_MODE_SIGNAL_EDGE_DETECT
        IcuSignalType = ICU_QM_SIGNAL
        IcuWakeupCapability = 0
        IcuAssignedHwUnit = Tim_2/TimChannel_7
        IcuSignalEdgeDetection_0 (IcuSignalEdgeDetection): IcuSignalNotification=CANRX_15_4_ICU_Notification
    IcuGeneral:
      IcuDebugSupport = 0
      IcuDevErrorDetect = 0
      IcuIndex = 0
      IcuPBFixedAddress = 0
      IcuReportWakeupSource = 0
      IcuResetSfrAtInit = 0
      IcuRunningInUser0Mode = 0
      IcuUserModeDeInitApiEnable = 0
      IcuUserModeInitApiEnable = 0
      IcuUserModeRuntimeApiEnable = 0
    IcuOptionalApis:
      IcuDeInitApi = 0
      IcuDisableWakeupApi = 0
      IcuEdgeCountApi = 0
      IcuEdgeDetectApi = 1
      IcuEnableWakeupApi = 0
      IcuGetDutyCycleValuesApi = 0
      IcuGetInputStateApi = 0
      IcuGetTimeElapsedApi = 0
      IcuGetVersionInfoApi = 0
      IcuSetModeApi = 0
      IcuSignalMeasurementApi = 0
      IcuTimestampApi = 0
      IcuWakeupFunctionalityApi = 0
    IcuSafety: IcuGetModeApi=1, IcuInitCheckApi=1, IcuSafetyEnable=0
    CommonPublishedInformation:
      ArMajorVersion = 4
      ArMinorVersion = 2
      ArPatchVersion = 0
      ModuleId = 122
      Release = _TRICORE_TC275
      SwMajorVersion = 4
      SwMinorVersion = 0
      SwPatchVersion = 1
      VendorApiInfix = GtmCcu6
      VendorId = 17
package /Port
  module config Port: implementation-config-variant=VARIANT-POST-BUILD-LOADABLE
    PortConfigSet_0 (PortConfigSet)
      14 x PortContainer:
        PortContainer_0: PortNumber=0, PortNumberOfPortPins=13
          13 x PortPin, all with PortPinAnalogInput=DISABLE, PortPinControllerSelect=DISABLE, PortPinDirectionChangeable=0, PortPinDriverStrength=PORT_CMOS_SPEED_GRADE1, PortPinInitialMode=PORT_PIN_MODE_GPIO, PortPinInputHysteresis=0, PortPinLevelValue=PORT_PIN_LEVEL_LOW, PortPinMode=PORT_PIN_MODE_ALL, PortPinModeChangeable=0, PortPinPadLevel=PORT_PDR_CMOS_AUTOMOTIVE_LEVEL:
            PortPin_0: PortPinDirection=PORT_PIN_IN, PortPinId=0, PortPinInputCharacteristic=PORT_PIN_IN_PULL_UP, PortPinSymbolicName=PORT_0_PIN_0
            PortPin_1: PortPinDirection=PORT_PIN_IN, PortPinId=1, PortPinInputCharacteristic=PORT_PIN_IN_PULL_UP, PortPinSymbolicName=PORT_0_PIN_1
            PortPin_{10..12}: PortPinDirection=PORT_PIN_IN, PortPinId={10..12}, PortPinInputCharacteristic=PORT_PIN_IN_PULL_UP, PortPinSymbolicName=PORT_0_PIN_{10..12}
            PortPin_{2..4}: PortPinDirection=PORT_PIN_IN, PortPinId={2..4}, PortPinInputCharacteristic=PORT_PIN_IN_PULL_UP, PortPinSymbolicName=PORT_0_PIN_{2..4}
            PortPin_5: PortPinDirection=PORT_PIN_OUT, PortPinId=5, PortPinOutputCharacteristic=PORT_PIN_OUT_PUSHPULL, PortPinSymbolicName=PORT_0_PIN_5
            PortPin_6: PortPinDirection=PORT_PIN_OUT, PortPinId=6, PortPinOutputCharacteristic=PORT_PIN_OUT_PUSHPULL, PortPinSymbolicName=PORT_0_PIN_6
            PortPin_{7..9}: PortPinDirection=PORT_PIN_IN, PortPinId={7..9}, PortPinInputCharacteristic=PORT_PIN_IN_PULL_UP, PortPinSymbolicName=PORT_0_PIN_{7..9}
        PortContainer_1: PortNumber=2, PortNumberOfPortPins=9
          9 x PortPin, all with PortPinAnalogInput=DISABLE, PortPinControllerSelect=DISABLE, PortPinDirection=PORT_PIN_IN, PortPinDirectionChangeable=0, PortPinDriverStrength=PORT_CMOS_SPEED_GRADE1, PortPinInitialMode=PORT_PIN_MODE_GPIO, PortPinInputCharacteristic=PORT_PIN_IN_PULL_UP, PortPinInputHysteresis=0, PortPinLevelValue=PORT_PIN_LEVEL_LOW, PortPinMode=PORT_PIN_MODE_ALL, PortPinModeChangeable=0, PortPinPadLevel=PORT_PDR_CMOS_AUTOMOTIVE_LEVEL:
            PortPin_0: PortPinId=32, PortPinSymbolicName=PORT_2_PIN_0
            PortPin_1: PortPinId=33, PortPinSymbolicName=PORT_2_PIN_1
            PortPin_2: PortPinId=34, PortPinSymbolicName=PORT_2_PIN_2
            PortPin_3: PortPinId=35, PortPinSymbolicName=PORT_2_PIN_3
            PortPin_4: PortPinId=36, PortPinSymbolicName=PORT_2_PIN_4
            PortPin_5: PortPinId=37, PortPinSymbolicName=PORT_2_PIN_5
            PortPin_6: PortPinId=38, PortPinSymbolicName=PORT_2_PIN_6
            PortPin_7: PortPinId=39, PortPinSymbolicName=PORT_2_PIN_7
            PortPin_8: PortPinId=40, PortPinSymbolicName=PORT_2_PIN_8
        PortContainer_10: PortNumber=23, PortNumberOfPortPins=6
          6 x PortPin, all with PortPinAnalogInput=DISABLE, PortPinControllerSelect=DISABLE, PortPinDirection=PORT_PIN_IN, PortPinDirectionChangeable=0, PortPinDriverStrength=PORT_CMOS_SPEED_GRADE1, PortPinInitialMode=PORT_PIN_MODE_GPIO, PortPinInputCharacteristic=PORT_PIN_IN_PULL_UP, PortPinInputHysteresis=0, PortPinLevelValue=PORT_PIN_LEVEL_LOW, PortPinMode=PORT_PIN_MODE_ALL, PortPinModeChangeable=0, PortPinPadLevel=PORT_PDR_CMOS_AUTOMOTIVE_LEVEL:
            PortPin_0: PortPinId=368, PortPinSymbolicName=PORT_23_PIN_0
            PortPin_1: PortPinId=369, PortPinSymbolicName=PORT_23_PIN_1
            PortPin_2: PortPinId=370, PortPinSymbolicName=PORT_23_PIN_2
            PortPin_3: PortPinId=371, PortPinSymbolicName=PORT_23_PIN_3
            PortPin_4: PortPinId=372, PortPinSymbolicName=PORT_23_PIN_4
            PortPin_5: PortPinId=373, PortPinSymbolicName=PORT_23_PIN_5
        PortContainer_11: PortNumber=32, PortNumberOfPortPins=4
          4 x PortPin, all with PortPinAnalogInput=DISABLE, PortPinControllerSelect=DISABLE, PortPinDirection=PORT_PIN_IN, PortPinDirectionChangeable=0, PortPinDriverStrength=PORT_CMOS_SPEED_GRADE1, PortPinInitialMode=PORT_PIN_MODE_GPIO, PortPinInputCharacteristic=PORT_PIN_IN_PULL_UP, PortPinInputHysteresis=0, PortPinLevelValue=PORT_PIN_LEVEL_LOW, PortPinMode=PORT_PIN_MODE_ALL, PortPinModeChangeable=0, PortPinPadLevel=PORT_PDR_CMOS_AUTOMOTIVE_LEVEL:
            PortPin_0: PortPinId=512, PortPinSymbolicName=PORT_32_PIN_0
            PortPin_1: PortPinId=514, PortPinSymbolicName=PORT_32_PIN_2
            PortPin_2: PortPinId=515, PortPinSymbolicName=PORT_32_PIN_3
            PortPin_3: PortPinId=516, PortPinSymbolicName=PORT_32_PIN_4
        PortContainer_12: PortNumber=33, PortNumberOfPortPins=14
          14 x PortPin, all with PortPinAnalogInput=DISABLE, PortPinControllerSelect=DISABLE, PortPinDirection=PORT_PIN_IN, PortPinDirectionChangeable=0, PortPinDriverStrength=PORT_CMOS_SPEED_GRADE1, PortPinInitialMode=PORT_PIN_MODE_GPIO, PortPinInputHysteresis=0, PortPinLevelValue=PORT_PIN_LEVEL_LOW, PortPinMode=PORT_PIN_MODE_ALL, PortPinModeChangeable=0, PortPinPadLevel=PORT_PDR_CMOS_AUTOMOTIVE_LEVEL:
            PortPin_0: PortPinId=528, PortPinInputCharacteristic=PORT_PIN_IN_PULL_DOWN, PortPinSymbolicName=PORT_33_PIN_0
            PortPin_1: PortPinId=529, PortPinInputCharacteristic=PORT_PIN_IN_PULL_UP, PortPinSymbolicName=PORT_33_PIN_1
            PortPin_10: PortPinId=538, PortPinInputCharacteristic=PORT_PIN_IN_PULL_UP, PortPinSymbolicName=PORT_33_PIN_10
            PortPin_11: PortPinId=539, PortPinInputCharacteristic=PORT_PIN_IN_PULL_UP, PortPinSymbolicName=PORT_33_PIN_11
            PortPin_12: PortPinId=540, PortPinInputCharacteristic=PORT_PIN_IN_PULL_UP, PortPinSymbolicName=PORT_33_PIN_12
            PortPin_13: PortPinId=541, PortPinInputCharacteristic=PORT_PIN_IN_PULL_UP, PortPinSymbolicName=PORT_33_PIN_13
            PortPin_2: PortPinId=530, PortPinInputCharacteristic=PORT_PIN_IN_PULL_UP, PortPinSymbolicName=PORT_33_PIN_2
            PortPin_3: PortPinId=531, PortPinInputCharacteristic=PORT_PIN_IN_PULL_UP, PortPinSymbolicName=PORT_33_PIN_3
            PortPin_4: PortPinId=532, PortPinInputCharacteristic=PORT_PIN_IN_PULL_UP, PortPinSymbolicName=PORT_33_PIN_4
            PortPin_5: PortPinId=533, PortPinInputCharacteristic=PORT_PIN_IN_PULL_UP, PortPinSymbolicName=PORT_33_PIN_5
            PortPin_6: PortPinId=534, PortPinInputCharacteristic=PORT_PIN_IN_PULL_UP, PortPinSymbolicName=PORT_33_PIN_6
            PortPin_7: PortPinId=535, PortPinInputCharacteristic=PORT_PIN_IN_PULL_UP, PortPinSymbolicName=PORT_33_PIN_7
            PortPin_8: PortPinId=536, PortPinInputCharacteristic=PORT_PIN_IN_PULL_UP, PortPinSymbolicName=PORT_33_PIN_8
            PortPin_9: PortPinId=537, PortPinInputCharacteristic=PORT_PIN_IN_PULL_UP, PortPinSymbolicName=PORT_33_PIN_9
        PortContainer_13: PortNumber=40, PortNumberOfPortPins=10
          10 x PortPin, all with PortPinAnalogInput=DISABLE, PortPinControllerSelect=DISABLE, PortPinDirection=PORT_PIN_IN, PortPinDirectionChangeable=0, PortPinDriverStrength=PORT_CMOS_SPEED_GRADE1, PortPinInitialMode=PORT_PIN_MODE_GPIO, PortPinInputCharacteristic=PORT_PIN_IN_PULL_UP, PortPinInputHysteresis=1, PortPinLevelValue=PORT_PIN_LEVEL_LOW, PortPinModeChangeable=0, PortPinPadLevel=PORT_PDR_CMOS_AUTOMOTIVE_LEVEL:
            PortPin_0: PortPinId=640, PortPinSymbolicName=PORT_40_PIN_0
            PortPin_1: PortPinId=641, PortPinSymbolicName=PORT_40_PIN_1
            PortPin_2: PortPinId=642, PortPinSymbolicName=PORT_40_PIN_2
            PortPin_3: PortPinId=643, PortPinSymbolicName=PORT_40_PIN_3
            PortPin_4: PortPinId=644, PortPinSymbolicName=PORT_40_PIN_4
            PortPin_5: PortPinId=645, PortPinSymbolicName=PORT_40_PIN_5
            PortPin_6: PortPinId=646, PortPinSymbolicName=PORT_40_PIN_6
            PortPin_7: PortPinId=647, PortPinSymbolicName=PORT_40_PIN_7
            PortPin_8: PortPinId=648, PortPinSymbolicName=PORT_40_PIN_8
            PortPin_9: PortPinId=649, PortPinSymbolicName=PORT_40_PIN_9
        PortContainer_2: PortNumber=10, PortNumberOfPortPins=9
          9 x PortPin, all with PortPinAnalogInput=DISABLE, PortPinControllerSelect=DISABLE, PortPinDirection=PORT_PIN_IN, PortPinDirectionChangeable=0, PortPinDriverStrength=PORT_CMOS_SPEED_GRADE1, PortPinInitialMode=PORT_PIN_MODE_GPIO, PortPinInputCharacteristic=PORT_PIN_IN_PULL_UP, PortPinInputHysteresis=0, PortPinLevelValue=PORT_PIN_LEVEL_LOW, PortPinMode=PORT_PIN_MODE_ALL, PortPinModeChangeable=0, PortPinPadLevel=PORT_PDR_CMOS_AUTOMOTIVE_LEVEL:
            PortPin_0: PortPinId=160, PortPinSymbolicName=PORT_10_PIN_0
            PortPin_1: PortPinId=161, PortPinSymbolicName=PORT_10_PIN_1
            PortPin_2: PortPinId=162, PortPinSymbolicName=PORT_10_PIN_2
            PortPin_3: PortPinId=163, PortPinSymbolicName=PORT_10_PIN_3
            PortPin_4: PortPinId=164, PortPinSymbolicName=PORT_10_PIN_4
            PortPin_5: PortPinId=165, PortPinSymbolicName=PORT_10_PIN_5
            PortPin_6: PortPinId=166, PortPinSymbolicName=PORT_10_PIN_6
            PortPin_7: PortPinId=167, PortPinSymbolicName=PORT_10_PIN_7
            PortPin_8: PortPinId=168, PortPinSymbolicName=PORT_10_PIN_8
        PortContainer_3: PortNumber=11, PortNumberOfPortPins=7
          7 x PortPin, all with PortPinAnalogInput=DISABLE, PortPinControllerSelect=DISABLE, PortPinDirection=PORT_PIN_IN, PortPinDirectionChangeable=0, PortPinDriverStrength=PORT_CMOS_SPEED_GRADE1, PortPinInitialMode=PORT_PIN_MODE_GPIO, PortPinInputCharacteristic=PORT_PIN_IN_PULL_UP, PortPinInputHysteresis=0, PortPinLevelValue=PORT_PIN_LEVEL_LOW, PortPinMode=PORT_PIN_MODE_ALL, PortPinModeChangeable=0, PortPinPadLevel=PORT_PDR_CMOS_AUTOMOTIVE_LEVEL:
            PortPin_0: PortPinId=178, PortPinSymbolicName=PORT_11_PIN_2
            PortPin_1: PortPinId=179, PortPinSymbolicName=PORT_11_PIN_3
            PortPin_2: PortPinId=182, PortPinSymbolicName=PORT_11_PIN_6
            PortPin_3: PortPinId=185, PortPinSymbolicName=PORT_11_PIN_9
            PortPin_4: PortPinId=186, PortPinSymbolicName=PORT_11_PIN_10
            PortPin_5: PortPinId=187, PortPinSymbolicName=PORT_11_PIN_11
            PortPin_6: PortPinId=188, PortPinSymbolicName=PORT_11_PIN_12
        PortContainer_4: PortNumber=13, PortNumberOfPortPins=4
          PortLVDSM_0 (PortLVDSM): PortLVDSMPinPair=Pin_0_Pin_1, PortPadSupplyVoltage=PAD_SUPPLY_5V
          PortLVDSM_1 (PortLVDSM): PortLVDSMPinPair=Pin_2_Pin_3, PortPadSupplyVoltage=PAD_SUPPLY_5V
          4 x PortPin, all with PortPinAnalogInput=DISABLE, PortPinControllerSelect=DISABLE, PortPinDirection=PORT_PIN_IN, PortPinDirectionChangeable=0, PortPinDriverStrength=PORT_CMOS_SPEED_GRADE1, PortPinInitialMode=PORT_PIN_MODE_GPIO, PortPinInputCharacteristic=PORT_PIN_IN_PULL_UP, PortPinInputHysteresis=0, PortPinLevelValue=PORT_PIN_LEVEL_LOW, PortPinMode=PORT_PIN_MODE_ALL, PortPinModeChangeable=0, PortPinPadLevel=PORT_PDR_CMOS_AUTOMOTIVE_LEVEL:
            PortPin_0: PortPinId=208, PortPinSymbolicName=PORT_13_PIN_0
            PortPin_1: PortPinId=209, PortPinSymbolicName=PORT_13_PIN_1
            PortPin_2: PortPinId=210, PortPinSymbolicName=PORT_13_PIN_2
            PortPin_3: PortPinId=211, PortPinSymbolicName=PORT_13_PIN_3
        PortContainer_5: PortNumber=14, PortNumberOfPortPins=11
          11 x PortPin, all with PortPinAnalogInput=DISABLE, PortPinControllerSelect=DISABLE, PortPinDirectionChangeable=0, PortPinDriverStrength=PORT_CMOS_SPEED_GRADE1, PortPinLevelValue=PORT_PIN_LEVEL_LOW, PortPinMode=PORT_PIN_MODE_ALL, PortPinModeChangeable=0, PortPinPadLevel=PORT_PDR_CMOS_AUTOMOTIVE_LEVEL:
            CAN1_TJA1043_RXD: PortPinDirection=PORT_PIN_IN, PortPinId=225, PortPinInitialMode=PORT_PIN_MODE_GPIO, PortPinInputCharacteristic=PORT_PIN_IN_NO_PULL, PortPinInputHysteresis=0, PortPinSymbolicName=PORT_14_PIN_1
            CAN1_TJA1043_TXD: PortPinDirection=PORT_PIN_OUT, PortPinId=224, PortPinInitialMode=PORT_PIN_MODE_ALT5, PortPinInputHysteresis=0, PortPinOutputCharacteristic=PORT_PIN_OUT_PUSHPULL, PortPinSymbolicName=PORT_14_PIN_0
            PortPin_10: PortPinDirection=PORT_PIN_IN, PortPinId=234, PortPinInitialMode=PORT_PIN_MODE_GPIO, PortPinInputCharacteristic=PORT_PIN_IN_PULL_UP, PortPinInputHysteresis=0, PortPinSymbolicName=PORT_14_PIN_10
            PortPin_2: PortPinDirection=PORT_PIN_IN, PortPinId=226, PortPinInitialMode=PORT_PIN_MODE_GPIO, PortPinInputCharacteristic=PORT_PIN_IN_PULL_UP, PortPinInputHysteresis=1, PortPinSymbolicName=PORT_14_PIN_2
            PortPin_3: PortPinDirection=PORT_PIN_IN, PortPinId=227, PortPinInitialMode=PORT_PIN_MODE_GPIO, PortPinInputCharacteristic=PORT_PIN_IN_PULL_UP, PortPinInputHysteresis=0, PortPinSymbolicName=PORT_14_PIN_3
            PortPin_4: PortPinDirection=PORT_PIN_IN, PortPinId=228, PortPinInitialMode=PORT_PIN_MODE_GPIO, PortPinInputCharacteristic=PORT_PIN_IN_PULL_UP, PortPinInputHysteresis=1, PortPinSymbolicName=PORT_14_PIN_4
            PortPin_5: PortPinDirection=PORT_PIN_IN, PortPinId=229, PortPinInitialMode=PORT_PIN_MODE_GPIO, PortPinInputCharacteristic=PORT_PIN_IN_PULL_UP, PortPinInputHysteresis=0, PortPinSymbolicName=PORT_14_PIN_5
            PortPin_6: PortPinDirection=PORT_PIN_IN, PortPinId=230, PortPinInitialMode=PORT_PIN_MODE_GPIO, PortPinInputCharacteristic=PORT_PIN_IN_PULL_UP, PortPinInputHysteresis=0, PortPinSymbolicName=PORT_14_PIN_6
            PortPin_7: PortPinDirection=PORT_PIN_IN, PortPinId=231, PortPinInitialMode=PORT_PIN_MODE_GPIO, PortPinInputCharacteristic=PORT_PIN_IN_PULL_UP, PortPinInputHysteresis=0, PortPinSymbolicName=PORT_14_PIN_7
            PortPin_8: PortPinDirection=PORT_PIN_IN, PortPinId=232, PortPinInitialMode=PORT_PIN_MODE_GPIO, PortPinInputCharacteristic=PORT_PIN_IN_PULL_UP, PortPinInputHysteresis=0, PortPinSymbolicName=PORT_14_PIN_8
            PortPin_9: PortPinDirection=PORT_PIN_IN, PortPinId=233, PortPinInitialMode=PORT_PIN_MODE_GPIO, PortPinInputCharacteristic=PORT_PIN_IN_PULL_UP, PortPinInputHysteresis=0, PortPinSymbolicName=PORT_14_PIN_9
        PortContainer_6: PortNumber=15, PortNumberOfPortPins=9
          9 x PortPin, all with PortPinAnalogInput=DISABLE, PortPinControllerSelect=DISABLE, PortPinDirectionChangeable=0, PortPinDriverStrength=PORT_CMOS_SPEED_GRADE1, PortPinInitialMode=PORT_PIN_MODE_GPIO, PortPinLevelValue=PORT_PIN_LEVEL_LOW, PortPinMode=PORT_PIN_MODE_ALL, PortPinModeChangeable=0, PortPinPadLevel=PORT_PDR_CMOS_AUTOMOTIVE_LEVEL:
            CAN1_TJA1043_EN: PortPinDirection=PORT_PIN_OUT, PortPinId=247, PortPinInputHysteresis=0, PortPinOutputCharacteristic=PORT_PIN_OUT_PUSHPULL, PortPinSymbolicName=PORT_15_PIN_7
            CAN1_TJA1043_ERR: PortPinDirection=PORT_PIN_IN, PortPinId=246, PortPinInputCharacteristic=PORT_PIN_IN_PULL_UP, PortPinInputHysteresis=0, PortPinSymbolicName=PORT_15_PIN_6
            CAN1_TJA1043_STB: PortPinDirection=PORT_PIN_OUT, PortPinId=248, PortPinInputHysteresis=0, PortPinOutputCharacteristic=PORT_PIN_OUT_PUSHPULL, PortPinSymbolicName=PORT_15_PIN_8
            PortPin_0: PortPinDirection=PORT_PIN_OUT, PortPinId=240, PortPinInputHysteresis=0, PortPinOutputCharacteristic=PORT_PIN_OUT_PUSHPULL, PortPinSymbolicName=PORT_15_PIN_0
            PortPin_1: PortPinDirection=PORT_PIN_OUT, PortPinId=241, PortPinInputHysteresis=1, PortPinOutputCharacteristic=PORT_PIN_OUT_PUSHPULL, PortPinSymbolicName=PORT_15_PIN_1
            PortPin_2: PortPinDirection=PORT_PIN_OUT, PortPinId=242, PortPinInputHysteresis=0, PortPinOutputCharacteristic=PORT_PIN_OUT_PUSHPULL, PortPinSymbolicName=PORT_15_PIN_2
            PortPin_3: PortPinDirection=PORT_PIN_OUT, PortPinId=243, PortPinInputHysteresis=0, PortPinOutputCharacteristic=PORT_PIN_OUT_PUSHPULL, PortPinSymbolicName=PORT_15_PIN_3
            PortPin_4: PortPinDirection=PORT_PIN_IN, PortPinId=244, PortPinInputCharacteristic=PORT_PIN_IN_PULL_UP, PortPinInputHysteresis=0, PortPinSymbolicName=PORT_15_PIN_4
            PortPin_5: PortPinDirection=PORT_PIN_IN, PortPinId=245, PortPinInputCharacteristic=PORT_PIN_IN_PULL_UP, PortPinInputHysteresis=0, PortPinSymbolicName=PORT_15_PIN_5
        PortContainer_7: PortNumber=20, PortNumberOfPortPins=13
          13 x PortPin, all with PortPinAnalogInput=DISABLE, PortPinControllerSelect=DISABLE, PortPinDirectionChangeable=0, PortPinDriverStrength=PORT_CMOS_SPEED_GRADE1, PortPinInputHysteresis=0, PortPinLevelValue=PORT_PIN_LEVEL_LOW, PortPinMode=PORT_PIN_MODE_ALL, PortPinModeChangeable=0, PortPinPadLevel=PORT_PDR_CMOS_AUTOMOTIVE_LEVEL:
            PortPin_0: PortPinDirection=PORT_PIN_IN, PortPinId=320, PortPinInitialMode=PORT_PIN_MODE_GPIO, PortPinInputCharacteristic=PORT_PIN_IN_PULL_UP, PortPinSymbolicName=PORT_20_PIN_0
            PortPin_1: PortPinDirection=PORT_PIN_IN, PortPinId=321, PortPinInitialMode=PORT_PIN_MODE_GPIO, PortPinInputCharacteristic=PORT_PIN_IN_PULL_UP, PortPinSymbolicName=PORT_20_PIN_1
            PortPin_10: PortPinDirection=PORT_PIN_IN, PortPinId=332, PortPinInitialMode=PORT_PIN_MODE_GPIO, PortPinInputCharacteristic=PORT_PIN_IN_PULL_UP, PortPinSymbolicName=PORT_20_PIN_12
            PortPin_11: PortPinDirection=PORT_PIN_IN, PortPinId=333, PortPinInitialMode=PORT_PIN_MODE_GPIO, PortPinInputCharacteristic=PORT_PIN_IN_PULL_UP, PortPinSymbolicName=PORT_20_PIN_13
            PortPin_12: PortPinDirection=PORT_PIN_IN, PortPinId=334, PortPinInitialMode=PORT_PIN_MODE_GPIO, PortPinInputCharacteristic=PORT_PIN_IN_PULL_UP, PortPinSymbolicName=PORT_20_PIN_14
            PortPin_2: PortPinDirection=PORT_PIN_IN, PortPinId=322, PortPinInitialMode=PORT_PIN_MODE_GPIO, PortPinInputCharacteristic=PORT_PIN_IN_PULL_UP, PortPinSymbolicName=PORT_20_PIN_2
            PortPin_3: PortPinDirection=PORT_PIN_IN, PortPinId=323, PortPinInitialMode=PORT_PIN_MODE_GPIO, PortPinInputCharacteristic=PORT_PIN_IN_PULL_UP, PortPinSymbolicName=PORT_20_PIN_3
            PortPin_4: PortPinDirection=PORT_PIN_OUT, PortPinId=326, PortPinInitialMode=PORT_PIN_MODE_GPIO, PortPinOutputCharacteristic=PORT_PIN_OUT_PUSHPULL, PortPinSymbolicName=PORT_20_PIN_6
            PortPin_5: PortPinDirection=PORT_PIN_IN, PortPinId=327, PortPinInitialMode=PORT_PIN_MODE_GPIO, PortPinInputCharacteristic=PORT_PIN_IN_NO_PULL, PortPinSymbolicName=PORT_20_PIN_7
            PortPin_6: PortPinDirection=PORT_PIN_OUT, PortPinId=328, PortPinInitialMode=PORT_PIN_MODE_ALT5, PortPinOutputCharacteristic=PORT_PIN_OUT_PUSHPULL, PortPinSymbolicName=PORT_20_PIN_8
            PortPin_7: PortPinDirection=PORT_PIN_IN, PortPinId=329, PortPinInitialMode=PORT_PIN_MODE_GPIO, PortPinInputCharacteristic=PORT_PIN_IN_PULL_UP, PortPinSymbolicName=PORT_20_PIN_9
            PortPin_8: PortPinDirection=PORT_PIN_IN, PortPinId=330, PortPinInitialMode=PORT_PIN_MODE_GPIO, PortPinInputCharacteristic=PORT_PIN_IN_PULL_UP, PortPinSymbolicName=PORT_20_PIN_10
            PortPin_9: PortPinDirection=PORT_PIN_IN, PortPinId=331, PortPinInitialMode=PORT_PIN_MODE_GPIO, PortPinInputCharacteristic=PORT_PIN_IN_PULL_UP, PortPinSymbolicName=PORT_20_PIN_11
        PortContainer_8: PortNumber=21, PortNumberOfPortPins=8
          PortLVDSH_0 (PortLVDSH):
            PortLVDSHPinPair = Pin_2_Pin_3
            PortLVDSRxDisable = DISABLE_LVDS
            PortLVDSRxDisableController = PORT_CONTROLLED
            PortLVDSRxTerminationMode = INTERNAL_TERMINATION
          PortLVDSH_1 (PortLVDSH):
            PortLVDSHPinPair = Pin_4_Pin_5
            PortLVDSPowerDown = PORT_LVDS_POWER_DOWN
            PortLVDSPowerDownPullDown = DISABLE
            PortLVDSTxDisable = DISABLE_LVDS
            PortLVDSTxDisableController = PORT_CONTROLLED
            PortLVDSTxSignallingMode = IEEE_GENERAL_PURPOSE_LINK
          8 x PortPin, all with PortPinAnalogInput=DISABLE, PortPinControllerSelect=DISABLE, PortPinDirection=PORT_PIN_IN, PortPinDirectionChangeable=0, PortPinDriverStrength=PORT_CMOS_SPEED_GRADE1, PortPinInitialMode=PORT_PIN_MODE_GPIO, PortPinInputCharacteristic=PORT_PIN_IN_PULL_UP, PortPinInputHysteresis=1, PortPinLevelValue=PORT_PIN_LEVEL_LOW, PortPinMode=PORT_PIN_MODE_ALL, PortPinModeChangeable=0, PortPinPadLevel=PORT_PDR_CMOS_AUTOMOTIVE_LEVEL:
            PortPin_0: PortPinId=336, PortPinSymbolicName=PORT_21_PIN_0
            PortPin_1: PortPinId=337, PortPinSymbolicName=PORT_21_PIN_1
            PortPin_2: PortPinId=338, PortPinSymbolicName=PORT_21_PIN_2
            PortPin_3: PortPinId=339, PortPinSymbolicName=PORT_21_PIN_3
            PortPin_4: PortPinId=340, PortPinSymbolicName=PORT_21_PIN_4
            PortPin_5: PortPinId=341, PortPinSymbolicName=PORT_21_PIN_5
            PortPin_6: PortPinId=342, PortPinSymbolicName=PORT_21_PIN_6
            PortPin_7: PortPinId=343, PortPinSymbolicName=PORT_21_PIN_7
        PortContainer_9: PortNumber=22, PortNumberOfPortPins=4
          PortLVDSM_0 (PortLVDSM): PortLVDSMPinPair=Pin_0_Pin_1, PortPadSupplyVoltage=PAD_SUPPLY_5V
          PortLVDSM_1 (PortLVDSM): PortLVDSMPinPair=Pin_2_Pin_3, PortPadSupplyVoltage=PAD_SUPPLY_5V
          4 x PortPin, all with PortPinAnalogInput=DISABLE, PortPinControllerSelect=DISABLE, PortPinDirection=PORT_PIN_IN, PortPinDirectionChangeable=0, PortPinDriverStrength=PORT_CMOS_SPEED_GRADE1, PortPinInitialMode=PORT_PIN_MODE_GPIO, PortPinInputCharacteristic=PORT_PIN_IN_PULL_UP, PortPinInputHysteresis=0, PortPinLevelValue=PORT_PIN_LEVEL_LOW, PortPinMode=PORT_PIN_MODE_ALL, PortPinModeChangeable=0, PortPinPadLevel=PORT_PDR_CMOS_AUTOMOTIVE_LEVEL:
            PortPin_0: PortPinId=352, PortPinSymbolicName=PORT_22_PIN_0
            PortPin_1: PortPinId=353, PortPinSymbolicName=PORT_22_PIN_1
            PortPin_2: PortPinId=354, PortPinSymbolicName=PORT_22_PIN_2
            PortPin_3: PortPinId=355, PortPinSymbolicName=PORT_22_PIN_3
    PortSafety: PortInitCheckApi=0, PortSafetyEnable=0
    PortGeneral:
      PortDevErrorDetect = 0
      PortPBFixedAddress = 0
      PortRunningInUser0Mode = 0
      PortSetPinDirectionApi = 0
      PortSetPinModeApi = 0
      PortUserModeInitApiEnable = 0
      PortUserModeRuntimeApiEnable = 0
      PortVersionInfoApi = 1
    CommonPublishedInformation:
      ArMajorVersion = 3
      ArMinorVersion = 2
      ArPatchVersion = 0
      ModuleId = 124
      Release = _TRICORE_TC275
      SwMajorVersion = 3
      SwMinorVersion = 1
      SwPatchVersion = 2
      VendorId = 17
package /Mcu
  module config Mcu: implementation-config-variant=VARIANT-POST-BUILD-LOADABLE
    McuPublishedInformation
      18 x McuResetReasonConf:
        MCU_CB0_RESET: McuResetReason=8
        MCU_CB1_RESET: McuResetReason=9
        MCU_CB3_RESET: McuResetReason=10
        MCU_ESR0_RESET: McuResetReason=0
        MCU_ESR1_RESET: McuResetReason=1
        MCU_EVR13_RESET: McuResetReason=12
        MCU_EVR33_RESET: McuResetReason=13
        MCU_POWER_ON_RESET: McuResetReason=7
        MCU_RESET_MULTIPLE: McuResetReason=254
        MCU_RESET_UNDEFINED: McuResetReason=255
        MCU_SMU_RESET: McuResetReason=2
        MCU_STBYR_RESET: McuResetReason=15
        MCU_STM0_RESET: McuResetReason=4
        MCU_STM1_RESET: McuResetReason=5
        MCU_STM2_RESET: McuResetReason=6
        MCU_SUPPLY_WDOG_RESET: McuResetReason=14
        MCU_SW_RESET: McuResetReason=3
        MCU_TP_RESET: McuResetReason=11
    McuGeneralConfiguration:
      McuClearColdResetApi = 0
      McuDeInitApi = 0
      McuDevErrorDetect = 0
      McuErayPllDisable = 0
      McuErayPllInitDelay = 10
      McuFmPllEnable = 0
      McuGetRamStateApi = 0
      McuIdleModeCpuCore = INDIVIDUAL_CORES
      McuInitClock = 1
      McuMainOscillatorFrequency = 20
      McuNoPll = 0
      McuPBFixedAddress = 0
      McuPerformResetApi = 1
      McuPllInitDelay = 10
      McuResetSfrAtInit = 0
      McuRunningInUser0Mode = 0
      McuSystemModeCpuCore = CPU_CORE_0
      McuUserModeDeInitApiEnable = 0
      McuUserModeInitApiEnable = 0
      McuUserModeRuntimeApiEnable = 0
      McuVersionInfoApi = 0
    McuModuleConfiguration_0 (McuModuleConfiguration):
      McuClockSrcFailureNotification = DISABLED
      McuNumberOfMcuModes = 1
      McuRamSectors = 0
      McuResetSetting = 2
      McuStm{0..2}ResetDisable = 0
      AscLinConfiguration: AscLin0=USE_FOR_NONE, AscLin1=USE_FOR_NONE, AscLin2=USE_FOR_NONE, AscLin3=USE_FOR_NONE
      GtmConfiguration_0 (GtmConfiguration)
        5 x Atom:
          Atom_0
            8 x AtomChannel:
              AtomChannel_0
                AtomChannelAruConfiguration: AtomChAruBlockingMode=GTM_ABM_DISABLED, AtomChAruReadAddress0=510, AtomChAruReadAddress1=510, AtomChannelAruEnable=0, AtomChannelCpuWriteRequest=0
                AtomChannelEnable: AtomChDisableOnAgcTrigger=0, AtomChannelEnable=AT_START
                AtomChannelInterrupt:
                  AtomCcu0Notification = NULL_PTR
                  AtomCcu1Notification = NULL_PTR
                  AtomGlobalCcuSel = 0
                  AtomIntEnableOnCcu0Trigger = 0
                  AtomIntEnableOnCcu1Trigger = 0
                  AtomInterruptMode = GTM_INTERRUPT_LEVEL_MODE
                  AtomNotification = NULL_PTR
                AtomChannelOutput:
                  AtomChOutputDisableOnAgcTrig = 0
                  AtomChannelOutputControl = DONT_ENABLE_CHANNEL_OUTPUT
                  AtomChannelOutputSignalLevel = LOW
                  AtomChannelPortPinSelect = TOUT9_SELC_PORT0_PIN0
                AtomChannelTimerParameters:
                  AtomChEnableForceUpdate = 0
                  AtomChResetCn0OnForceUpdate = 0
                  AtomChShadowCompareValSr0 = 0
                  AtomChShadowCompareValSr1 = 0
                  AtomChSomcCompareStrategy = TIMEBASE_GREATER_EQUAL_TO_CMx
                  AtomChSomcTimebaseForComparison = TBU_TS1
                  AtomChUpdateEnableOnCn0Reset = 0
                  AtomChannelClockSelect = GTM_CONFIGURABLE_CLOCK_0
                  AtomChannelCompareValueCm0 = 0
                  AtomChannelCompareValueCm1 = 0
                  AtomChannelCounterCn0Reset = ON_COMPARE_MATCH_ON_CHANNEL
                  AtomChannelCounterValCn0 = 0
                  AtomChannelModeSelect = ATOM_SIG_OUTPUT_MODE_IMMEDIATE
                  AtomChannelOneShotMode = 0
                  AtomChannelTriggerOutput = TRIG_FROM_PREVIOUS_CHANNEL
                  AtomModeControlBits = 0
                  AtomServeLastAruCommStrategy = 0
                AtomChannelUsage: AtomChannelUsage=USED_BY_OTHER_DRIVERS_OR_UNUSED
              AtomChannel_1
                AtomChannelAruConfiguration: AtomChAruBlockingMode=GTM_ABM_DISABLED, AtomChAruReadAddress0=510, AtomChAruReadAddress1=510, AtomChannelAruEnable=0, AtomChannelCpuWriteRequest=0
                AtomChannelEnable: AtomChDisableOnAgcTrigger=0, AtomChannelEnable=AT_START
                AtomChannelInterrupt:
                  AtomCcu0Notification = NULL_PTR
                  AtomCcu1Notification = NULL_PTR
                  AtomGlobalCcuSel = 0
                  AtomIntEnableOnCcu0Trigger = 0
                  AtomIntEnableOnCcu1Trigger = 0
                  AtomInterruptMode = GTM_INTERRUPT_LEVEL_MODE
                  AtomNotification = NULL_PTR
                AtomChannelOutput:
                  AtomChOutputDisableOnAgcTrig = 0
                  AtomChannelOutputControl = DONT_ENABLE_CHANNEL_OUTPUT
                  AtomChannelOutputSignalLevel = LOW
                  AtomChannelPortPinSelect = TOUT10_SELC_PORT0_PIN1
                AtomChannelTimerParameters:
                  AtomChEnableForceUpdate = 0
                  AtomChResetCn0OnForceUpdate = 0
                  AtomChShadowCompareValSr0 = 0
                  AtomChShadowCompareValSr1 = 0
                  AtomChSomcCompareStrategy = TIMEBASE_GREATER_EQUAL_TO_CMx
                  AtomChSomcTimebaseForComparison = TBU_TS1
                  AtomChUpdateEnableOnCn0Reset = 0
                  AtomChannelClockSelect = GTM_CONFIGURABLE_CLOCK_0
                  AtomChannelCompareValueCm0 = 0
                  AtomChannelCompareValueCm1 = 0
                  AtomChannelCounterCn0Reset = ON_COMPARE_MATCH_ON_CHANNEL
                  AtomChannelCounterValCn0 = 0
                  AtomChannelModeSelect = ATOM_SIG_OUTPUT_MODE_IMMEDIATE
                  AtomChannelOneShotMode = 0
                  AtomChannelTriggerOutput = TRIG_FROM_PREVIOUS_CHANNEL
                  AtomModeControlBits = 0
                  AtomServeLastAruCommStrategy = 0
                AtomChannelUsage: AtomChannelUsage=USED_BY_OTHER_DRIVERS_OR_UNUSED
              AtomChannel_2
                AtomChannelAruConfiguration: AtomChAruBlockingMode=GTM_ABM_DISABLED, AtomChAruReadAddress0=510, AtomChAruReadAddress1=510, AtomChannelAruEnable=0, AtomChannelCpuWriteRequest=0
                AtomChannelEnable: AtomChDisableOnAgcTrigger=0, AtomChannelEnable=AT_START
                AtomChannelInterrupt:
                  AtomCcu0Notification = NULL_PTR
                  AtomCcu1Notification = NULL_PTR
                  AtomGlobalCcuSel = 0
                  AtomIntEnableOnCcu0Trigger = 0
                  AtomIntEnableOnCcu1Trigger = 0
                  AtomInterruptMode = GTM_INTERRUPT_LEVEL_MODE
                  AtomNotification = NULL_PTR
                AtomChannelOutput:
                  AtomChOutputDisableOnAgcTrig = 0
                  AtomChannelOutputControl = DONT_ENABLE_CHANNEL_OUTPUT
                  AtomChannelOutputSignalLevel = LOW
                  AtomChannelPortPinSelect = TOUT12_SELC_PORT0_PIN3
                AtomChannelTimerParameters:
                  AtomChEnableForceUpdate = 0
                  AtomChResetCn0OnForceUpdate = 0
                  AtomChShadowCompareValSr0 = 0
                  AtomChShadowCompareValSr1 = 0
                  AtomChSomcCompareStrategy = TIMEBASE_GREATER_EQUAL_TO_CMx
                  AtomChSomcTimebaseForComparison = TBU_TS1
                  AtomChUpdateEnableOnCn0Reset = 0
                  AtomChannelClockSelect = GTM_CONFIGURABLE_CLOCK_0
                  AtomChannelCompareValueCm0 = 0
                  AtomChannelCompareValueCm1 = 0
                  AtomChannelCounterCn0Reset = ON_COMPARE_MATCH_ON_CHANNEL
                  AtomChannelCounterValCn0 = 0
                  AtomChannelModeSelect = ATOM_SIG_OUTPUT_MODE_IMMEDIATE
                  AtomChannelOneShotMode = 0
                  AtomChannelTriggerOutput = TRIG_FROM_PREVIOUS_CHANNEL
                  AtomModeControlBits = 0
                  AtomServeLastAruCommStrategy = 0
                AtomChannelUsage: AtomChannelUsage=USED_BY_OTHER_DRIVERS_OR_UNUSED
              AtomChannel_3
                AtomChannelAruConfiguration: AtomChAruBlockingMode=GTM_ABM_DISABLED, AtomChAruReadAddress0=510, AtomChAruReadAddress1=510, AtomChannelAruEnable=0, AtomChannelCpuWriteRequest=0
                AtomChannelEnable: AtomChDisableOnAgcTrigger=0, AtomChannelEnable=AT_START
                AtomChannelInterrupt:
                  AtomCcu0Notification = NULL_PTR
                  AtomCcu1Notification = NULL_PTR
                  AtomGlobalCcuSel = 0
                  AtomIntEnableOnCcu0Trigger = 0
                  AtomIntEnableOnCcu1Trigger = 0
                  AtomInterruptMode = GTM_INTERRUPT_LEVEL_MODE
                  AtomNotification = NULL_PTR
                AtomChannelOutput:
                  AtomChOutputDisableOnAgcTrig = 0
                  AtomChannelOutputControl = DONT_ENABLE_CHANNEL_OUTPUT
                  AtomChannelOutputSignalLevel = LOW
                  AtomChannelPortPinSelect = TOUT13_SELC_PORT0_PIN4
                AtomChannelTimerParameters:
                  AtomChEnableForceUpdate = 0
                  AtomChResetCn0OnForceUpdate = 0
                  AtomChShadowCompareValSr0 = 0
                  AtomChShadowCompareValSr1 = 0
                  AtomChSomcCompareStrategy = TIMEBASE_GREATER_EQUAL_TO_CMx
                  AtomChSomcTimebaseForComparison = TBU_TS1
                  AtomChUpdateEnableOnCn0Reset = 0
                  AtomChannelClockSelect = GTM_CONFIGURABLE_CLOCK_0
                  AtomChannelCompareValueCm0 = 0
                  AtomChannelCompareValueCm1 = 0
                  AtomChannelCounterCn0Reset = ON_COMPARE_MATCH_ON_CHANNEL
                  AtomChannelCounterValCn0 = 0
                  AtomChannelModeSelect = ATOM_SIG_OUTPUT_MODE_IMMEDIATE
                  AtomChannelOneShotMode = 0
                  AtomChannelTriggerOutput = TRIG_FROM_PREVIOUS_CHANNEL
                  AtomModeControlBits = 0
                  AtomServeLastAruCommStrategy = 0
                AtomChannelUsage: AtomChannelUsage=USED_BY_OTHER_DRIVERS_OR_UNUSED
              AtomChannel_4
                AtomChannelAruConfiguration: AtomChAruBlockingMode=GTM_ABM_DISABLED, AtomChAruReadAddress0=510, AtomChAruReadAddress1=510, AtomChannelAruEnable=0, AtomChannelCpuWriteRequest=0
                AtomChannelEnable: AtomChDisableOnAgcTrigger=0, AtomChannelEnable=AT_START
                AtomChannelInterrupt:
                  AtomCcu0Notification = NULL_PTR
                  AtomCcu1Notification = NULL_PTR
                  AtomGlobalCcuSel = 0
                  AtomIntEnableOnCcu0Trigger = 0
                  AtomIntEnableOnCcu1Trigger = 0
                  AtomInterruptMode = GTM_INTERRUPT_LEVEL_MODE
                  AtomNotification = NULL_PTR
                AtomChannelOutput:
                  AtomChOutputDisableOnAgcTrig = 0
                  AtomChannelOutputControl = DONT_ENABLE_CHANNEL_OUTPUT
                  AtomChannelOutputSignalLevel = LOW
                  AtomChannelPortPinSelect = TOUT14_SELC_PORT0_PIN5
                AtomChannelTimerParameters:
                  AtomChEnableForceUpdate = 0
                  AtomChResetCn0OnForceUpdate = 0
                  AtomChShadowCompareValSr0 = 0
                  AtomChShadowCompareValSr1 = 0
                  AtomChSomcCompareStrategy = TIMEBASE_GREATER_EQUAL_TO_CMx
                  AtomChSomcTimebaseForComparison = TBU_TS1
                  AtomChUpdateEnableOnCn0Reset = 0
                  AtomChannelClockSelect = GTM_CONFIGURABLE_CLOCK_0
                  AtomChannelCompareValueCm0 = 0
                  AtomChannelCompareValueCm1 = 0
                  AtomChannelCounterCn0Reset = ON_COMPARE_MATCH_ON_CHANNEL
                  AtomChannelCounterValCn0 = 0
                  AtomChannelModeSelect = ATOM_SIG_OUTPUT_MODE_IMMEDIATE
                  AtomChannelOneShotMode = 0
                  AtomChannelTriggerOutput = TRIG_FROM_PREVIOUS_CHANNEL
                  AtomModeControlBits = 0
                  AtomServeLastAruCommStrategy = 0
                AtomChannelUsage: AtomChannelUsage=USED_BY_OTHER_DRIVERS_OR_UNUSED
              AtomChannel_5
                AtomChannelAruConfiguration: AtomChAruBlockingMode=GTM_ABM_DISABLED, AtomChAruReadAddress0=510, AtomChAruReadAddress1=510, AtomChannelAruEnable=0, AtomChannelCpuWriteRequest=0
                AtomChannelEnable: AtomChDisableOnAgcTrigger=0, AtomChannelEnable=AT_START
                AtomChannelInterrupt:
                  AtomCcu0Notification = NULL_PTR
                  AtomCcu1Notification = NULL_PTR
                  AtomGlobalCcuSel = 0
                  AtomIntEnableOnCcu0Trigger = 0
                  AtomIntEnableOnCcu1Trigger = 0
                  AtomInterruptMode = GTM_INTERRUPT_LEVEL_MODE
                  AtomNotification = NULL_PTR
                AtomChannelOutput:
                  AtomChOutputDisableOnAgcTrig = 0
                  AtomChannelOutputControl = DONT_ENABLE_CHANNEL_OUTPUT
                  AtomChannelOutputSignalLevel = LOW
                  AtomChannelPortPinSelect = TOUT15_SELC_PORT0_PIN6
                AtomChannelTimerParameters:
                  AtomChEnableForceUpdate = 0
                  AtomChResetCn0OnForceUpdate = 0
                  AtomChShadowCompareValSr0 = 0
                  AtomChShadowCompareValSr1 = 0
                  AtomChSomcCompareStrategy = TIMEBASE_GREATER_EQUAL_TO_CMx
                  AtomChSomcTimebaseForComparison = TBU_TS1
                  AtomChUpdateEnableOnCn0Reset = 0
                  AtomChannelClockSelect = GTM_CONFIGURABLE_CLOCK_0
                  AtomChannelCompareValueCm0 = 0
                  AtomChannelCompareValueCm1 = 0
                  AtomChannelCounterCn0Reset = ON_COMPARE_MATCH_ON_CHANNEL
                  AtomChannelCounterValCn0 = 0
                  AtomChannelModeSelect = ATOM_SIG_OUTPUT_MODE_IMMEDIATE
                  AtomChannelOneShotMode = 0
                  AtomChannelTriggerOutput = TRIG_FROM_PREVIOUS_CHANNEL
                  AtomModeControlBits = 0
                  AtomServeLastAruCommStrategy = 0
                AtomChannelUsage: AtomChannelUsage=USED_BY_OTHER_DRIVERS_OR_UNUSED
              AtomChannel_6
                AtomChannelAruConfiguration: AtomChAruBlockingMode=GTM_ABM_DISABLED, AtomChAruReadAddress0=510, AtomChAruReadAddress1=510, AtomChannelAruEnable=0, AtomChannelCpuWriteRequest=0
                AtomChannelEnable: AtomChDisableOnAgcTrigger=0, AtomChannelEnable=AT_START
                AtomChannelInterrupt:
                  AtomCcu0Notification = NULL_PTR
                  AtomCcu1Notification = NULL_PTR
                  AtomGlobalCcuSel = 0
                  AtomIntEnableOnCcu0Trigger = 0
                  AtomIntEnableOnCcu1Trigger = 0
                  AtomInterruptMode = GTM_INTERRUPT_LEVEL_MODE
                  AtomNotification = NULL_PTR
                AtomChannelOutput:
                  AtomChOutputDisableOnAgcTrig = 0
                  AtomChannelOutputControl = DONT_ENABLE_CHANNEL_OUTPUT
                  AtomChannelOutputSignalLevel = LOW
                  AtomChannelPortPinSelect = TOUT16_SELC_PORT0_PIN7
                AtomChannelTimerParameters:
                  AtomChEnableForceUpdate = 0
                  AtomChResetCn0OnForceUpdate = 0
                  AtomChShadowCompareValSr0 = 0
                  AtomChShadowCompareValSr1 = 0
                  AtomChSomcCompareStrategy = TIMEBASE_GREATER_EQUAL_TO_CMx
                  AtomChSomcTimebaseForComparison = TBU_TS1
                  AtomChUpdateEnableOnCn0Reset = 0
                  AtomChannelClockSelect = GTM_CONFIGURABLE_CLOCK_0
                  AtomChannelCompareValueCm0 = 0
                  AtomChannelCompareValueCm1 = 0
                  AtomChannelCounterCn0Reset = ON_COMPARE_MATCH_ON_CHANNEL
                  AtomChannelCounterValCn0 = 0
                  AtomChannelModeSelect = ATOM_SIG_OUTPUT_MODE_IMMEDIATE
                  AtomChannelOneShotMode = 0
                  AtomChannelTriggerOutput = TRIG_FROM_PREVIOUS_CHANNEL
                  AtomModeControlBits = 0
                  AtomServeLastAruCommStrategy = 0
                AtomChannelUsage: AtomChannelUsage=USED_BY_OTHER_DRIVERS_OR_UNUSED
              AtomChannel_7
                AtomChannelAruConfiguration: AtomChAruBlockingMode=GTM_ABM_DISABLED, AtomChAruReadAddress0=510, AtomChAruReadAddress1=510, AtomChannelAruEnable=0, AtomChannelCpuWriteRequest=0
                AtomChannelEnable: AtomChDisableOnAgcTrigger=0, AtomChannelEnable=AT_START
                AtomChannelInterrupt:
                  AtomCcu0Notification = NULL_PTR
                  AtomCcu1Notification = NULL_PTR
                  AtomGlobalCcuSel = 0
                  AtomIntEnableOnCcu0Trigger = 0
                  AtomIntEnableOnCcu1Trigger = 0
                  AtomInterruptMode = GTM_INTERRUPT_LEVEL_MODE
                  AtomNotification = NULL_PTR
                AtomChannelOutput:
                  AtomChOutputDisableOnAgcTrig = 0
                  AtomChannelOutputControl = DONT_ENABLE_CHANNEL_OUTPUT
                  AtomChannelOutputSignalLevel = LOW
                  AtomChannelPortPinSelect = TOUT17_SELC_PORT0_PIN8
                AtomChannelTimerParameters:
                  AtomChEnableForceUpdate = 0
                  AtomChResetCn0OnForceUpdate = 0
                  AtomChShadowCompareValSr0 = 0
                  AtomChShadowCompareValSr1 = 0
                  AtomChSomcCompareStrategy = TIMEBASE_GREATER_EQUAL_TO_CMx
                  AtomChSomcTimebaseForComparison = TBU_TS1
                  AtomChUpdateEnableOnCn0Reset = 0
                  AtomChannelClockSelect = GTM_CONFIGURABLE_CLOCK_0
                  AtomChannelCompareValueCm0 = 0
                  AtomChannelCompareValueCm1 = 0
                  AtomChannelCounterCn0Reset = ON_COMPARE_MATCH_ON_CHANNEL
                  AtomChannelCounterValCn0 = 0
                  AtomChannelModeSelect = ATOM_SIG_OUTPUT_MODE_IMMEDIATE
                  AtomChannelOneShotMode = 0
                  AtomChannelTriggerOutput = TRIG_FROM_PREVIOUS_CHANNEL
                  AtomModeControlBits = 0
                  AtomServeLastAruCommStrategy = 0
                AtomChannelUsage: AtomChannelUsage=USED_BY_OTHER_DRIVERS_OR_UNUSED
            AtomTriggerForAgc
              AtomAgcInternalTriggerSelect:
                AtomAgcIntTriggerFromChannel{0..7} = 0
              AtomAgcTriggerByTimebase: AtomAgcTbuTimebaseSelect=TBU_TS0_TIMEBASE, AtomAgcTimeBaseTriggerEnable=0, AtomAgcTimebaseMatchValue=0
          Atom_1
            8 x AtomChannel:
              AtomChannel_0
                AtomChannelAruConfiguration: AtomChAruBlockingMode=GTM_ABM_DISABLED, AtomChAruReadAddress0=510, AtomChAruReadAddress1=510, AtomChannelAruEnable=0, AtomChannelCpuWriteRequest=0
                AtomChannelEnable: AtomChDisableOnAgcTrigger=0, AtomChannelEnable=AT_START
                AtomChannelInterrupt:
                  AtomCcu0Notification = NULL_PTR
                  AtomCcu1Notification = NULL_PTR
                  AtomGlobalCcuSel = 0
                  AtomIntEnableOnCcu0Trigger = 0
                  AtomIntEnableOnCcu1Trigger = 0
                  AtomInterruptMode = GTM_INTERRUPT_LEVEL_MODE
                  AtomNotification = NULL_PTR
                AtomChannelOutput:
                  AtomChOutputDisableOnAgcTrig = 0
                  AtomChannelOutputControl = DONT_ENABLE_CHANNEL_OUTPUT
                  AtomChannelOutputSignalLevel = LOW
                  AtomChannelPortPinSelect = TOUT9_SELD_PORT0_PIN0
                AtomChannelTimerParameters:
                  AtomChEnableForceUpdate = 0
                  AtomChResetCn0OnForceUpdate = 0
                  AtomChShadowCompareValSr0 = 0
                  AtomChShadowCompareValSr1 = 0
                  AtomChSomcCompareStrategy = TIMEBASE_GREATER_EQUAL_TO_CMx
                  AtomChSomcTimebaseForComparison = TBU_TS1
                  AtomChUpdateEnableOnCn0Reset = 0
                  AtomChannelClockSelect = GTM_CONFIGURABLE_CLOCK_0
                  AtomChannelCompareValueCm0 = 0
                  AtomChannelCompareValueCm1 = 0
                  AtomChannelCounterCn0Reset = ON_COMPARE_MATCH_ON_CHANNEL
                  AtomChannelCounterValCn0 = 0
                  AtomChannelModeSelect = ATOM_SIG_OUTPUT_MODE_IMMEDIATE
                  AtomChannelOneShotMode = 0
                  AtomChannelTriggerOutput = TRIG_FROM_PREVIOUS_CHANNEL
                  AtomModeControlBits = 0
                  AtomServeLastAruCommStrategy = 0
                AtomChannelUsage: AtomChannelUsage=USED_BY_OTHER_DRIVERS_OR_UNUSED
              AtomChannel_1
                AtomChannelAruConfiguration: AtomChAruBlockingMode=GTM_ABM_DISABLED, AtomChAruReadAddress0=510, AtomChAruReadAddress1=510, AtomChannelAruEnable=0, AtomChannelCpuWriteRequest=0
                AtomChannelEnable: AtomChDisableOnAgcTrigger=0, AtomChannelEnable=AT_START
                AtomChannelInterrupt:
                  AtomCcu0Notification = NULL_PTR
                  AtomCcu1Notification = NULL_PTR
                  AtomGlobalCcuSel = 0
                  AtomIntEnableOnCcu0Trigger = 0
                  AtomIntEnableOnCcu1Trigger = 0
                  AtomInterruptMode = GTM_INTERRUPT_LEVEL_MODE
                  AtomNotification = NULL_PTR
                AtomChannelOutput:
                  AtomChOutputDisableOnAgcTrig = 0
                  AtomChannelOutputControl = DONT_ENABLE_CHANNEL_OUTPUT
                  AtomChannelOutputSignalLevel = LOW
                  AtomChannelPortPinSelect = TOUT10_SELD_PORT0_PIN1
                AtomChannelTimerParameters:
                  AtomChEnableForceUpdate = 0
                  AtomChResetCn0OnForceUpdate = 0
                  AtomChShadowCompareValSr0 = 0
                  AtomChShadowCompareValSr1 = 0
                  AtomChSomcCompareStrategy = TIMEBASE_GREATER_EQUAL_TO_CMx
                  AtomChSomcTimebaseForComparison = TBU_TS1
                  AtomChUpdateEnableOnCn0Reset = 0
                  AtomChannelClockSelect = GTM_CONFIGURABLE_CLOCK_0
                  AtomChannelCompareValueCm0 = 0
                  AtomChannelCompareValueCm1 = 0
                  AtomChannelCounterCn0Reset = ON_COMPARE_MATCH_ON_CHANNEL
                  AtomChannelCounterValCn0 = 0
                  AtomChannelModeSelect = ATOM_SIG_OUTPUT_MODE_IMMEDIATE
                  AtomChannelOneShotMode = 0
                  AtomChannelTriggerOutput = TRIG_FROM_PREVIOUS_CHANNEL
                  AtomModeControlBits = 0
                  AtomServeLastAruCommStrategy = 0
                AtomChannelUsage: AtomChannelUsage=USED_BY_OTHER_DRIVERS_OR_UNUSED
              AtomChannel_2
                AtomChannelAruConfiguration: AtomChAruBlockingMode=GTM_ABM_DISABLED, AtomChAruReadAddress0=510, AtomChAruReadAddress1=510, AtomChannelAruEnable=0, AtomChannelCpuWriteRequest=0
                AtomChannelEnable: AtomChDisableOnAgcTrigger=0, AtomChannelEnable=AT_START
                AtomChannelInterrupt:
                  AtomCcu0Notification = NULL_PTR
                  AtomCcu1Notification = NULL_PTR
                  AtomGlobalCcuSel = 0
                  AtomIntEnableOnCcu0Trigger = 0
                  AtomIntEnableOnCcu1Trigger = 0
                  AtomInterruptMode = GTM_INTERRUPT_LEVEL_MODE
                  AtomNotification = NULL_PTR
                AtomChannelOutput:
                  AtomChOutputDisableOnAgcTrig = 0
                  AtomChannelOutputControl = DONT_ENABLE_CHANNEL_OUTPUT
                  AtomChannelOutputSignalLevel = LOW
                  AtomChannelPortPinSelect = TOUT12_SELD_PORT0_PIN3
                AtomChannelTimerParameters:
                  AtomChEnableForceUpdate = 0
                  AtomChResetCn0OnForceUpdate = 0
                  AtomChShadowCompareValSr0 = 0
                  AtomChShadowCompareValSr1 = 0
                  AtomChSomcCompareStrategy = TIMEBASE_GREATER_EQUAL_TO_CMx
                  AtomChSomcTimebaseForComparison = TBU_TS1
                  AtomChUpdateEnableOnCn0Reset = 0
                  AtomChannelClockSelect = GTM_CONFIGURABLE_CLOCK_0
                  AtomChannelCompareValueCm0 = 0
                  AtomChannelCompareValueCm1 = 0
                  AtomChannelCounterCn0Reset = ON_COMPARE_MATCH_ON_CHANNEL
                  AtomChannelCounterValCn0 = 0
                  AtomChannelModeSelect = ATOM_SIG_OUTPUT_MODE_IMMEDIATE
                  AtomChannelOneShotMode = 0
                  AtomChannelTriggerOutput = TRIG_FROM_PREVIOUS_CHANNEL
                  AtomModeControlBits = 0
                  AtomServeLastAruCommStrategy = 0
                AtomChannelUsage: AtomChannelUsage=USED_BY_OTHER_DRIVERS_OR_UNUSED
              AtomChannel_3
                AtomChannelAruConfiguration: AtomChAruBlockingMode=GTM_ABM_DISABLED, AtomChAruReadAddress0=510, AtomChAruReadAddress1=510, AtomChannelAruEnable=0, AtomChannelCpuWriteRequest=0
                AtomChannelEnable: AtomChDisableOnAgcTrigger=0, AtomChannelEnable=AT_START
                AtomChannelInterrupt:
                  AtomCcu0Notification = NULL_PTR
                  AtomCcu1Notification = NULL_PTR
                  AtomGlobalCcuSel = 0
                  AtomIntEnableOnCcu0Trigger = 0
                  AtomIntEnableOnCcu1Trigger = 0
                  AtomInterruptMode = GTM_INTERRUPT_LEVEL_MODE
                  AtomNotification = NULL_PTR
                AtomChannelOutput:
                  AtomChOutputDisableOnAgcTrig = 0
                  AtomChannelOutputControl = DONT_ENABLE_CHANNEL_OUTPUT
                  AtomChannelOutputSignalLevel = LOW
                  AtomChannelPortPinSelect = TOUT13_SELD_PORT0_PIN4
                AtomChannelTimerParameters:
                  AtomChEnableForceUpdate = 0
                  AtomChResetCn0OnForceUpdate = 0
                  AtomChShadowCompareValSr0 = 0
                  AtomChShadowCompareValSr1 = 0
                  AtomChSomcCompareStrategy = TIMEBASE_GREATER_EQUAL_TO_CMx
                  AtomChSomcTimebaseForComparison = TBU_TS1
                  AtomChUpdateEnableOnCn0Reset = 0
                  AtomChannelClockSelect = GTM_CONFIGURABLE_CLOCK_0
                  AtomChannelCompareValueCm0 = 0
                  AtomChannelCompareValueCm1 = 0
                  AtomChannelCounterCn0Reset = ON_COMPARE_MATCH_ON_CHANNEL
                  AtomChannelCounterValCn0 = 0
                  AtomChannelModeSelect = ATOM_SIG_OUTPUT_MODE_IMMEDIATE
                  AtomChannelOneShotMode = 0
                  AtomChannelTriggerOutput = TRIG_FROM_PREVIOUS_CHANNEL
                  AtomModeControlBits = 0
                  AtomServeLastAruCommStrategy = 0
                AtomChannelUsage: AtomChannelUsage=USED_BY_OTHER_DRIVERS_OR_UNUSED
              AtomChannel_4
                AtomChannelAruConfiguration: AtomChAruBlockingMode=GTM_ABM_DISABLED, AtomChAruReadAddress0=510, AtomChAruReadAddress1=510, AtomChannelAruEnable=0, AtomChannelCpuWriteRequest=0
                AtomChannelEnable: AtomChDisableOnAgcTrigger=0, AtomChannelEnable=AT_START
                AtomChannelInterrupt:
                  AtomCcu0Notification = NULL_PTR
                  AtomCcu1Notification = NULL_PTR
                  AtomGlobalCcuSel = 0
                  AtomIntEnableOnCcu0Trigger = 0
                  AtomIntEnableOnCcu1Trigger = 0
                  AtomInterruptMode = GTM_INTERRUPT_LEVEL_MODE
                  AtomNotification = NULL_PTR
                AtomChannelOutput:
                  AtomChOutputDisableOnAgcTrig = 0
                  AtomChannelOutputControl = DONT_ENABLE_CHANNEL_OUTPUT
                  AtomChannelOutputSignalLevel = LOW
                  AtomChannelPortPinSelect = TOUT14_SELD_PORT0_PIN5
                AtomChannelTimerParameters:
                  AtomChEnableForceUpdate = 0
                  AtomChResetCn0OnForceUpdate = 0
                  AtomChShadowCompareValSr0 = 0
                  AtomChShadowCompareValSr1 = 0
                  AtomChSomcCompareStrategy = TIMEBASE_GREATER_EQUAL_TO_CMx
                  AtomChSomcTimebaseForComparison = TBU_TS1
                  AtomChUpdateEnableOnCn0Reset = 0
                  AtomChannelClockSelect = GTM_CONFIGURABLE_CLOCK_0
                  AtomChannelCompareValueCm0 = 0
                  AtomChannelCompareValueCm1 = 0
                  AtomChannelCounterCn0Reset = ON_COMPARE_MATCH_ON_CHANNEL
                  AtomChannelCounterValCn0 = 0
                  AtomChannelModeSelect = ATOM_SIG_OUTPUT_MODE_IMMEDIATE
                  AtomChannelOneShotMode = 0
                  AtomChannelTriggerOutput = TRIG_FROM_PREVIOUS_CHANNEL
                  AtomModeControlBits = 0
                  AtomServeLastAruCommStrategy = 0
                AtomChannelUsage: AtomChannelUsage=USED_BY_OTHER_DRIVERS_OR_UNUSED
              AtomChannel_5
                AtomChannelAruConfiguration: AtomChAruBlockingMode=GTM_ABM_DISABLED, AtomChAruReadAddress0=510, AtomChAruReadAddress1=510, AtomChannelAruEnable=0, AtomChannelCpuWriteRequest=0
                AtomChannelEnable: AtomChDisableOnAgcTrigger=0, AtomChannelEnable=AT_START
                AtomChannelInterrupt:
                  AtomCcu0Notification = NULL_PTR
                  AtomCcu1Notification = NULL_PTR
                  AtomGlobalCcuSel = 0
                  AtomIntEnableOnCcu0Trigger = 0
                  AtomIntEnableOnCcu1Trigger = 0
                  AtomInterruptMode = GTM_INTERRUPT_LEVEL_MODE
                  AtomNotification = NULL_PTR
                AtomChannelOutput:
                  AtomChOutputDisableOnAgcTrig = 0
                  AtomChannelOutputControl = DONT_ENABLE_CHANNEL_OUTPUT
                  AtomChannelOutputSignalLevel = LOW
                  AtomChannelPortPinSelect = TOUT15_SELD_PORT0_PIN6
                AtomChannelTimerParameters:
                  AtomChEnableForceUpdate = 0
                  AtomChResetCn0OnForceUpdate = 0
                  AtomChShadowCompareValSr0 = 0
                  AtomChShadowCompareValSr1 = 0
                  AtomChSomcCompareStrategy = TIMEBASE_GREATER_EQUAL_TO_CMx
                  AtomChSomcTimebaseForComparison = TBU_TS1
                  AtomChUpdateEnableOnCn0Reset = 0
                  AtomChannelClockSelect = GTM_CONFIGURABLE_CLOCK_0
                  AtomChannelCompareValueCm0 = 0
                  AtomChannelCompareValueCm1 = 0
                  AtomChannelCounterCn0Reset = ON_COMPARE_MATCH_ON_CHANNEL
                  AtomChannelCounterValCn0 = 0
                  AtomChannelModeSelect = ATOM_SIG_OUTPUT_MODE_IMMEDIATE
                  AtomChannelOneShotMode = 0
                  AtomChannelTriggerOutput = TRIG_FROM_PREVIOUS_CHANNEL
                  AtomModeControlBits = 0
                  AtomServeLastAruCommStrategy = 0
                AtomChannelUsage: AtomChannelUsage=USED_BY_OTHER_DRIVERS_OR_UNUSED
              AtomChannel_6
                AtomChannelAruConfiguration: AtomChAruBlockingMode=GTM_ABM_DISABLED, AtomChAruReadAddress0=510, AtomChAruReadAddress1=510, AtomChannelAruEnable=0, AtomChannelCpuWriteRequest=0
                AtomChannelEnable: AtomChDisableOnAgcTrigger=0, AtomChannelEnable=AT_START
                AtomChannelInterrupt:
                  AtomCcu0Notification = NULL_PTR
                  AtomCcu1Notification = NULL_PTR
                  AtomGlobalCcuSel = 0
                  AtomIntEnableOnCcu0Trigger = 0
                  AtomIntEnableOnCcu1Trigger = 0
                  AtomInterruptMode = GTM_INTERRUPT_LEVEL_MODE
                  AtomNotification = NULL_PTR
                AtomChannelOutput:
                  AtomChOutputDisableOnAgcTrig = 0
                  AtomChannelOutputControl = DONT_ENABLE_CHANNEL_OUTPUT
                  AtomChannelOutputSignalLevel = LOW
                  AtomChannelPortPinSelect = TOUT16_SELD_PORT0_PIN7
                AtomChannelTimerParameters:
                  AtomChEnableForceUpdate = 0
                  AtomChResetCn0OnForceUpdate = 0
                  AtomChShadowCompareValSr0 = 0
                  AtomChShadowCompareValSr1 = 0
                  AtomChSomcCompareStrategy = TIMEBASE_GREATER_EQUAL_TO_CMx
                  AtomChSomcTimebaseForComparison = TBU_TS1
                  AtomChUpdateEnableOnCn0Reset = 0
                  AtomChannelClockSelect = GTM_CONFIGURABLE_CLOCK_0
                  AtomChannelCompareValueCm0 = 0
                  AtomChannelCompareValueCm1 = 0
                  AtomChannelCounterCn0Reset = ON_COMPARE_MATCH_ON_CHANNEL
                  AtomChannelCounterValCn0 = 0
                  AtomChannelModeSelect = ATOM_SIG_OUTPUT_MODE_IMMEDIATE
                  AtomChannelOneShotMode = 0
                  AtomChannelTriggerOutput = TRIG_FROM_PREVIOUS_CHANNEL
                  AtomModeControlBits = 0
                  AtomServeLastAruCommStrategy = 0
                AtomChannelUsage: AtomChannelUsage=USED_BY_OTHER_DRIVERS_OR_UNUSED
              AtomChannel_7
                AtomChannelAruConfiguration: AtomChAruBlockingMode=GTM_ABM_DISABLED, AtomChAruReadAddress0=510, AtomChAruReadAddress1=510, AtomChannelAruEnable=0, AtomChannelCpuWriteRequest=0
                AtomChannelEnable: AtomChDisableOnAgcTrigger=0, AtomChannelEnable=AT_START
                AtomChannelInterrupt:
                  AtomCcu0Notification = NULL_PTR
                  AtomCcu1Notification = NULL_PTR
                  AtomGlobalCcuSel = 0
                  AtomIntEnableOnCcu0Trigger = 0
                  AtomIntEnableOnCcu1Trigger = 0
                  AtomInterruptMode = GTM_INTERRUPT_LEVEL_MODE
                  AtomNotification = NULL_PTR
                AtomChannelOutput:
                  AtomChOutputDisableOnAgcTrig = 0
                  AtomChannelOutputControl = DONT_ENABLE_CHANNEL_OUTPUT
                  AtomChannelOutputSignalLevel = LOW
                  AtomChannelPortPinSelect = TOUT17_SELD_PORT0_PIN8
                AtomChannelTimerParameters:
                  AtomChEnableForceUpdate = 0
                  AtomChResetCn0OnForceUpdate = 0
                  AtomChShadowCompareValSr0 = 0
                  AtomChShadowCompareValSr1 = 0
                  AtomChSomcCompareStrategy = TIMEBASE_GREATER_EQUAL_TO_CMx
                  AtomChSomcTimebaseForComparison = TBU_TS1
                  AtomChUpdateEnableOnCn0Reset = 0
                  AtomChannelClockSelect = GTM_CONFIGURABLE_CLOCK_0
                  AtomChannelCompareValueCm0 = 0
                  AtomChannelCompareValueCm1 = 0
                  AtomChannelCounterCn0Reset = ON_COMPARE_MATCH_ON_CHANNEL
                  AtomChannelCounterValCn0 = 0
                  AtomChannelModeSelect = ATOM_SIG_OUTPUT_MODE_IMMEDIATE
                  AtomChannelOneShotMode = 0
                  AtomChannelTriggerOutput = TRIG_FROM_PREVIOUS_CHANNEL
                  AtomModeControlBits = 0
                  AtomServeLastAruCommStrategy = 0
                AtomChannelUsage: AtomChannelUsage=USED_BY_OTHER_DRIVERS_OR_UNUSED
            AtomTriggerForAgc
              AtomAgcInternalTriggerSelect:
                AtomAgcIntTriggerFromChannel{0..7} = 0
              AtomAgcTriggerByTimebase: AtomAgcTbuTimebaseSelect=TBU_TS0_TIMEBASE, AtomAgcTimeBaseTriggerEnable=0, AtomAgcTimebaseMatchValue=0
          Atom_2
            8 x AtomChannel:
              AtomChannel_0
                AtomChannelAruConfiguration: AtomChAruBlockingMode=GTM_ABM_DISABLED, AtomChAruReadAddress0=510, AtomChAruReadAddress1=510, AtomChannelAruEnable=0, AtomChannelCpuWriteRequest=0
                AtomChannelEnable: AtomChDisableOnAgcTrigger=0, AtomChannelEnable=AT_START
                AtomChannelInterrupt:
                  AtomCcu0Notification = NULL_PTR
                  AtomCcu1Notification = NULL_PTR
                  AtomGlobalCcuSel = 0
                  AtomIntEnableOnCcu0Trigger = 0
                  AtomIntEnableOnCcu1Trigger = 0
                  AtomInterruptMode = GTM_INTERRUPT_LEVEL_MODE
                  AtomNotification = NULL_PTR
                AtomChannelOutput:
                  AtomChOutputDisableOnAgcTrig = 0
                  AtomChannelOutputControl = DONT_ENABLE_CHANNEL_OUTPUT
                  AtomChannelOutputSignalLevel = LOW
                  AtomChannelPortPinSelect = TOUT18_SELC_PORT0_PIN9
                AtomChannelTimerParameters:
                  AtomChEnableForceUpdate = 0
                  AtomChResetCn0OnForceUpdate = 0
                  AtomChShadowCompareValSr0 = 0
                  AtomChShadowCompareValSr1 = 0
                  AtomChSomcCompareStrategy = TIMEBASE_GREATER_EQUAL_TO_CMx
                  AtomChSomcTimebaseForComparison = TBU_TS1
                  AtomChUpdateEnableOnCn0Reset = 0
                  AtomChannelClockSelect = GTM_CONFIGURABLE_CLOCK_0
                  AtomChannelCompareValueCm0 = 0
                  AtomChannelCompareValueCm1 = 0
                  AtomChannelCounterCn0Reset = ON_COMPARE_MATCH_ON_CHANNEL
                  AtomChannelCounterValCn0 = 0
                  AtomChannelModeSelect = ATOM_SIG_OUTPUT_MODE_IMMEDIATE
                  AtomChannelOneShotMode = 0
                  AtomChannelTriggerOutput = TRIG_FROM_PREVIOUS_CHANNEL
                  AtomModeControlBits = 0
                  AtomServeLastAruCommStrategy = 0
                AtomChannelUsage: AtomChannelUsage=USED_BY_OTHER_DRIVERS_OR_UNUSED
              AtomChannel_1
                AtomChannelAruConfiguration: AtomChAruBlockingMode=GTM_ABM_DISABLED, AtomChAruReadAddress0=510, AtomChAruReadAddress1=510, AtomChannelAruEnable=0, AtomChannelCpuWriteRequest=0
                AtomChannelEnable: AtomChDisableOnAgcTrigger=0, AtomChannelEnable=AT_START
                AtomChannelInterrupt:
                  AtomCcu0Notification = NULL_PTR
                  AtomCcu1Notification = NULL_PTR
                  AtomGlobalCcuSel = 0
                  AtomIntEnableOnCcu0Trigger = 0
                  AtomIntEnableOnCcu1Trigger = 0
                  AtomInterruptMode = GTM_INTERRUPT_LEVEL_MODE
                  AtomNotification = NULL_PTR
                AtomChannelOutput:
                  AtomChOutputDisableOnAgcTrig = 0
                  AtomChannelOutputControl = DONT_ENABLE_CHANNEL_OUTPUT
                  AtomChannelOutputSignalLevel = LOW
                  AtomChannelPortPinSelect = TOUT19_SELC_PORT0_PIN10
                AtomChannelTimerParameters:
                  AtomChEnableForceUpdate = 0
                  AtomChResetCn0OnForceUpdate = 0
                  AtomChShadowCompareValSr0 = 0
                  AtomChShadowCompareValSr1 = 0
                  AtomChSomcCompareStrategy = TIMEBASE_GREATER_EQUAL_TO_CMx
                  AtomChSomcTimebaseForComparison = TBU_TS1
                  AtomChUpdateEnableOnCn0Reset = 0
                  AtomChannelClockSelect = GTM_CONFIGURABLE_CLOCK_0
                  AtomChannelCompareValueCm0 = 0
                  AtomChannelCompareValueCm1 = 0
                  AtomChannelCounterCn0Reset = ON_COMPARE_MATCH_ON_CHANNEL
                  AtomChannelCounterValCn0 = 0
                  AtomChannelModeSelect = ATOM_SIG_OUTPUT_MODE_IMMEDIATE
                  AtomChannelOneShotMode = 0
                  AtomChannelTriggerOutput = TRIG_FROM_PREVIOUS_CHANNEL
                  AtomModeControlBits = 0
                  AtomServeLastAruCommStrategy = 0
                AtomChannelUsage: AtomChannelUsage=USED_BY_OTHER_DRIVERS_OR_UNUSED
              AtomChannel_2
                AtomChannelAruConfiguration: AtomChAruBlockingMode=GTM_ABM_DISABLED, AtomChAruReadAddress0=510, AtomChAruReadAddress1=510, AtomChannelAruEnable=0, AtomChannelCpuWriteRequest=0
                AtomChannelEnable: AtomChDisableOnAgcTrigger=0, AtomChannelEnable=AT_START
                AtomChannelInterrupt:
                  AtomCcu0Notification = NULL_PTR
                  AtomCcu1Notification = NULL_PTR
                  AtomGlobalCcuSel = 0
                  AtomIntEnableOnCcu0Trigger = 0
                  AtomIntEnableOnCcu1Trigger = 0
                  AtomInterruptMode = GTM_INTERRUPT_LEVEL_MODE
                  AtomNotification = NULL_PTR
                AtomChannelOutput:
                  AtomChOutputDisableOnAgcTrig = 0
                  AtomChannelOutputControl = DONT_ENABLE_CHANNEL_OUTPUT
                  AtomChannelOutputSignalLevel = LOW
                  AtomChannelPortPinSelect = TOUT20_SELC_PORT0_PIN11
                AtomChannelTimerParameters:
                  AtomChEnableForceUpdate = 0
                  AtomChResetCn0OnForceUpdate = 0
                  AtomChShadowCompareValSr0 = 0
                  AtomChShadowCompareValSr1 = 0
                  AtomChSomcCompareStrategy = TIMEBASE_GREATER_EQUAL_TO_CMx
                  AtomChSomcTimebaseForComparison = TBU_TS1
                  AtomChUpdateEnableOnCn0Reset = 0
                  AtomChannelClockSelect = GTM_CONFIGURABLE_CLOCK_0
                  AtomChannelCompareValueCm0 = 0
                  AtomChannelCompareValueCm1 = 0
                  AtomChannelCounterCn0Reset = ON_COMPARE_MATCH_ON_CHANNEL
                  AtomChannelCounterValCn0 = 0
                  AtomChannelModeSelect = ATOM_SIG_OUTPUT_MODE_IMMEDIATE
                  AtomChannelOneShotMode = 0
                  AtomChannelTriggerOutput = TRIG_FROM_PREVIOUS_CHANNEL
                  AtomModeControlBits = 0
                  AtomServeLastAruCommStrategy = 0
                AtomChannelUsage: AtomChannelUsage=USED_BY_OTHER_DRIVERS_OR_UNUSED
              AtomChannel_3
                AtomChannelAruConfiguration: AtomChAruBlockingMode=GTM_ABM_DISABLED, AtomChAruReadAddress0=510, AtomChAruReadAddress1=510, AtomChannelAruEnable=0, AtomChannelCpuWriteRequest=0
                AtomChannelEnable: AtomChDisableOnAgcTrigger=0, AtomChannelEnable=AT_START
                AtomChannelInterrupt:
                  AtomCcu0Notification = NULL_PTR
                  AtomCcu1Notification = NULL_PTR
                  AtomGlobalCcuSel = 0
                  AtomIntEnableOnCcu0Trigger = 0
                  AtomIntEnableOnCcu1Trigger = 0
                  AtomInterruptMode = GTM_INTERRUPT_LEVEL_MODE
                  AtomNotification = NULL_PTR
                AtomChannelOutput:
                  AtomChOutputDisableOnAgcTrig = 0
                  AtomChannelOutputControl = DONT_ENABLE_CHANNEL_OUTPUT
                  AtomChannelOutputSignalLevel = LOW
                  AtomChannelPortPinSelect = TOUT21_SELC_PORT0_PIN12
                AtomChannelTimerParameters:
                  AtomChEnableForceUpdate = 0
                  AtomChResetCn0OnForceUpdate = 0
                  AtomChShadowCompareValSr0 = 0
                  AtomChShadowCompareValSr1 = 0
                  AtomChSomcCompareStrategy = TIMEBASE_GREATER_EQUAL_TO_CMx
                  AtomChSomcTimebaseForComparison = TBU_TS1
                  AtomChUpdateEnableOnCn0Reset = 0
                  AtomChannelClockSelect = GTM_CONFIGURABLE_CLOCK_0
                  AtomChannelCompareValueCm0 = 0
                  AtomChannelCompareValueCm1 = 0
                  AtomChannelCounterCn0Reset = ON_COMPARE_MATCH_ON_CHANNEL
                  AtomChannelCounterValCn0 = 0
                  AtomChannelModeSelect = ATOM_SIG_OUTPUT_MODE_IMMEDIATE
                  AtomChannelOneShotMode = 0
                  AtomChannelTriggerOutput = TRIG_FROM_PREVIOUS_CHANNEL
                  AtomModeControlBits = 0
                  AtomServeLastAruCommStrategy = 0
                AtomChannelUsage: AtomChannelUsage=USED_BY_OTHER_DRIVERS_OR_UNUSED
              AtomChannel_4
                AtomChannelAruConfiguration: AtomChAruBlockingMode=GTM_ABM_DISABLED, AtomChAruReadAddress0=510, AtomChAruReadAddress1=510, AtomChannelAruEnable=0, AtomChannelCpuWriteRequest=0
                AtomChannelEnable: AtomChDisableOnAgcTrigger=0, AtomChannelEnable=AT_START
                AtomChannelInterrupt:
                  AtomCcu0Notification = NULL_PTR
                  AtomCcu1Notification = NULL_PTR
                  AtomGlobalCcuSel = 0
                  AtomIntEnableOnCcu0Trigger = 0
                  AtomIntEnableOnCcu1Trigger = 0
                  AtomInterruptMode = GTM_INTERRUPT_LEVEL_MODE
                  AtomNotification = NULL_PTR
                AtomChannelOutput:
                  AtomChOutputDisableOnAgcTrig = 0
                  AtomChannelOutputControl = DONT_ENABLE_CHANNEL_OUTPUT
                  AtomChannelOutputSignalLevel = LOW
                  AtomChannelPortPinSelect = TOUT98_SELC_PORT11_PIN9
                AtomChannelTimerParameters:
                  AtomChEnableForceUpdate = 0
                  AtomChResetCn0OnForceUpdate = 0
                  AtomChShadowCompareValSr0 = 0
                  AtomChShadowCompareValSr1 = 0
                  AtomChSomcCompareStrategy = TIMEBASE_GREATER_EQUAL_TO_CMx
                  AtomChSomcTimebaseForComparison = TBU_TS1
                  AtomChUpdateEnableOnCn0Reset = 0
                  AtomChannelClockSelect = GTM_CONFIGURABLE_CLOCK_0
                  AtomChannelCompareValueCm0 = 0
                  AtomChannelCompareValueCm1 = 0
                  AtomChannelCounterCn0Reset = ON_COMPARE_MATCH_ON_CHANNEL
                  AtomChannelCounterValCn0 = 0
                  AtomChannelModeSelect = ATOM_SIG_OUTPUT_MODE_IMMEDIATE
                  AtomChannelOneShotMode = 0
                  AtomChannelTriggerOutput = TRIG_FROM_PREVIOUS_CHANNEL
                  AtomModeControlBits = 0
                  AtomServeLastAruCommStrategy = 0
                AtomChannelUsage: AtomChannelUsage=USED_BY_OTHER_DRIVERS_OR_UNUSED
              AtomChannel_5
                AtomChannelAruConfiguration: AtomChAruBlockingMode=GTM_ABM_DISABLED, AtomChAruReadAddress0=510, AtomChAruReadAddress1=510, AtomChannelAruEnable=0, AtomChannelCpuWriteRequest=0
                AtomChannelEnable: AtomChDisableOnAgcTrigger=0, AtomChannelEnable=AT_START
                AtomChannelInterrupt:
                  AtomCcu0Notification = NULL_PTR
                  AtomCcu1Notification = NULL_PTR
                  AtomGlobalCcuSel = 0
                  AtomIntEnableOnCcu0Trigger = 0
                  AtomIntEnableOnCcu1Trigger = 0
                  AtomInterruptMode = GTM_INTERRUPT_LEVEL_MODE
                  AtomNotification = NULL_PTR
                AtomChannelOutput:
                  AtomChOutputDisableOnAgcTrig = 0
                  AtomChannelOutputControl = DONT_ENABLE_CHANNEL_OUTPUT
                  AtomChannelOutputSignalLevel = LOW
                  AtomChannelPortPinSelect = TOUT99_SELC_PORT11_PIN10
                AtomChannelTimerParameters:
                  AtomChEnableForceUpdate = 0
                  AtomChResetCn0OnForceUpdate = 0
                  AtomChShadowCompareValSr0 = 0
                  AtomChShadowCompareValSr1 = 0
                  AtomChSomcCompareStrategy = TIMEBASE_GREATER_EQUAL_TO_CMx
                  AtomChSomcTimebaseForComparison = TBU_TS1
                  AtomChUpdateEnableOnCn0Reset = 0
                  AtomChannelClockSelect = GTM_CONFIGURABLE_CLOCK_0
                  AtomChannelCompareValueCm0 = 0
                  AtomChannelCompareValueCm1 = 0
                  AtomChannelCounterCn0Reset = ON_COMPARE_MATCH_ON_CHANNEL
                  AtomChannelCounterValCn0 = 0
                  AtomChannelModeSelect = ATOM_SIG_OUTPUT_MODE_IMMEDIATE
                  AtomChannelOneShotMode = 0
                  AtomChannelTriggerOutput = TRIG_FROM_PREVIOUS_CHANNEL
                  AtomModeControlBits = 0
                  AtomServeLastAruCommStrategy = 0
                AtomChannelUsage: AtomChannelUsage=USED_BY_OTHER_DRIVERS_OR_UNUSED
              AtomChannel_6
                AtomChannelAruConfiguration: AtomChAruBlockingMode=GTM_ABM_DISABLED, AtomChAruReadAddress0=510, AtomChAruReadAddress1=510, AtomChannelAruEnable=0, AtomChannelCpuWriteRequest=0
                AtomChannelEnable: AtomChDisableOnAgcTrigger=0, AtomChannelEnable=AT_START
                AtomChannelInterrupt:
                  AtomCcu0Notification = NULL_PTR
                  AtomCcu1Notification = NULL_PTR
                  AtomGlobalCcuSel = 0
                  AtomIntEnableOnCcu0Trigger = 0
                  AtomIntEnableOnCcu1Trigger = 0
                  AtomInterruptMode = GTM_INTERRUPT_LEVEL_MODE
                  AtomNotification = NULL_PTR
                AtomChannelOutput:
                  AtomChOutputDisableOnAgcTrig = 0
                  AtomChannelOutputControl = DONT_ENABLE_CHANNEL_OUTPUT
                  AtomChannelOutputSignalLevel = LOW
                  AtomChannelPortPinSelect = TOUT100_SELC_PORT11_PIN11
                AtomChannelTimerParameters:
                  AtomChEnableForceUpdate = 0
                  AtomChResetCn0OnForceUpdate = 0
                  AtomChShadowCompareValSr0 = 0
                  AtomChShadowCompareValSr1 = 0
                  AtomChSomcCompareStrategy = TIMEBASE_GREATER_EQUAL_TO_CMx
                  AtomChSomcTimebaseForComparison = TBU_TS1
                  AtomChUpdateEnableOnCn0Reset = 0
                  AtomChannelClockSelect = GTM_CONFIGURABLE_CLOCK_0
                  AtomChannelCompareValueCm0 = 0
                  AtomChannelCompareValueCm1 = 0
                  AtomChannelCounterCn0Reset = ON_COMPARE_MATCH_ON_CHANNEL
                  AtomChannelCounterValCn0 = 0
                  AtomChannelModeSelect = ATOM_SIG_OUTPUT_MODE_IMMEDIATE
                  AtomChannelOneShotMode = 0
                  AtomChannelTriggerOutput = TRIG_FROM_PREVIOUS_CHANNEL
                  AtomModeControlBits = 0
                  AtomServeLastAruCommStrategy = 0
                AtomChannelUsage: AtomChannelUsage=USED_BY_OTHER_DRIVERS_OR_UNUSED
              AtomChannel_7
                AtomChannelAruConfiguration: AtomChAruBlockingMode=GTM_ABM_DISABLED, AtomChAruReadAddress0=510, AtomChAruReadAddress1=510, AtomChannelAruEnable=0, AtomChannelCpuWriteRequest=0
                AtomChannelEnable: AtomChDisableOnAgcTrigger=0, AtomChannelEnable=AT_START
                AtomChannelInterrupt:
                  AtomCcu0Notification = NULL_PTR
                  AtomCcu1Notification = NULL_PTR
                  AtomGlobalCcuSel = 0
                  AtomIntEnableOnCcu0Trigger = 0
                  AtomIntEnableOnCcu1Trigger = 0
                  AtomInterruptMode = GTM_INTERRUPT_LEVEL_MODE
                  AtomNotification = NULL_PTR
                AtomChannelOutput:
                  AtomChOutputDisableOnAgcTrig = 0
                  AtomChannelOutputControl = DONT_ENABLE_CHANNEL_OUTPUT
                  AtomChannelOutputSignalLevel = LOW
                  AtomChannelPortPinSelect = TOUT101_SELC_PORT11_PIN12
                AtomChannelTimerParameters:
                  AtomChEnableForceUpdate = 0
                  AtomChResetCn0OnForceUpdate = 0
                  AtomChShadowCompareValSr0 = 0
                  AtomChShadowCompareValSr1 = 0
                  AtomChSomcCompareStrategy = TIMEBASE_GREATER_EQUAL_TO_CMx
                  AtomChSomcTimebaseForComparison = TBU_TS1
                  AtomChUpdateEnableOnCn0Reset = 0
                  AtomChannelClockSelect = GTM_CONFIGURABLE_CLOCK_0
                  AtomChannelCompareValueCm0 = 0
                  AtomChannelCompareValueCm1 = 0
                  AtomChannelCounterCn0Reset = ON_COMPARE_MATCH_ON_CHANNEL
                  AtomChannelCounterValCn0 = 0
                  AtomChannelModeSelect = ATOM_SIG_OUTPUT_MODE_IMMEDIATE
                  AtomChannelOneShotMode = 0
                  AtomChannelTriggerOutput = TRIG_FROM_PREVIOUS_CHANNEL
                  AtomModeControlBits = 0
                  AtomServeLastAruCommStrategy = 0
                AtomChannelUsage: AtomChannelUsage=USED_BY_OTHER_DRIVERS_OR_UNUSED
            AtomTriggerForAgc
              AtomAgcInternalTriggerSelect:
                AtomAgcIntTriggerFromChannel{0..7} = 0
              AtomAgcTriggerByTimebase: AtomAgcTbuTimebaseSelect=TBU_TS0_TIMEBASE, AtomAgcTimeBaseTriggerEnable=0, AtomAgcTimebaseMatchValue=0
          Atom_3
            8 x AtomChannel:
              AtomChannel_0
                AtomChannelAruConfiguration: AtomChAruBlockingMode=GTM_ABM_DISABLED, AtomChAruReadAddress0=510, AtomChAruReadAddress1=510, AtomChannelAruEnable=0, AtomChannelCpuWriteRequest=0
                AtomChannelEnable: AtomChDisableOnAgcTrigger=0, AtomChannelEnable=AT_START
                AtomChannelInterrupt:
                  AtomCcu0Notification = NULL_PTR
                  AtomCcu1Notification = NULL_PTR
                  AtomGlobalCcuSel = 0
                  AtomIntEnableOnCcu0Trigger = 0
                  AtomIntEnableOnCcu1Trigger = 0
                  AtomInterruptMode = GTM_INTERRUPT_LEVEL_MODE
                  AtomNotification = NULL_PTR
                AtomChannelOutput:
                  AtomChOutputDisableOnAgcTrig = 0
                  AtomChannelOutputControl = DONT_ENABLE_CHANNEL_OUTPUT
                  AtomChannelOutputSignalLevel = LOW
                  AtomChannelPortPinSelect = TOUT18_SELD_PORT0_PIN9
                AtomChannelTimerParameters:
                  AtomChEnableForceUpdate = 0
                  AtomChResetCn0OnForceUpdate = 0
                  AtomChShadowCompareValSr0 = 0
                  AtomChShadowCompareValSr1 = 0
                  AtomChSomcCompareStrategy = TIMEBASE_GREATER_EQUAL_TO_CMx
                  AtomChSomcTimebaseForComparison = TBU_TS1
                  AtomChUpdateEnableOnCn0Reset = 0
                  AtomChannelClockSelect = GTM_CONFIGURABLE_CLOCK_0
                  AtomChannelCompareValueCm0 = 0
                  AtomChannelCompareValueCm1 = 0
                  AtomChannelCounterCn0Reset = ON_COMPARE_MATCH_ON_CHANNEL
                  AtomChannelCounterValCn0 = 0
                  AtomChannelModeSelect = ATOM_SIG_OUTPUT_MODE_IMMEDIATE
                  AtomChannelOneShotMode = 0
                  AtomChannelTriggerOutput = TRIG_FROM_PREVIOUS_CHANNEL
                  AtomModeControlBits = 0
                  AtomServeLastAruCommStrategy = 0
                AtomChannelUsage: AtomChannelUsage=USED_BY_OTHER_DRIVERS_OR_UNUSED
              AtomChannel_1
                AtomChannelAruConfiguration: AtomChAruBlockingMode=GTM_ABM_DISABLED, AtomChAruReadAddress0=510, AtomChAruReadAddress1=510, AtomChannelAruEnable=0, AtomChannelCpuWriteRequest=0
                AtomChannelEnable: AtomChDisableOnAgcTrigger=0, AtomChannelEnable=AT_START
                AtomChannelInterrupt:
                  AtomCcu0Notification = NULL_PTR
                  AtomCcu1Notification = NULL_PTR
                  AtomGlobalCcuSel = 0
                  AtomIntEnableOnCcu0Trigger = 0
                  AtomIntEnableOnCcu1Trigger = 0
                  AtomInterruptMode = GTM_INTERRUPT_LEVEL_MODE
                  AtomNotification = NULL_PTR
                AtomChannelOutput:
                  AtomChOutputDisableOnAgcTrig = 0
                  AtomChannelOutputControl = DONT_ENABLE_CHANNEL_OUTPUT
                  AtomChannelOutputSignalLevel = LOW
                  AtomChannelPortPinSelect = TOUT19_SELD_PORT0_PIN10
                AtomChannelTimerParameters:
                  AtomChEnableForceUpdate = 0
                  AtomChResetCn0OnForceUpdate = 0
                  AtomChShadowCompareValSr0 = 0
                  AtomChShadowCompareValSr1 = 0
                  AtomChSomcCompareStrategy = TIMEBASE_GREATER_EQUAL_TO_CMx
                  AtomChSomcTimebaseForComparison = TBU_TS1
                  AtomChUpdateEnableOnCn0Reset = 0
                  AtomChannelClockSelect = GTM_CONFIGURABLE_CLOCK_0
                  AtomChannelCompareValueCm0 = 0
                  AtomChannelCompareValueCm1 = 0
                  AtomChannelCounterCn0Reset = ON_COMPARE_MATCH_ON_CHANNEL
                  AtomChannelCounterValCn0 = 0
                  AtomChannelModeSelect = ATOM_SIG_OUTPUT_MODE_IMMEDIATE
                  AtomChannelOneShotMode = 0
                  AtomChannelTriggerOutput = TRIG_FROM_PREVIOUS_CHANNEL
                  AtomModeControlBits = 0
                  AtomServeLastAruCommStrategy = 0
                AtomChannelUsage: AtomChannelUsage=USED_BY_OTHER_DRIVERS_OR_UNUSED
              AtomChannel_2
                AtomChannelAruConfiguration: AtomChAruBlockingMode=GTM_ABM_DISABLED, AtomChAruReadAddress0=510, AtomChAruReadAddress1=510, AtomChannelAruEnable=0, AtomChannelCpuWriteRequest=0
                AtomChannelEnable: AtomChDisableOnAgcTrigger=0, AtomChannelEnable=AT_START
                AtomChannelInterrupt:
                  AtomCcu0Notification = NULL_PTR
                  AtomCcu1Notification = NULL_PTR
                  AtomGlobalCcuSel = 0
                  AtomIntEnableOnCcu0Trigger = 0
                  AtomIntEnableOnCcu1Trigger = 0
                  AtomInterruptMode = GTM_INTERRUPT_LEVEL_MODE
                  AtomNotification = NULL_PTR
                AtomChannelOutput:
                  AtomChOutputDisableOnAgcTrig = 0
                  AtomChannelOutputControl = DONT_ENABLE_CHANNEL_OUTPUT
                  AtomChannelOutputSignalLevel = LOW
                  AtomChannelPortPinSelect = TOUT20_SELD_PORT0_PIN11
                AtomChannelTimerParameters:
                  AtomChEnableForceUpdate = 0
                  AtomChResetCn0OnForceUpdate = 0
                  AtomChShadowCompareValSr0 = 0
                  AtomChShadowCompareValSr1 = 0
                  AtomChSomcCompareStrategy = TIMEBASE_GREATER_EQUAL_TO_CMx
                  AtomChSomcTimebaseForComparison = TBU_TS1
                  AtomChUpdateEnableOnCn0Reset = 0
                  AtomChannelClockSelect = GTM_CONFIGURABLE_CLOCK_0
                  AtomChannelCompareValueCm0 = 0
                  AtomChannelCompareValueCm1 = 0
                  AtomChannelCounterCn0Reset = ON_COMPARE_MATCH_ON_CHANNEL
                  AtomChannelCounterValCn0 = 0
                  AtomChannelModeSelect = ATOM_SIG_OUTPUT_MODE_IMMEDIATE
                  AtomChannelOneShotMode = 0
                  AtomChannelTriggerOutput = TRIG_FROM_PREVIOUS_CHANNEL
                  AtomModeControlBits = 0
                  AtomServeLastAruCommStrategy = 0
                AtomChannelUsage: AtomChannelUsage=USED_BY_OTHER_DRIVERS_OR_UNUSED
              AtomChannel_3
                AtomChannelAruConfiguration: AtomChAruBlockingMode=GTM_ABM_DISABLED, AtomChAruReadAddress0=510, AtomChAruReadAddress1=510, AtomChannelAruEnable=0, AtomChannelCpuWriteRequest=0
                AtomChannelEnable: AtomChDisableOnAgcTrigger=0, AtomChannelEnable=AT_START
                AtomChannelInterrupt:
                  AtomCcu0Notification = NULL_PTR
                  AtomCcu1Notification = NULL_PTR
                  AtomGlobalCcuSel = 0
                  AtomIntEnableOnCcu0Trigger = 0
                  AtomIntEnableOnCcu1Trigger = 0
                  AtomInterruptMode = GTM_INTERRUPT_LEVEL_MODE
                  AtomNotification = NULL_PTR
                AtomChannelOutput:
                  AtomChOutputDisableOnAgcTrig = 0
                  AtomChannelOutputControl = DONT_ENABLE_CHANNEL_OUTPUT
                  AtomChannelOutputSignalLevel = LOW
                  AtomChannelPortPinSelect = TOUT21_SELD_PORT0_PIN12
                AtomChannelTimerParameters:
                  AtomChEnableForceUpdate = 0
                  AtomChResetCn0OnForceUpdate = 0
                  AtomChShadowCompareValSr0 = 0
                  AtomChShadowCompareValSr1 = 0
                  AtomChSomcCompareStrategy = TIMEBASE_GREATER_EQUAL_TO_CMx
                  AtomChSomcTimebaseForComparison = TBU_TS1
                  AtomChUpdateEnableOnCn0Reset = 0
                  AtomChannelClockSelect = GTM_CONFIGURABLE_CLOCK_0
                  AtomChannelCompareValueCm0 = 0
                  AtomChannelCompareValueCm1 = 0
                  AtomChannelCounterCn0Reset = ON_COMPARE_MATCH_ON_CHANNEL
                  AtomChannelCounterValCn0 = 0
                  AtomChannelModeSelect = ATOM_SIG_OUTPUT_MODE_IMMEDIATE
                  AtomChannelOneShotMode = 0
                  AtomChannelTriggerOutput = TRIG_FROM_PREVIOUS_CHANNEL
                  AtomModeControlBits = 0
                  AtomServeLastAruCommStrategy = 0
                AtomChannelUsage: AtomChannelUsage=USED_BY_OTHER_DRIVERS_OR_UNUSED
              AtomChannel_4
                AtomChannelAruConfiguration: AtomChAruBlockingMode=GTM_ABM_DISABLED, AtomChAruReadAddress0=510, AtomChAruReadAddress1=510, AtomChannelAruEnable=0, AtomChannelCpuWriteRequest=0
                AtomChannelEnable: AtomChDisableOnAgcTrigger=0, AtomChannelEnable=AT_START
                AtomChannelInterrupt:
                  AtomCcu0Notification = NULL_PTR
                  AtomCcu1Notification = NULL_PTR
                  AtomGlobalCcuSel = 0
                  AtomIntEnableOnCcu0Trigger = 0
                  AtomIntEnableOnCcu1Trigger = 0
                  AtomInterruptMode = GTM_INTERRUPT_LEVEL_MODE
                  AtomNotification = NULL_PTR
                AtomChannelOutput:
                  AtomChOutputDisableOnAgcTrig = 0
                  AtomChannelOutputControl = DONT_ENABLE_CHANNEL_OUTPUT
                  AtomChannelOutputSignalLevel = LOW
                  AtomChannelPortPinSelect = TOUT98_SELD_PORT11_PIN9
                AtomChannelTimerParameters:
                  AtomChEnableForceUpdate = 0
                  AtomChResetCn0OnForceUpdate = 0
                  AtomChShadowCompareValSr0 = 0
                  AtomChShadowCompareValSr1 = 0
                  AtomChSomcCompareStrategy = TIMEBASE_GREATER_EQUAL_TO_CMx
                  AtomChSomcTimebaseForComparison = TBU_TS1
                  AtomChUpdateEnableOnCn0Reset = 0
                  AtomChannelClockSelect = GTM_CONFIGURABLE_CLOCK_0
                  AtomChannelCompareValueCm0 = 0
                  AtomChannelCompareValueCm1 = 0
                  AtomChannelCounterCn0Reset = ON_COMPARE_MATCH_ON_CHANNEL
                  AtomChannelCounterValCn0 = 0
                  AtomChannelModeSelect = ATOM_SIG_OUTPUT_MODE_IMMEDIATE
                  AtomChannelOneShotMode = 0
                  AtomChannelTriggerOutput = TRIG_FROM_PREVIOUS_CHANNEL
                  AtomModeControlBits = 0
                  AtomServeLastAruCommStrategy = 0
                AtomChannelUsage: AtomChannelUsage=USED_BY_OTHER_DRIVERS_OR_UNUSED
              AtomChannel_5
                AtomChannelAruConfiguration: AtomChAruBlockingMode=GTM_ABM_DISABLED, AtomChAruReadAddress0=510, AtomChAruReadAddress1=510, AtomChannelAruEnable=0, AtomChannelCpuWriteRequest=0
                AtomChannelEnable: AtomChDisableOnAgcTrigger=0, AtomChannelEnable=AT_START
                AtomChannelInterrupt:
                  AtomCcu0Notification = NULL_PTR
                  AtomCcu1Notification = NULL_PTR
                  AtomGlobalCcuSel = 0
                  AtomIntEnableOnCcu0Trigger = 0
                  AtomIntEnableOnCcu1Trigger = 0
                  AtomInterruptMode = GTM_INTERRUPT_LEVEL_MODE
                  AtomNotification = NULL_PTR
                AtomChannelOutput:
                  AtomChOutputDisableOnAgcTrig = 0
                  AtomChannelOutputControl = DONT_ENABLE_CHANNEL_OUTPUT
                  AtomChannelOutputSignalLevel = LOW
                  AtomChannelPortPinSelect = TOUT99_SELD_PORT11_PIN10
                AtomChannelTimerParameters:
                  AtomChEnableForceUpdate = 0
                  AtomChResetCn0OnForceUpdate = 0
                  AtomChShadowCompareValSr0 = 0
                  AtomChShadowCompareValSr1 = 0
                  AtomChSomcCompareStrategy = TIMEBASE_GREATER_EQUAL_TO_CMx
                  AtomChSomcTimebaseForComparison = TBU_TS1
                  AtomChUpdateEnableOnCn0Reset = 0
                  AtomChannelClockSelect = GTM_CONFIGURABLE_CLOCK_0
                  AtomChannelCompareValueCm0 = 0
                  AtomChannelCompareValueCm1 = 0
                  AtomChannelCounterCn0Reset = ON_COMPARE_MATCH_ON_CHANNEL
                  AtomChannelCounterValCn0 = 0
                  AtomChannelModeSelect = ATOM_SIG_OUTPUT_MODE_IMMEDIATE
                  AtomChannelOneShotMode = 0
                  AtomChannelTriggerOutput = TRIG_FROM_PREVIOUS_CHANNEL
                  AtomModeControlBits = 0
                  AtomServeLastAruCommStrategy = 0
                AtomChannelUsage: AtomChannelUsage=USED_BY_OTHER_DRIVERS_OR_UNUSED
              AtomChannel_6
                AtomChannelAruConfiguration: AtomChAruBlockingMode=GTM_ABM_DISABLED, AtomChAruReadAddress0=510, AtomChAruReadAddress1=510, AtomChannelAruEnable=0, AtomChannelCpuWriteRequest=0
                AtomChannelEnable: AtomChDisableOnAgcTrigger=0, AtomChannelEnable=AT_START
                AtomChannelInterrupt:
                  AtomCcu0Notification = NULL_PTR
                  AtomCcu1Notification = NULL_PTR
                  AtomGlobalCcuSel = 0
                  AtomIntEnableOnCcu0Trigger = 0
                  AtomIntEnableOnCcu1Trigger = 0
                  AtomInterruptMode = GTM_INTERRUPT_LEVEL_MODE
                  AtomNotification = NULL_PTR
                AtomChannelOutput:
                  AtomChOutputDisableOnAgcTrig = 0
                  AtomChannelOutputControl = DONT_ENABLE_CHANNEL_OUTPUT
                  AtomChannelOutputSignalLevel = LOW
                  AtomChannelPortPinSelect = TOUT100_SELD_PORT11_PIN11
                AtomChannelTimerParameters:
                  AtomChEnableForceUpdate = 0
                  AtomChResetCn0OnForceUpdate = 0
                  AtomChShadowCompareValSr0 = 0
                  AtomChShadowCompareValSr1 = 0
                  AtomChSomcCompareStrategy = TIMEBASE_GREATER_EQUAL_TO_CMx
                  AtomChSomcTimebaseForComparison = TBU_TS1
                  AtomChUpdateEnableOnCn0Reset = 0
                  AtomChannelClockSelect = GTM_CONFIGURABLE_CLOCK_0
                  AtomChannelCompareValueCm0 = 0
                  AtomChannelCompareValueCm1 = 0
                  AtomChannelCounterCn0Reset = ON_COMPARE_MATCH_ON_CHANNEL
                  AtomChannelCounterValCn0 = 0
                  AtomChannelModeSelect = ATOM_SIG_OUTPUT_MODE_IMMEDIATE
                  AtomChannelOneShotMode = 0
                  AtomChannelTriggerOutput = TRIG_FROM_PREVIOUS_CHANNEL
                  AtomModeControlBits = 0
                  AtomServeLastAruCommStrategy = 0
                AtomChannelUsage: AtomChannelUsage=USED_BY_OTHER_DRIVERS_OR_UNUSED
              AtomChannel_7
                AtomChannelAruConfiguration: AtomChAruBlockingMode=GTM_ABM_DISABLED, AtomChAruReadAddress0=510, AtomChAruReadAddress1=510, AtomChannelAruEnable=0, AtomChannelCpuWriteRequest=0
                AtomChannelEnable: AtomChDisableOnAgcTrigger=0, AtomChannelEnable=AT_START
                AtomChannelInterrupt:
                  AtomCcu0Notification = NULL_PTR
                  AtomCcu1Notification = NULL_PTR
                  AtomGlobalCcuSel = 0
                  AtomIntEnableOnCcu0Trigger = 0
                  AtomIntEnableOnCcu1Trigger = 0
                  AtomInterruptMode = GTM_INTERRUPT_LEVEL_MODE
                  AtomNotification = NULL_PTR
                AtomChannelOutput:
                  AtomChOutputDisableOnAgcTrig = 0
                  AtomChannelOutputControl = DONT_ENABLE_CHANNEL_OUTPUT
                  AtomChannelOutputSignalLevel = LOW
                  AtomChannelPortPinSelect = TOUT101_SELD_PORT11_PIN12
                AtomChannelTimerParameters:
                  AtomChEnableForceUpdate = 0
                  AtomChResetCn0OnForceUpdate = 0
                  AtomChShadowCompareValSr0 = 0
                  AtomChShadowCompareValSr1 = 0
                  AtomChSomcCompareStrategy = TIMEBASE_GREATER_EQUAL_TO_CMx
                  AtomChSomcTimebaseForComparison = TBU_TS1
                  AtomChUpdateEnableOnCn0Reset = 0
                  AtomChannelClockSelect = GTM_CONFIGURABLE_CLOCK_0
                  AtomChannelCompareValueCm0 = 0
                  AtomChannelCompareValueCm1 = 0
                  AtomChannelCounterCn0Reset = ON_COMPARE_MATCH_ON_CHANNEL
                  AtomChannelCounterValCn0 = 0
                  AtomChannelModeSelect = ATOM_SIG_OUTPUT_MODE_IMMEDIATE
                  AtomChannelOneShotMode = 0
                  AtomChannelTriggerOutput = TRIG_FROM_PREVIOUS_CHANNEL
                  AtomModeControlBits = 0
                  AtomServeLastAruCommStrategy = 0
                AtomChannelUsage: AtomChannelUsage=USED_BY_OTHER_DRIVERS_OR_UNUSED
            AtomTriggerForAgc
              AtomAgcInternalTriggerSelect:
                AtomAgcIntTriggerFromChannel{0..7} = 0
              AtomAgcTriggerByTimebase: AtomAgcTbuTimebaseSelect=TBU_TS0_TIMEBASE, AtomAgcTimeBaseTriggerEnable=0, AtomAgcTimebaseMatchValue=0
          Atom_4
            8 x AtomChannel:
              AtomChannel_0
                AtomChannelAruConfiguration: AtomChAruBlockingMode=GTM_ABM_DISABLED, AtomChAruReadAddress0=510, AtomChAruReadAddress1=510, AtomChannelAruEnable=0, AtomChannelCpuWriteRequest=0
                AtomChannelEnable: AtomChDisableOnAgcTrigger=0, AtomChannelEnable=AT_START
                AtomChannelInterrupt:
                  AtomCcu0Notification = NULL_PTR
                  AtomCcu1Notification = NULL_PTR
                  AtomGlobalCcuSel = 0
                  AtomIntEnableOnCcu0Trigger = 0
                  AtomIntEnableOnCcu1Trigger = 0
                  AtomInterruptMode = GTM_INTERRUPT_LEVEL_MODE
                  AtomNotification = NULL_PTR
                AtomChannelOutput:
                  AtomChOutputDisableOnAgcTrig = 0
                  AtomChannelOutputControl = DONT_ENABLE_CHANNEL_OUTPUT
                  AtomChannelOutputSignalLevel = LOW
                  AtomChannelPortPinSelect = TOUT109_SELD_PORT10_PIN7
                AtomChannelTimerParameters:
                  AtomChEnableForceUpdate = 0
                  AtomChResetCn0OnForceUpdate = 0
                  AtomChShadowCompareValSr0 = 0
                  AtomChShadowCompareValSr1 = 0
                  AtomChSomcCompareStrategy = TIMEBASE_GREATER_EQUAL_TO_CMx
                  AtomChSomcTimebaseForComparison = TBU_TS1
                  AtomChUpdateEnableOnCn0Reset = 0
                  AtomChannelClockSelect = GTM_CONFIGURABLE_CLOCK_0
                  AtomChannelCompareValueCm0 = 0
                  AtomChannelCompareValueCm1 = 0
                  AtomChannelCounterCn0Reset = ON_COMPARE_MATCH_ON_CHANNEL
                  AtomChannelCounterValCn0 = 0
                  AtomChannelModeSelect = ATOM_SIG_OUTPUT_MODE_IMMEDIATE
                  AtomChannelOneShotMode = 0
                  AtomChannelTriggerOutput = TRIG_FROM_PREVIOUS_CHANNEL
                  AtomModeControlBits = 0
                  AtomServeLastAruCommStrategy = 0
                AtomChannelUsage: AtomChannelUsage=USED_BY_OTHER_DRIVERS_OR_UNUSED
              AtomChannel_1
                AtomChannelAruConfiguration: AtomChAruBlockingMode=GTM_ABM_DISABLED, AtomChAruReadAddress0=510, AtomChAruReadAddress1=510, AtomChannelAruEnable=0, AtomChannelCpuWriteRequest=0
                AtomChannelEnable: AtomChDisableOnAgcTrigger=0, AtomChannelEnable=AT_START
                AtomChannelInterrupt:
                  AtomCcu0Notification = NULL_PTR
                  AtomCcu1Notification = NULL_PTR
                  AtomGlobalCcuSel = 0
                  AtomIntEnableOnCcu0Trigger = 0
                  AtomIntEnableOnCcu1Trigger = 0
                  AtomInterruptMode = GTM_INTERRUPT_LEVEL_MODE
                  AtomNotification = NULL_PTR
                AtomChannelOutput:
                  AtomChOutputDisableOnAgcTrig = 0
                  AtomChannelOutputControl = DONT_ENABLE_CHANNEL_OUTPUT
                  AtomChannelOutputSignalLevel = LOW
                  AtomChannelPortPinSelect = TOUT103_SELD_PORT10_PIN1
                AtomChannelTimerParameters:
                  AtomChEnableForceUpdate = 0
                  AtomChResetCn0OnForceUpdate = 0
                  AtomChShadowCompareValSr0 = 0
                  AtomChShadowCompareValSr1 = 0
                  AtomChSomcCompareStrategy = TIMEBASE_GREATER_EQUAL_TO_CMx
                  AtomChSomcTimebaseForComparison = TBU_TS1
                  AtomChUpdateEnableOnCn0Reset = 0
                  AtomChannelClockSelect = GTM_CONFIGURABLE_CLOCK_0
                  AtomChannelCompareValueCm0 = 0
                  AtomChannelCompareValueCm1 = 0
                  AtomChannelCounterCn0Reset = ON_COMPARE_MATCH_ON_CHANNEL
                  AtomChannelCounterValCn0 = 0
                  AtomChannelModeSelect = ATOM_SIG_OUTPUT_MODE_IMMEDIATE
                  AtomChannelOneShotMode = 0
                  AtomChannelTriggerOutput = TRIG_FROM_PREVIOUS_CHANNEL
                  AtomModeControlBits = 0
                  AtomServeLastAruCommStrategy = 0
                AtomChannelUsage: AtomChannelUsage=USED_BY_OTHER_DRIVERS_OR_UNUSED
              AtomChannel_2
                AtomChannelAruConfiguration: AtomChAruBlockingMode=GTM_ABM_DISABLED, AtomChAruReadAddress0=510, AtomChAruReadAddress1=510, AtomChannelAruEnable=0, AtomChannelCpuWriteRequest=0
                AtomChannelEnable: AtomChDisableOnAgcTrigger=0, AtomChannelEnable=AT_START
                AtomChannelInterrupt:
                  AtomCcu0Notification = NULL_PTR
                  AtomCcu1Notification = NULL_PTR
                  AtomGlobalCcuSel = 0
                  AtomIntEnableOnCcu0Trigger = 0
                  AtomIntEnableOnCcu1Trigger = 0
                  AtomInterruptMode = GTM_INTERRUPT_LEVEL_MODE
                  AtomNotification = NULL_PTR
                AtomChannelOutput:
                  AtomChOutputDisableOnAgcTrig = 0
                  AtomChannelOutputControl = DONT_ENABLE_CHANNEL_OUTPUT
                  AtomChannelOutputSignalLevel = LOW
                  AtomChannelPortPinSelect = TOUT104_SELD_PORT10_PIN2
                AtomChannelTimerParameters:
                  AtomChEnableForceUpdate = 0
                  AtomChResetCn0OnForceUpdate = 0
                  AtomChShadowCompareValSr0 = 0
                  AtomChShadowCompareValSr1 = 0
                  AtomChSomcCompareStrategy = TIMEBASE_GREATER_EQUAL_TO_CMx
                  AtomChSomcTimebaseForComparison = TBU_TS1
                  AtomChUpdateEnableOnCn0Reset = 0
                  AtomChannelClockSelect = GTM_CONFIGURABLE_CLOCK_0
                  AtomChannelCompareValueCm0 = 0
                  AtomChannelCompareValueCm1 = 0
                  AtomChannelCounterCn0Reset = ON_COMPARE_MATCH_ON_CHANNEL
                  AtomChannelCounterValCn0 = 0
                  AtomChannelModeSelect = ATOM_SIG_OUTPUT_MODE_IMMEDIATE
                  AtomChannelOneShotMode = 0
                  AtomChannelTriggerOutput = TRIG_FROM_PREVIOUS_CHANNEL
                  AtomModeControlBits = 0
                  AtomServeLastAruCommStrategy = 0
                AtomChannelUsage: AtomChannelUsage=USED_BY_OTHER_DRIVERS_OR_UNUSED
              AtomChannel_3
                AtomChannelAruConfiguration: AtomChAruBlockingMode=GTM_ABM_DISABLED, AtomChAruReadAddress0=510, AtomChAruReadAddress1=510, AtomChannelAruEnable=0, AtomChannelCpuWriteRequest=0
                AtomChannelEnable: AtomChDisableOnAgcTrigger=0, AtomChannelEnable=AT_START
                AtomChannelInterrupt:
                  AtomCcu0Notification = NULL_PTR
                  AtomCcu1Notification = NULL_PTR
                  AtomGlobalCcuSel = 0
                  AtomIntEnableOnCcu0Trigger = 0
                  AtomIntEnableOnCcu1Trigger = 0
                  AtomInterruptMode = GTM_INTERRUPT_LEVEL_MODE
                  AtomNotification = NULL_PTR
                AtomChannelOutput:
                  AtomChOutputDisableOnAgcTrig = 0
                  AtomChannelOutputControl = DONT_ENABLE_CHANNEL_OUTPUT
                  AtomChannelOutputSignalLevel = LOW
                  AtomChannelPortPinSelect = TOUT105_SELD_PORT10_PIN3
                AtomChannelTimerParameters:
                  AtomChEnableForceUpdate = 0
                  AtomChResetCn0OnForceUpdate = 0
                  AtomChShadowCompareValSr0 = 0
                  AtomChShadowCompareValSr1 = 0
                  AtomChSomcCompareStrategy = TIMEBASE_GREATER_EQUAL_TO_CMx
                  AtomChSomcTimebaseForComparison = TBU_TS1
                  AtomChUpdateEnableOnCn0Reset = 0
                  AtomChannelClockSelect = GTM_CONFIGURABLE_CLOCK_0
                  AtomChannelCompareValueCm0 = 0
                  AtomChannelCompareValueCm1 = 0
                  AtomChannelCounterCn0Reset = ON_COMPARE_MATCH_ON_CHANNEL
                  AtomChannelCounterValCn0 = 0
                  AtomChannelModeSelect = ATOM_SIG_OUTPUT_MODE_IMMEDIATE
                  AtomChannelOneShotMode = 0
                  AtomChannelTriggerOutput = TRIG_FROM_PREVIOUS_CHANNEL
                  AtomModeControlBits = 0
                  AtomServeLastAruCommStrategy = 0
                AtomChannelUsage: AtomChannelUsage=USED_BY_OTHER_DRIVERS_OR_UNUSED
              AtomChannel_4
                AtomChannelAruConfiguration: AtomChAruBlockingMode=GTM_ABM_DISABLED, AtomChAruReadAddress0=510, AtomChAruReadAddress1=510, AtomChannelAruEnable=0, AtomChannelCpuWriteRequest=0
                AtomChannelEnable: AtomChDisableOnAgcTrigger=0, AtomChannelEnable=AT_START
                AtomChannelInterrupt:
                  AtomCcu0Notification = NULL_PTR
                  AtomCcu1Notification = NULL_PTR
                  AtomGlobalCcuSel = 0
                  AtomIntEnableOnCcu0Trigger = 0
                  AtomIntEnableOnCcu1Trigger = 0
                  AtomInterruptMode = GTM_INTERRUPT_LEVEL_MODE
                  AtomNotification = NULL_PTR
                AtomChannelOutput:
                  AtomChOutputDisableOnAgcTrig = 0
                  AtomChannelOutputControl = DONT_ENABLE_CHANNEL_OUTPUT
                  AtomChannelOutputSignalLevel = LOW
                  AtomChannelPortPinSelect = TOUT102_SELD_PORT10_PIN0
                AtomChannelTimerParameters:
                  AtomChEnableForceUpdate = 0
                  AtomChResetCn0OnForceUpdate = 0
                  AtomChShadowCompareValSr0 = 0
                  AtomChShadowCompareValSr1 = 0
                  AtomChSomcCompareStrategy = TIMEBASE_GREATER_EQUAL_TO_CMx
                  AtomChSomcTimebaseForComparison = TBU_TS1
                  AtomChUpdateEnableOnCn0Reset = 0
                  AtomChannelClockSelect = GTM_CONFIGURABLE_CLOCK_0
                  AtomChannelCompareValueCm0 = 0
                  AtomChannelCompareValueCm1 = 0
                  AtomChannelCounterCn0Reset = ON_COMPARE_MATCH_ON_CHANNEL
                  AtomChannelCounterValCn0 = 0
                  AtomChannelModeSelect = ATOM_SIG_OUTPUT_MODE_IMMEDIATE
                  AtomChannelOneShotMode = 0
                  AtomChannelTriggerOutput = TRIG_FROM_PREVIOUS_CHANNEL
                  AtomModeControlBits = 0
                  AtomServeLastAruCommStrategy = 0
                AtomChannelUsage: AtomChannelUsage=USED_BY_OTHER_DRIVERS_OR_UNUSED
              AtomChannel_5
                AtomChannelAruConfiguration: AtomChAruBlockingMode=GTM_ABM_DISABLED, AtomChAruReadAddress0=510, AtomChAruReadAddress1=510, AtomChannelAruEnable=0, AtomChannelCpuWriteRequest=0
                AtomChannelEnable: AtomChDisableOnAgcTrigger=0, AtomChannelEnable=AT_START
                AtomChannelInterrupt:
                  AtomCcu0Notification = NULL_PTR
                  AtomCcu1Notification = NULL_PTR
                  AtomGlobalCcuSel = 0
                  AtomIntEnableOnCcu0Trigger = 0
                  AtomIntEnableOnCcu1Trigger = 0
                  AtomInterruptMode = GTM_INTERRUPT_LEVEL_MODE
                  AtomNotification = NULL_PTR
                AtomChannelOutput:
                  AtomChOutputDisableOnAgcTrig = 0
                  AtomChannelOutputControl = DONT_ENABLE_CHANNEL_OUTPUT
                  AtomChannelOutputSignalLevel = LOW
                  AtomChannelPortPinSelect = TOUT110_SELD_PORT10_PIN8
                AtomChannelTimerParameters:
                  AtomChEnableForceUpdate = 0
                  AtomChResetCn0OnForceUpdate = 0
                  AtomChShadowCompareValSr0 = 0
                  AtomChShadowCompareValSr1 = 0
                  AtomChSomcCompareStrategy = TIMEBASE_GREATER_EQUAL_TO_CMx
                  AtomChSomcTimebaseForComparison = TBU_TS1
                  AtomChUpdateEnableOnCn0Reset = 0
                  AtomChannelClockSelect = GTM_CONFIGURABLE_CLOCK_0
                  AtomChannelCompareValueCm0 = 0
                  AtomChannelCompareValueCm1 = 0
                  AtomChannelCounterCn0Reset = ON_COMPARE_MATCH_ON_CHANNEL
                  AtomChannelCounterValCn0 = 0
                  AtomChannelModeSelect = ATOM_SIG_OUTPUT_MODE_IMMEDIATE
                  AtomChannelOneShotMode = 0
                  AtomChannelTriggerOutput = TRIG_FROM_PREVIOUS_CHANNEL
                  AtomModeControlBits = 0
                  AtomServeLastAruCommStrategy = 0
                AtomChannelUsage: AtomChannelUsage=USED_BY_OTHER_DRIVERS_OR_UNUSED
              AtomChannel_6
                AtomChannelAruConfiguration: AtomChAruBlockingMode=GTM_ABM_DISABLED, AtomChAruReadAddress0=510, AtomChAruReadAddress1=510, AtomChannelAruEnable=0, AtomChannelCpuWriteRequest=0
                AtomChannelEnable: AtomChDisableOnAgcTrigger=0, AtomChannelEnable=AT_START
                AtomChannelInterrupt:
                  AtomCcu0Notification = NULL_PTR
                  AtomCcu1Notification = NULL_PTR
                  AtomGlobalCcuSel = 0
                  AtomIntEnableOnCcu0Trigger = 0
                  AtomIntEnableOnCcu1Trigger = 0
                  AtomInterruptMode = GTM_INTERRUPT_LEVEL_MODE
                  AtomNotification = NULL_PTR
                AtomChannelOutput:
                  AtomChOutputDisableOnAgcTrig = 0
                  AtomChannelOutputControl = DONT_ENABLE_CHANNEL_OUTPUT
                  AtomChannelOutputSignalLevel = LOW
                  AtomChannelPortPinSelect = TOUT106_SELD_PORT10_PIN4
                AtomChannelTimerParameters:
                  AtomChEnableForceUpdate = 0
                  AtomChResetCn0OnForceUpdate = 0
                  AtomChShadowCompareValSr0 = 0
                  AtomChShadowCompareValSr1 = 0
                  AtomChSomcCompareStrategy = TIMEBASE_GREATER_EQUAL_TO_CMx
                  AtomChSomcTimebaseForComparison = TBU_TS1
                  AtomChUpdateEnableOnCn0Reset = 0
                  AtomChannelClockSelect = GTM_CONFIGURABLE_CLOCK_0
                  AtomChannelCompareValueCm0 = 0
                  AtomChannelCompareValueCm1 = 0
                  AtomChannelCounterCn0Reset = ON_COMPARE_MATCH_ON_CHANNEL
                  AtomChannelCounterValCn0 = 0
                  AtomChannelModeSelect = ATOM_SIG_OUTPUT_MODE_IMMEDIATE
                  AtomChannelOneShotMode = 0
                  AtomChannelTriggerOutput = TRIG_FROM_PREVIOUS_CHANNEL
                  AtomModeControlBits = 0
                  AtomServeLastAruCommStrategy = 0
                AtomChannelUsage: AtomChannelUsage=USED_BY_OTHER_DRIVERS_OR_UNUSED
              AtomChannel_7
                AtomChannelAruConfiguration: AtomChAruBlockingMode=GTM_ABM_DISABLED, AtomChAruReadAddress0=510, AtomChAruReadAddress1=510, AtomChannelAruEnable=0, AtomChannelCpuWriteRequest=0
                AtomChannelEnable: AtomChDisableOnAgcTrigger=0, AtomChannelEnable=AT_START
                AtomChannelInterrupt:
                  AtomCcu0Notification = NULL_PTR
                  AtomCcu1Notification = NULL_PTR
                  AtomGlobalCcuSel = 0
                  AtomIntEnableOnCcu0Trigger = 0
                  AtomIntEnableOnCcu1Trigger = 0
                  AtomInterruptMode = GTM_INTERRUPT_LEVEL_MODE
                  AtomNotification = NULL_PTR
                AtomChannelOutput:
                  AtomChOutputDisableOnAgcTrig = 0
                  AtomChannelOutputControl = DONT_ENABLE_CHANNEL_OUTPUT
                  AtomChannelOutputSignalLevel = LOW
                  AtomChannelPortPinSelect = TOUT75_SELD_PORT15_PIN4
                AtomChannelTimerParameters:
                  AtomChEnableForceUpdate = 0
                  AtomChResetCn0OnForceUpdate = 0
                  AtomChShadowCompareValSr0 = 0
                  AtomChShadowCompareValSr1 = 0
                  AtomChSomcCompareStrategy = TIMEBASE_GREATER_EQUAL_TO_CMx
                  AtomChSomcTimebaseForComparison = TBU_TS1
                  AtomChUpdateEnableOnCn0Reset = 0
                  AtomChannelClockSelect = GTM_CONFIGURABLE_CLOCK_0
                  AtomChannelCompareValueCm0 = 0
                  AtomChannelCompareValueCm1 = 0
                  AtomChannelCounterCn0Reset = ON_COMPARE_MATCH_ON_CHANNEL
                  AtomChannelCounterValCn0 = 0
                  AtomChannelModeSelect = ATOM_SIG_OUTPUT_MODE_IMMEDIATE
                  AtomChannelOneShotMode = 0
                  AtomChannelTriggerOutput = TRIG_FROM_PREVIOUS_CHANNEL
                  AtomModeControlBits = 0
                  AtomServeLastAruCommStrategy = 0
                AtomChannelUsage: AtomChannelUsage=USED_BY_OTHER_DRIVERS_OR_UNUSED
            AtomTriggerForAgc
              AtomAgcInternalTriggerSelect:
                AtomAgcIntTriggerFromChannel{0..7} = 0
              AtomAgcTriggerByTimebase: AtomAgcTbuTimebaseSelect=TBU_TS0_TIMEBASE, AtomAgcTimeBaseTriggerEnable=0, AtomAgcTimebaseMatchValue=0
        GtmAeiInterface:
          GtmAeiIllegalModuleAddErrIntEn = 0
          GtmAeiIllegalModuleAddIntEn = 0
          GtmAeiInterruptMode = GTM_INTERRUPT_LEVEL_MODE
          GtmAeiTimeOutMode = OBSERVE
          GtmAeiTimeOutValue = 0
          GtmAeiTimeoutExceptionErrIntEn = 0
          GtmAeiTimeoutExceptionIntEn = 0
          GtmAeiUnsupportedAddressErrIntEn = 0
          GtmAeiUnsupportedAddressIntEn = 0
          GtmAeiUnsupportedByteEnErrIntEn = 0
          GtmAeiUnsupportedByteEnIntEn = 0
        GtmGeneral: GtmEnRstAndForceIntFunctionality=0, GtmGlobalClkDivDenominator=1, GtmGlobalClkDivNumerator=1, GtmSleepMode=GTM_SLEEP_ENABLE
        4 x Mcs:
          Mcs_0
            8 x McsChannel, all with McsChMemoryErrorInterruptEnable=0, McsChMemoryErrorInterruptEnableErr=0, McsChStackErrorInterruptEnable=0, McsChStackErrorInterruptEnableErr=0, McsChannelEnable=0, McsChannelInterruptEnable=0, McsChannelInterruptEnableErr=0, McsChannelInterruptMode=GTM_INTERRUPT_LEVEL_MODE:
              McsChannel_{0..7}
            McsGeneral: McsHaltOnStackPointerOverflow=0, McsSchedulingScheme=ACCELERATED_SCHEDULING_SCHEME, McsUsage=UNUSED
          Mcs_1
            8 x McsChannel, all with McsChMemoryErrorInterruptEnable=0, McsChMemoryErrorInterruptEnableErr=0, McsChStackErrorInterruptEnable=0, McsChStackErrorInterruptEnableErr=0, McsChannelEnable=0, McsChannelInterruptEnable=0, McsChannelInterruptEnableErr=0, McsChannelInterruptMode=GTM_INTERRUPT_LEVEL_MODE:
              McsChannel_{0..7}
            McsGeneral: McsHaltOnStackPointerOverflow=0, McsSchedulingScheme=ACCELERATED_SCHEDULING_SCHEME, McsUsage=UNUSED
          Mcs_2
            8 x McsChannel, all with McsChMemoryErrorInterruptEnable=0, McsChMemoryErrorInterruptEnableErr=0, McsChStackErrorInterruptEnable=0, McsChStackErrorInterruptEnableErr=0, McsChannelEnable=0, McsChannelInterruptEnable=0, McsChannelInterruptEnableErr=0, McsChannelInterruptMode=GTM_INTERRUPT_LEVEL_MODE:
              McsChannel_{0..7}
            McsGeneral: McsHaltOnStackPointerOverflow=0, McsSchedulingScheme=ACCELERATED_SCHEDULING_SCHEME, McsUsage=UNUSED
          Mcs_3
            8 x McsChannel, all with McsChMemoryErrorInterruptEnable=0, McsChMemoryErrorInterruptEnableErr=0, McsChStackErrorInterruptEnable=0, McsChStackErrorInterruptEnableErr=0, McsChannelEnable=0, McsChannelInterruptEnable=0, McsChannelInterruptEnableErr=0, McsChannelInterruptMode=GTM_INTERRUPT_LEVEL_MODE:
              McsChannel_{0..7}
            McsGeneral: McsHaltOnStackPointerOverflow=0, McsSchedulingScheme=ACCELERATED_SCHEDULING_SCHEME, McsUsage=UNUSED
        Spe_0 (Spe)
          SpeErrorInterrupt:
            SpeEnableIntOnBouncingInputErr = 0
            SpeEnableIntOnNewPatternDetectErr = 0
            SpeEnableIntOnRegCompErr = 0
            SpeEnableIntOnSpeDirBitChangeErr = 0
            SpeEnableIntOnWrongPatternErr = 0
          SpeGeneral:
            SpeEnableFastShutOff = 0
            SpeEnableInput{0..2} = 0
            SpeEnableModule = 0
            SpeInputSigRevCntr = 60
            SpeInputSigRevCntrCmpVal = 60
            SpeTimChannelsSelect = SEL0_TIM0_CH0_TO_2
            SpeTriggerInputSelect = SPE_NIPD
            SpeUsage = UNUSED
          8 x SpeInputPattern, all with SpeInputPattern=0, SpeIsPatternValid=0:
            SpeInputPattern_{0..7}
          SpeInterrupt:
            SpeEnableIntOnBouncingInput = 0
            SpeEnableIntOnNewPatternDetect = 0
            SpeEnableIntOnRegComp = 0
            SpeEnableIntOnSpeDirBitChange = 0
            SpeEnableIntOnWrongPattern = 0
            SpeInterruptMode = GTM_INTERRUPT_LEVEL_MODE
          8 x SpeOutputConfig, all with SpeFastShutoffLevel=LOW_LEVEL, SpeOutputSelect=TOM_CH0_SOUR:
            SpeOutputConfig_{0..7}
        Spe_1 (Spe)
          SpeErrorInterrupt:
            SpeEnableIntOnBouncingInputErr = 0
            SpeEnableIntOnNewPatternDetectErr = 0
            SpeEnableIntOnRegCompErr = 0
            SpeEnableIntOnSpeDirBitChangeErr = 0
            SpeEnableIntOnWrongPatternErr = 0
          SpeGeneral:
            SpeEnableFastShutOff = 0
            SpeEnableInput{0..2} = 0
            SpeEnableModule = 0
            SpeInputSigRevCntr = 60
            SpeInputSigRevCntrCmpVal = 60
            SpeTimChannelsSelect = SEL0_TIM0_CH3_TO_5
            SpeTriggerInputSelect = SPE_NIPD
            SpeUsage = UNUSED
          8 x SpeInputPattern, all with SpeInputPattern=0, SpeIsPatternValid=0:
            SpeInputPattern_{0..7}
          SpeInterrupt:
            SpeEnableIntOnBouncingInput = 0
            SpeEnableIntOnNewPatternDetect = 0
            SpeEnableIntOnRegComp = 0
            SpeEnableIntOnSpeDirBitChange = 0
            SpeEnableIntOnWrongPattern = 0
            SpeInterruptMode = GTM_INTERRUPT_LEVEL_MODE
          8 x SpeOutputConfig, all with SpeFastShutoffLevel=LOW_LEVEL, SpeOutputSelect=TOM_CH0_SOUR:
            SpeOutputConfig_{0..7}
