[part 2 of 2: packages /Mcu to /Adc]
AUTOSAR XML (schema 4-0-3)
package /Mcu  (continued)
  module config Mcu: implementation-config-variant=VARIANT-POST-BUILD-LOADABLE  (continued)
    McuModuleConfiguration_0 (McuModuleConfiguration):  (continued)
      GtmConfiguration_0 (GtmConfiguration)  (continued)
        4 x Tim:
          Tim_0
            8 x TimChannel:
              TimChannel_0
                TimChannelErrorInterrupt:
                  TimInterruptEnableOnCntOflErr = 0
                  TimInterruptEnableOnEcntOflErr = 0
                  TimInterruptEnableOnGlitchDetErr = 0
                  TimInterruptEnableOnGprxOflErr = 0
                  TimInterruptEnableOnNewValErr = 0
                  TimInterruptEnableOnToDetErr = 0
                TimChannelFilterConfig:
                  TimChFilterCounterFreqSelect = GTM_CONFIGURABLE_CLOCK_0
                  TimChFilterModeForFallingEdge = IMMEDIATE_EDGE_PROPAGATION_MODE
                  TimChFilterModeForRisingEdge = IMMEDIATE_EDGE_PROPAGATION_MODE
                  TimChFilterTimeForFallingEdge = 0
                  TimChFilterTimeForRisingEdge = 0
                  TimChannelFilterEnable = 0
                TimChannelGeneral:
                  TimChannelAruEnable = 0
                  TimChannelClockSelect = GTM_CONFIGURABLE_CLOCK_0
                  TimChannelCntsInputSelect = CNT_VALUE
                  TimChannelCntsValue = 0
                  TimChannelEcntOvflwSetting = SEL0_OVRFLOW_SIG_ON_ECNT_BITWIDTH_8
                  TimChannelEcntResetSetting = SEL0_ECNT_IN_WRAP_AROUND_MODE
                  TimChannelEnable = 0
                  TimChannelExtCaptureModeEnable = 0
                  TimChannelExtCaptureSrc = SEL0_NEW_VAL_IRQ
                  TimChannelGpr0InputSelect = TIMEBASE_TBU_TS0
                  TimChannelGpr1InputSelect = TIMEBASE_TBU_TS0
                  TimChannelInputSelect = INPUT_OF_CURRENT_TIM_CHANNEL
                  TimChannelModeSelect = PWM_MEASUREMENT_MODE_TPWM
                  TimChannelOneShotMode = 0
                  TimChannelPortPinSelect = NONE_SEL0
                  TimChannelSignalEdgeSelect = FALLING_EDGE
                  TimChannelTbu0Ts0BitsSelect = BITS_0_TO_23
                  TimChannelUsage = USED_BY_OTHER_DRIVERS_OR_UNUSED
                  TimChannelValInitSignal = VAL_LOW
                TimChannelInterrupt:
                  TimInterruptEnableOnCntOfl = 0
                  TimInterruptEnableOnEcntOfl = 0
                  TimInterruptEnableOnGlitchDet = 0
                  TimInterruptEnableOnGprxOfl = 0
                  TimInterruptEnableOnNewVal = 0
                  TimInterruptEnableOnToDet = 0
                  TimInterruptMode = GTM_INTERRUPT_LEVEL_MODE
                  TimNotification = NULL_PTR
                TimChannelTimeoutDetection: TimChTimeoutClockSelect=GTM_CONFIGURABLE_CLOCK_0, TimChTimeoutDetectionEnable=SEL0_TIMOUT_DISABLED, TimChTimeoutDuration=0
              TimChannel_1
                TimChannelErrorInterrupt:
                  TimInterruptEnableOnCntOflErr = 0
                  TimInterruptEnableOnEcntOflErr = 0
                  TimInterruptEnableOnGlitchDetErr = 0
                  TimInterruptEnableOnGprxOflErr = 0
                  TimInterruptEnableOnNewValErr = 0
                  TimInterruptEnableOnToDetErr = 0
                TimChannelFilterConfig:
                  TimChFilterCounterFreqSelect = GTM_CONFIGURABLE_CLOCK_0
                  TimChFilterModeForFallingEdge = IMMEDIATE_EDGE_PROPAGATION_MODE
                  TimChFilterModeForRisingEdge = IMMEDIATE_EDGE_PROPAGATION_MODE
                  TimChFilterTimeForFallingEdge = 0
                  TimChFilterTimeForRisingEdge = 0
                  TimChannelFilterEnable = 0
                TimChannelGeneral:
                  TimChannelAruEnable = 0
                  TimChannelClockSelect = GTM_CONFIGURABLE_CLOCK_0
                  TimChannelCntsInputSelect = CNT_VALUE
                  TimChannelCntsValue = 0
                  TimChannelEcntOvflwSetting = SEL0_OVRFLOW_SIG_ON_ECNT_BITWIDTH_8
                  TimChannelEcntResetSetting = SEL0_ECNT_IN_WRAP_AROUND_MODE
                  TimChannelEnable = 0
                  TimChannelExtCaptureModeEnable = 0
                  TimChannelExtCaptureSrc = SEL0_NEW_VAL_IRQ
                  TimChannelGpr0InputSelect = TIMEBASE_TBU_TS0
                  TimChannelGpr1InputSelect = TIMEBASE_TBU_TS0
                  TimChannelInputSelect = INPUT_OF_CURRENT_TIM_CHANNEL
                  TimChannelModeSelect = PWM_MEASUREMENT_MODE_TPWM
                  TimChannelOneShotMode = 0
                  TimChannelPortPinSelect = NONE_SEL0
                  TimChannelSignalEdgeSelect = FALLING_EDGE
                  TimChannelTbu0Ts0BitsSelect = BITS_0_TO_23
                  TimChannelUsage = USED_BY_OTHER_DRIVERS_OR_UNUSED
                  TimChannelValInitSignal = VAL_LOW
                TimChannelInterrupt:
                  TimInterruptEnableOnCntOfl = 0
                  TimInterruptEnableOnEcntOfl = 0
                  TimInterruptEnableOnGlitchDet = 0
                  TimInterruptEnableOnGprxOfl = 0
                  TimInterruptEnableOnNewVal = 0
                  TimInterruptEnableOnToDet = 0
                  TimInterruptMode = GTM_INTERRUPT_LEVEL_MODE
                  TimNotification = NULL_PTR
                TimChannelTimeoutDetection: TimChTimeoutClockSelect=GTM_CONFIGURABLE_CLOCK_0, TimChTimeoutDetectionEnable=SEL0_TIMOUT_DISABLED, TimChTimeoutDuration=0
              TimChannel_2
                TimChannelErrorInterrupt:
                  TimInterruptEnableOnCntOflErr = 0
                  TimInterruptEnableOnEcntOflErr = 0
                  TimInterruptEnableOnGlitchDetErr = 0
                  TimInterruptEnableOnGprxOflErr = 0
                  TimInterruptEnableOnNewValErr = 0
                  TimInterruptEnableOnToDetErr = 0
                TimChannelFilterConfig:
                  TimChFilterCounterFreqSelect = GTM_CONFIGURABLE_CLOCK_0
                  TimChFilterModeForFallingEdge = IMMEDIATE_EDGE_PROPAGATION_MODE
                  TimChFilterModeForRisingEdge = IMMEDIATE_EDGE_PROPAGATION_MODE
                  TimChFilterTimeForFallingEdge = 0
                  TimChFilterTimeForRisingEdge = 0
                  TimChannelFilterEnable = 0
                TimChannelGeneral:
                  TimChannelAruEnable = 0
                  TimChannelClockSelect = GTM_CONFIGURABLE_CLOCK_0
                  TimChannelCntsInputSelect = CNT_VALUE
                  TimChannelCntsValue = 0
                  TimChannelEcntOvflwSetting = SEL0_OVRFLOW_SIG_ON_ECNT_BITWIDTH_8
                  TimChannelEcntResetSetting = SEL0_ECNT_IN_WRAP_AROUND_MODE
                  TimChannelEnable = 0
                  TimChannelExtCaptureModeEnable = 0
                  TimChannelExtCaptureSrc = SEL0_NEW_VAL_IRQ
                  TimChannelGpr0InputSelect = TIMEBASE_TBU_TS0
                  TimChannelGpr1InputSelect = TIMEBASE_TBU_TS0
                  TimChannelInputSelect = INPUT_OF_CURRENT_TIM_CHANNEL
                  TimChannelModeSelect = PWM_MEASUREMENT_MODE_TPWM
                  TimChannelOneShotMode = 0
                  TimChannelPortPinSelect = NONE_SEL0
                  TimChannelSignalEdgeSelect = FALLING_EDGE
                  TimChannelTbu0Ts0BitsSelect = BITS_0_TO_23
                  TimChannelUsage = USED_BY_OTHER_DRIVERS_OR_UNUSED
                  TimChannelValInitSignal = VAL_LOW
                TimChannelInterrupt:
                  TimInterruptEnableOnCntOfl = 0
                  TimInterruptEnableOnEcntOfl = 0
                  TimInterruptEnableOnGlitchDet = 0
                  TimInterruptEnableOnGprxOfl = 0
                  TimInterruptEnableOnNewVal = 0
                  TimInterruptEnableOnToDet = 0
                  TimInterruptMode = GTM_INTERRUPT_LEVEL_MODE
                  TimNotification = NULL_PTR
                TimChannelTimeoutDetection: TimChTimeoutClockSelect=GTM_CONFIGURABLE_CLOCK_0, TimChTimeoutDetectionEnable=SEL0_TIMOUT_DISABLED, TimChTimeoutDuration=0
              TimChannel_3
                TimChannelErrorInterrupt:
                  TimInterruptEnableOnCntOflErr = 0
                  TimInterruptEnableOnEcntOflErr = 0
                  TimInterruptEnableOnGlitchDetErr = 0
                  TimInterruptEnableOnGprxOflErr = 0
                  TimInterruptEnableOnNewValErr = 0
                  TimInterruptEnableOnToDetErr = 0
                TimChannelFilterConfig:
                  TimChFilterCounterFreqSelect = GTM_CONFIGURABLE_CLOCK_0
                  TimChFilterModeForFallingEdge = IMMEDIATE_EDGE_PROPAGATION_MODE
                  TimChFilterModeForRisingEdge = IMMEDIATE_EDGE_PROPAGATION_MODE
                  TimChFilterTimeForFallingEdge = 0
                  TimChFilterTimeForRisingEdge = 0
                  TimChannelFilterEnable = 0
                TimChannelGeneral:
                  TimChannelAruEnable = 0
                  TimChannelClockSelect = GTM_CONFIGURABLE_CLOCK_0
                  TimChannelCntsInputSelect = CNT_VALUE
                  TimChannelCntsValue = 0
                  TimChannelEcntOvflwSetting = SEL0_OVRFLOW_SIG_ON_ECNT_BITWIDTH_8
                  TimChannelEcntResetSetting = SEL0_ECNT_IN_WRAP_AROUND_MODE
                  TimChannelEnable = 0
                  TimChannelExtCaptureModeEnable = 0
                  TimChannelExtCaptureSrc = SEL0_NEW_VAL_IRQ
                  TimChannelGpr0InputSelect = TIMEBASE_TBU_TS0
                  TimChannelGpr1InputSelect = TIMEBASE_TBU_TS0
                  TimChannelInputSelect = INPUT_OF_CURRENT_TIM_CHANNEL
                  TimChannelModeSelect = PWM_MEASUREMENT_MODE_TPWM
                  TimChannelOneShotMode = 0
                  TimChannelPortPinSelect = NONE_SEL0
                  TimChannelSignalEdgeSelect = FALLING_EDGE
                  TimChannelTbu0Ts0BitsSelect = BITS_0_TO_23
                  TimChannelUsage = USED_BY_OTHER_DRIVERS_OR_UNUSED
                  TimChannelValInitSignal = VAL_LOW
                TimChannelInterrupt:
                  TimInterruptEnableOnCntOfl = 0
                  TimInterruptEnableOnEcntOfl = 0
                  TimInterruptEnableOnGlitchDet = 0
                  TimInterruptEnableOnGprxOfl = 0
                  TimInterruptEnableOnNewVal = 0
                  TimInterruptEnableOnToDet = 0
                  TimInterruptMode = GTM_INTERRUPT_LEVEL_MODE
                  TimNotification = NULL_PTR
                TimChannelTimeoutDetection: TimChTimeoutClockSelect=GTM_CONFIGURABLE_CLOCK_0, TimChTimeoutDetectionEnable=SEL0_TIMOUT_DISABLED, TimChTimeoutDuration=0
              TimChannel_4
                TimChannelErrorInterrupt:
                  TimInterruptEnableOnCntOflErr = 0
                  TimInterruptEnableOnEcntOflErr = 0
                  TimInterruptEnableOnGlitchDetErr = 0
                  TimInterruptEnableOnGprxOflErr = 0
                  TimInterruptEnableOnNewValErr = 0
                  TimInterruptEnableOnToDetErr = 0
                TimChannelFilterConfig:
                  TimChFilterCounterFreqSelect = GTM_CONFIGURABLE_CLOCK_0
                  TimChFilterModeForFallingEdge = IMMEDIATE_EDGE_PROPAGATION_MODE
                  TimChFilterModeForRisingEdge = IMMEDIATE_EDGE_PROPAGATION_MODE
                  TimChFilterTimeForFallingEdge = 0
                  TimChFilterTimeForRisingEdge = 0
                  TimChannelFilterEnable = 0
                TimChannelGeneral:
                  TimChannelAruEnable = 0
                  TimChannelClockSelect = GTM_CONFIGURABLE_CLOCK_0
                  TimChannelCntsInputSelect = CNT_VALUE
                  TimChannelCntsValue = 0
                  TimChannelEcntOvflwSetting = SEL0_OVRFLOW_SIG_ON_ECNT_BITWIDTH_8
                  TimChannelEcntResetSetting = SEL0_ECNT_IN_WRAP_AROUND_MODE
                  TimChannelEnable = 0
                  TimChannelExtCaptureModeEnable = 0
                  TimChannelExtCaptureSrc = SEL0_NEW_VAL_IRQ
                  TimChannelGpr0InputSelect = TIMEBASE_TBU_TS0
                  TimChannelGpr1InputSelect = TIMEBASE_TBU_TS0
                  TimChannelInputSelect = INPUT_OF_CURRENT_TIM_CHANNEL
                  TimChannelModeSelect = PWM_MEASUREMENT_MODE_TPWM
                  TimChannelOneShotMode = 0
                  TimChannelPortPinSelect = NONE_SEL0
                  TimChannelSignalEdgeSelect = FALLING_EDGE
                  TimChannelTbu0Ts0BitsSelect = BITS_0_TO_23
                  TimChannelUsage = USED_BY_OTHER_DRIVERS_OR_UNUSED
                  TimChannelValInitSignal = VAL_LOW
                TimChannelInterrupt:
                  TimInterruptEnableOnCntOfl = 0
                  TimInterruptEnableOnEcntOfl = 0
                  TimInterruptEnableOnGlitchDet = 0
                  TimInterruptEnableOnGprxOfl = 0
                  TimInterruptEnableOnNewVal = 0
                  TimInterruptEnableOnToDet = 0
                  TimInterruptMode = GTM_INTERRUPT_LEVEL_MODE
                  TimNotification = NULL_PTR
                TimChannelTimeoutDetection: TimChTimeoutClockSelect=GTM_CONFIGURABLE_CLOCK_0, TimChTimeoutDetectionEnable=SEL0_TIMOUT_DISABLED, TimChTimeoutDuration=0
              TimChannel_5
                TimChannelErrorInterrupt:
                  TimInterruptEnableOnCntOflErr = 0
                  TimInterruptEnableOnEcntOflErr = 0
                  TimInterruptEnableOnGlitchDetErr = 0
                  TimInterruptEnableOnGprxOflErr = 0
                  TimInterruptEnableOnNewValErr = 0
                  TimInterruptEnableOnToDetErr = 0
                TimChannelFilterConfig:
                  TimChFilterCounterFreqSelect = GTM_CONFIGURABLE_CLOCK_0
                  TimChFilterModeForFallingEdge = IMMEDIATE_EDGE_PROPAGATION_MODE
                  TimChFilterModeForRisingEdge = IMMEDIATE_EDGE_PROPAGATION_MODE
                  TimChFilterTimeForFallingEdge = 0
                  TimChFilterTimeForRisingEdge = 0
                  TimChannelFilterEnable = 0
                TimChannelGeneral:
                  TimChannelAruEnable = 0
                  TimChannelClockSelect = GTM_CONFIGURABLE_CLOCK_0
                  TimChannelCntsInputSelect = CNT_VALUE
                  TimChannelCntsValue = 0
                  TimChannelEcntOvflwSetting = SEL0_OVRFLOW_SIG_ON_ECNT_BITWIDTH_8
                  TimChannelEcntResetSetting = SEL0_ECNT_IN_WRAP_AROUND_MODE
                  TimChannelEnable = 0
                  TimChannelExtCaptureModeEnable = 0
                  TimChannelExtCaptureSrc = SEL0_NEW_VAL_IRQ
                  TimChannelGpr0InputSelect = TIMEBASE_TBU_TS0
                  TimChannelGpr1InputSelect = TIMEBASE_TBU_TS0
                  TimChannelInputSelect = INPUT_OF_CURRENT_TIM_CHANNEL
                  TimChannelModeSelect = PWM_MEASUREMENT_MODE_TPWM
                  TimChannelOneShotMode = 0
                  TimChannelPortPinSelect = NONE_SEL0
                  TimChannelSignalEdgeSelect = FALLING_EDGE
                  TimChannelTbu0Ts0BitsSelect = BITS_0_TO_23
                  TimChannelUsage = USED_BY_OTHER_DRIVERS_OR_UNUSED
                  TimChannelValInitSignal = VAL_LOW
                TimChannelInterrupt:
                  TimInterruptEnableOnCntOfl = 0
                  TimInterruptEnableOnEcntOfl = 0
                  TimInterruptEnableOnGlitchDet = 0
                  TimInterruptEnableOnGprxOfl = 0
                  TimInterruptEnableOnNewVal = 0
                  TimInterruptEnableOnToDet = 0
                  TimInterruptMode = GTM_INTERRUPT_LEVEL_MODE
                  TimNotification = NULL_PTR
                TimChannelTimeoutDetection: TimChTimeoutClockSelect=GTM_CONFIGURABLE_CLOCK_0, TimChTimeoutDetectionEnable=SEL0_TIMOUT_DISABLED, TimChTimeoutDuration=0
              TimChannel_6
                TimChannelErrorInterrupt:
                  TimInterruptEnableOnCntOflErr = 0
                  TimInterruptEnableOnEcntOflErr = 0
                  TimInterruptEnableOnGlitchDetErr = 0
                  TimInterruptEnableOnGprxOflErr = 0
                  TimInterruptEnableOnNewValErr = 0
                  TimInterruptEnableOnToDetErr = 0
                TimChannelFilterConfig:
                  TimChFilterCounterFreqSelect = GTM_CONFIGURABLE_CLOCK_0
                  TimChFilterModeForFallingEdge = IMMEDIATE_EDGE_PROPAGATION_MODE
                  TimChFilterModeForRisingEdge = IMMEDIATE_EDGE_PROPAGATION_MODE
                  TimChFilterTimeForFallingEdge = 0
                  TimChFilterTimeForRisingEdge = 0
                  TimChannelFilterEnable = 0
                TimChannelGeneral:
                  TimChannelAruEnable = 0
                  TimChannelClockSelect = GTM_CONFIGURABLE_CLOCK_0
                  TimChannelCntsInputSelect = CNT_VALUE
                  TimChannelCntsValue = 0
                  TimChannelEcntOvflwSetting = SEL0_OVRFLOW_SIG_ON_ECNT_BITWIDTH_8
                  TimChannelEcntResetSetting = SEL0_ECNT_IN_WRAP_AROUND_MODE
                  TimChannelEnable = 0
                  TimChannelExtCaptureModeEnable = 0
                  TimChannelExtCaptureSrc = SEL0_NEW_VAL_IRQ
                  TimChannelGpr0InputSelect = TIMEBASE_TBU_TS0
                  TimChannelGpr1InputSelect = TIMEBASE_TBU_TS0
                  TimChannelInputSelect = INPUT_OF_CURRENT_TIM_CHANNEL
                  TimChannelModeSelect = PWM_MEASUREMENT_MODE_TPWM
                  TimChannelOneShotMode = 0
                  TimChannelPortPinSelect = NONE_SEL0
                  TimChannelSignalEdgeSelect = FALLING_EDGE
                  TimChannelTbu0Ts0BitsSelect = BITS_0_TO_23
                  TimChannelUsage = USED_BY_OTHER_DRIVERS_OR_UNUSED
                  TimChannelValInitSignal = VAL_LOW
                TimChannelInterrupt:
                  TimInterruptEnableOnCntOfl = 0
                  TimInterruptEnableOnEcntOfl = 0
                  TimInterruptEnableOnGlitchDet = 0
                  TimInterruptEnableOnGprxOfl = 0
                  TimInterruptEnableOnNewVal = 0
                  TimInterruptEnableOnToDet = 0
                  TimInterruptMode = GTM_INTERRUPT_LEVEL_MODE
                  TimNotification = NULL_PTR
                TimChannelTimeoutDetection: TimChTimeoutClockSelect=GTM_CONFIGURABLE_CLOCK_0, TimChTimeoutDetectionEnable=SEL0_TIMOUT_DISABLED, TimChTimeoutDuration=0
              TimChannel_7
                TimChannelErrorInterrupt:
                  TimInterruptEnableOnCntOflErr = 0
                  TimInterruptEnableOnEcntOflErr = 0
                  TimInterruptEnableOnGlitchDetErr = 0
                  TimInterruptEnableOnGprxOflErr = 0
                  TimInterruptEnableOnNewValErr = 0
                  TimInterruptEnableOnToDetErr = 0
                TimChannelFilterConfig:
                  TimChFilterCounterFreqSelect = GTM_CONFIGURABLE_CLOCK_0
                  TimChFilterModeForFallingEdge = IMMEDIATE_EDGE_PROPAGATION_MODE
                  TimChFilterModeForRisingEdge = IMMEDIATE_EDGE_PROPAGATION_MODE
                  TimChFilterTimeForFallingEdge = 0
                  TimChFilterTimeForRisingEdge = 0
                  TimChannelFilterEnable = 0
                TimChannelGeneral:
                  TimChannelAruEnable = 0
                  TimChannelClockSelect = GTM_CONFIGURABLE_CLOCK_0
                  TimChannelCntsInputSelect = CNT_VALUE
                  TimChannelCntsValue = 0
                  TimChannelEcntOvflwSetting = SEL0_OVRFLOW_SIG_ON_ECNT_BITWIDTH_8
                  TimChannelEcntResetSetting = SEL0_ECNT_IN_WRAP_AROUND_MODE
                  TimChannelEnable = 0
                  TimChannelExtCaptureModeEnable = 0
                  TimChannelExtCaptureSrc = SEL0_NEW_VAL_IRQ
                  TimChannelGpr0InputSelect = TIMEBASE_TBU_TS0
                  TimChannelGpr1InputSelect = TIMEBASE_TBU_TS0
                  TimChannelInputSelect = INPUT_OF_CURRENT_TIM_CHANNEL
                  TimChannelModeSelect = PWM_MEASUREMENT_MODE_TPWM
                  TimChannelOneShotMode = 0
                  TimChannelPortPinSelect = NONE_SEL0
                  TimChannelSignalEdgeSelect = FALLING_EDGE
                  TimChannelTbu0Ts0BitsSelect = BITS_0_TO_23
                  TimChannelUsage = USED_BY_OTHER_DRIVERS_OR_UNUSED
                  TimChannelValInitSignal = VAL_LOW
                TimChannelInterrupt:
                  TimInterruptEnableOnCntOfl = 0
                  TimInterruptEnableOnEcntOfl = 0
                  TimInterruptEnableOnGlitchDet = 0
                  TimInterruptEnableOnGprxOfl = 0
                  TimInterruptEnableOnNewVal = 0
                  TimInterruptEnableOnToDet = 0
                  TimInterruptMode = GTM_INTERRUPT_LEVEL_MODE
                  TimNotification = NULL_PTR
                TimChannelTimeoutDetection: TimChTimeoutClockSelect=GTM_CONFIGURABLE_CLOCK_0, TimChTimeoutDetectionEnable=SEL0_TIMOUT_DISABLED, TimChTimeoutDuration=0
          Tim_1
            8 x TimChannel:
              TimChannel_0
                TimChannelErrorInterrupt:
                  TimInterruptEnableOnCntOflErr = 0
                  TimInterruptEnableOnEcntOflErr = 0
                  TimInterruptEnableOnGlitchDetErr = 0
                  TimInterruptEnableOnGprxOflErr = 0
                  TimInterruptEnableOnNewValErr = 0
                  TimInterruptEnableOnToDetErr = 0
                TimChannelFilterConfig:
                  TimChFilterCounterFreqSelect = GTM_CONFIGURABLE_CLOCK_0
                  TimChFilterModeForFallingEdge = IMMEDIATE_EDGE_PROPAGATION_MODE
                  TimChFilterModeForRisingEdge = IMMEDIATE_EDGE_PROPAGATION_MODE
                  TimChFilterTimeForFallingEdge = 0
                  TimChFilterTimeForRisingEdge = 0
                  TimChannelFilterEnable = 0
                TimChannelGeneral:
                  TimChannelAruEnable = 0
                  TimChannelClockSelect = GTM_CONFIGURABLE_CLOCK_0
                  TimChannelCntsInputSelect = CNT_VALUE
                  TimChannelCntsValue = 0
                  TimChannelEcntOvflwSetting = SEL0_OVRFLOW_SIG_ON_ECNT_BITWIDTH_8
                  TimChannelEcntResetSetting = SEL0_ECNT_IN_WRAP_AROUND_MODE
                  TimChannelEnable = 0
                  TimChannelExtCaptureModeEnable = 0
                  TimChannelExtCaptureSrc = SEL0_NEW_VAL_IRQ
                  TimChannelGpr0InputSelect = TIMEBASE_TBU_TS0
                  TimChannelGpr1InputSelect = TIMEBASE_TBU_TS0
                  TimChannelInputSelect = INPUT_OF_CURRENT_TIM_CHANNEL
                  TimChannelModeSelect = PWM_MEASUREMENT_MODE_TPWM
                  TimChannelOneShotMode = 0
                  TimChannelPortPinSelect = NONE_SEL0
                  TimChannelSignalEdgeSelect = FALLING_EDGE
                  TimChannelTbu0Ts0BitsSelect = BITS_0_TO_23
                  TimChannelUsage = USED_BY_OTHER_DRIVERS_OR_UNUSED
                  TimChannelValInitSignal = VAL_LOW
                TimChannelInterrupt:
                  TimInterruptEnableOnCntOfl = 0
                  TimInterruptEnableOnEcntOfl = 0
                  TimInterruptEnableOnGlitchDet = 0
                  TimInterruptEnableOnGprxOfl = 0
                  TimInterruptEnableOnNewVal = 0
                  TimInterruptEnableOnToDet = 0
                  TimInterruptMode = GTM_INTERRUPT_LEVEL_MODE
                  TimNotification = NULL_PTR
                TimChannelTimeoutDetection: TimChTimeoutClockSelect=GTM_CONFIGURABLE_CLOCK_0, TimChTimeoutDetectionEnable=SEL0_TIMOUT_DISABLED, TimChTimeoutDuration=0
              TimChannel_1
                TimChannelErrorInterrupt:
                  TimInterruptEnableOnCntOflErr = 0
                  TimInterruptEnableOnEcntOflErr = 0
                  TimInterruptEnableOnGlitchDetErr = 0
                  TimInterruptEnableOnGprxOflErr = 0
                  TimInterruptEnableOnNewValErr = 0
                  TimInterruptEnableOnToDetErr = 0
                TimChannelFilterConfig:
                  TimChFilterCounterFreqSelect = GTM_CONFIGURABLE_CLOCK_0
                  TimChFilterModeForFallingEdge = IMMEDIATE_EDGE_PROPAGATION_MODE
                  TimChFilterModeForRisingEdge = IMMEDIATE_EDGE_PROPAGATION_MODE
                  TimChFilterTimeForFallingEdge = 0
                  TimChFilterTimeForRisingEdge = 0
                  TimChannelFilterEnable = 0
                TimChannelGeneral:
                  TimChannelAruEnable = 0
                  TimChannelClockSelect = GTM_CONFIGURABLE_CLOCK_0
                  TimChannelCntsInputSelect = CNT_VALUE
                  TimChannelCntsValue = 0
                  TimChannelEcntOvflwSetting = SEL0_OVRFLOW_SIG_ON_ECNT_BITWIDTH_8
                  TimChannelEcntResetSetting = SEL0_ECNT_IN_WRAP_AROUND_MODE
                  TimChannelEnable = 0
                  TimChannelExtCaptureModeEnable = 0
                  TimChannelExtCaptureSrc = SEL0_NEW_VAL_IRQ
                  TimChannelGpr0InputSelect = TIMEBASE_TBU_TS0
                  TimChannelGpr1InputSelect = TIMEBASE_TBU_TS0
                  TimChannelInputSelect = INPUT_OF_CURRENT_TIM_CHANNEL
                  TimChannelModeSelect = PWM_MEASUREMENT_MODE_TPWM
                  TimChannelOneShotMode = 0
                  TimChannelPortPinSelect = NONE_SEL0
                  TimChannelSignalEdgeSelect = FALLING_EDGE
                  TimChannelTbu0Ts0BitsSelect = BITS_0_TO_23
                  TimChannelUsage = USED_BY_OTHER_DRIVERS_OR_UNUSED
                  TimChannelValInitSignal = VAL_LOW
                TimChannelInterrupt:
                  TimInterruptEnableOnCntOfl = 0
                  TimInterruptEnableOnEcntOfl = 0
                  TimInterruptEnableOnGlitchDet = 0
                  TimInterruptEnableOnGprxOfl = 0
                  TimInterruptEnableOnNewVal = 0
                  TimInterruptEnableOnToDet = 0
                  TimInterruptMode = GTM_INTERRUPT_LEVEL_MODE
                  TimNotification = NULL_PTR
                TimChannelTimeoutDetection: TimChTimeoutClockSelect=GTM_CONFIGURABLE_CLOCK_0, TimChTimeoutDetectionEnable=SEL0_TIMOUT_DISABLED, TimChTimeoutDuration=0
              TimChannel_2
                TimChannelErrorInterrupt:
                  TimInterruptEnableOnCntOflErr = 0
                  TimInterruptEnableOnEcntOflErr = 0
                  TimInterruptEnableOnGlitchDetErr = 0
                  TimInterruptEnableOnGprxOflErr = 0
                  TimInterruptEnableOnNewValErr = 0
                  TimInterruptEnableOnToDetErr = 0
                TimChannelFilterConfig:
                  TimChFilterCounterFreqSelect = GTM_CONFIGURABLE_CLOCK_0
                  TimChFilterModeForFallingEdge = IMMEDIATE_EDGE_PROPAGATION_MODE
                  TimChFilterModeForRisingEdge = IMMEDIATE_EDGE_PROPAGATION_MODE
                  TimChFilterTimeForFallingEdge = 0
                  TimChFilterTimeForRisingEdge = 0
                  TimChannelFilterEnable = 0
                TimChannelGeneral:
                  TimChannelAruEnable = 0
                  TimChannelClockSelect = GTM_CONFIGURABLE_CLOCK_0
                  TimChannelCntsInputSelect = CNT_VALUE
                  TimChannelCntsValue = 0
                  TimChannelEcntOvflwSetting = SEL0_OVRFLOW_SIG_ON_ECNT_BITWIDTH_8
                  TimChannelEcntResetSetting = SEL0_ECNT_IN_WRAP_AROUND_MODE
                  TimChannelEnable = 0
                  TimChannelExtCaptureModeEnable = 0
                  TimChannelExtCaptureSrc = SEL0_NEW_VAL_IRQ
                  TimChannelGpr0InputSelect = TIMEBASE_TBU_TS0
                  TimChannelGpr1InputSelect = TIMEBASE_TBU_TS0
                  TimChannelInputSelect = INPUT_OF_CURRENT_TIM_CHANNEL
                  TimChannelModeSelect = PWM_MEASUREMENT_MODE_TPWM
                  TimChannelOneShotMode = 0
                  TimChannelPortPinSelect = NONE_SEL0
                  TimChannelSignalEdgeSelect = FALLING_EDGE
                  TimChannelTbu0Ts0BitsSelect = BITS_0_TO_23
                  TimChannelUsage = USED_BY_OTHER_DRIVERS_OR_UNUSED
                  TimChannelValInitSignal = VAL_LOW
                TimChannelInterrupt:
                  TimInterruptEnableOnCntOfl = 0
                  TimInterruptEnableOnEcntOfl = 0
                  TimInterruptEnableOnGlitchDet = 0
                  TimInterruptEnableOnGprxOfl = 0
                  TimInterruptEnableOnNewVal = 0
                  TimInterruptEnableOnToDet = 0
                  TimInterruptMode = GTM_INTERRUPT_LEVEL_MODE
                  TimNotification = NULL_PTR
                TimChannelTimeoutDetection: TimChTimeoutClockSelect=GTM_CONFIGURABLE_CLOCK_0, TimChTimeoutDetectionEnable=SEL0_TIMOUT_DISABLED, TimChTimeoutDuration=0
              TimChannel_3
                TimChannelErrorInterrupt:
                  TimInterruptEnableOnCntOflErr = 0
                  TimInterruptEnableOnEcntOflErr = 0
                  TimInterruptEnableOnGlitchDetErr = 0
                  TimInterruptEnableOnGprxOflErr = 0
                  TimInterruptEnableOnNewValErr = 0
                  TimInterruptEnableOnToDetErr = 0
                TimChannelFilterConfig:
                  TimChFilterCounterFreqSelect = GTM_CONFIGURABLE_CLOCK_0
                  TimChFilterModeForFallingEdge = IMMEDIATE_EDGE_PROPAGATION_MODE
                  TimChFilterModeForRisingEdge = IMMEDIATE_EDGE_PROPAGATION_MODE
                  TimChFilterTimeForFallingEdge = 0
                  TimChFilterTimeForRisingEdge = 0
                  TimChannelFilterEnable = 0
                TimChannelGeneral:
                  TimChannelAruEnable = 0
                  TimChannelClockSelect = GTM_CONFIGURABLE_CLOCK_0
                  TimChannelCntsInputSelect = CNT_VALUE
                  TimChannelCntsValue = 0
                  TimChannelEcntOvflwSetting = SEL0_OVRFLOW_SIG_ON_ECNT_BITWIDTH_8
                  TimChannelEcntResetSetting = SEL0_ECNT_IN_WRAP_AROUND_MODE
                  TimChannelEnable = 0
                  TimChannelExtCaptureModeEnable = 0
                  TimChannelExtCaptureSrc = SEL0_NEW_VAL_IRQ
                  TimChannelGpr0InputSelect = TIMEBASE_TBU_TS0
                  TimChannelGpr1InputSelect = TIMEBASE_TBU_TS0
                  TimChannelInputSelect = INPUT_OF_CURRENT_TIM_CHANNEL
                  TimChannelModeSelect = PWM_MEASUREMENT_MODE_TPWM
                  TimChannelOneShotMode = 0
                  TimChannelPortPinSelect = NONE_SEL0
                  TimChannelSignalEdgeSelect = FALLING_EDGE
                  TimChannelTbu0Ts0BitsSelect = BITS_0_TO_23
                  TimChannelUsage = USED_BY_OTHER_DRIVERS_OR_UNUSED
                  TimChannelValInitSignal = VAL_LOW
                TimChannelInterrupt:
                  TimInterruptEnableOnCntOfl = 0
                  TimInterruptEnableOnEcntOfl = 0
                  TimInterruptEnableOnGlitchDet = 0
                  TimInterruptEnableOnGprxOfl = 0
                  TimInterruptEnableOnNewVal = 0
                  TimInterruptEnableOnToDet = 0
                  TimInterruptMode = GTM_INTERRUPT_LEVEL_MODE
                  TimNotification = NULL_PTR
                TimChannelTimeoutDetection: TimChTimeoutClockSelect=GTM_CONFIGURABLE_CLOCK_0, TimChTimeoutDetectionEnable=SEL0_TIMOUT_DISABLED, TimChTimeoutDuration=0
              TimChannel_4
                TimChannelErrorInterrupt:
                  TimInterruptEnableOnCntOflErr = 0
                  TimInterruptEnableOnEcntOflErr = 0
                  TimInterruptEnableOnGlitchDetErr = 0
                  TimInterruptEnableOnGprxOflErr = 0
                  TimInterruptEnableOnNewValErr = 0
                  TimInterruptEnableOnToDetErr = 0
                TimChannelFilterConfig:
                  TimChFilterCounterFreqSelect = GTM_CONFIGURABLE_CLOCK_0
                  TimChFilterModeForFallingEdge = IMMEDIATE_EDGE_PROPAGATION_MODE
                  TimChFilterModeForRisingEdge = IMMEDIATE_EDGE_PROPAGATION_MODE
                  TimChFilterTimeForFallingEdge = 0
                  TimChFilterTimeForRisingEdge = 0
                  TimChannelFilterEnable = 0
                TimChannelGeneral:
                  TimChannelAruEnable = 0
                  TimChannelClockSelect = GTM_CONFIGURABLE_CLOCK_0
                  TimChannelCntsInputSelect = CNT_VALUE
                  TimChannelCntsValue = 0
                  TimChannelEcntOvflwSetting = SEL0_OVRFLOW_SIG_ON_ECNT_BITWIDTH_8
                  TimChannelEcntResetSetting = SEL0_ECNT_IN_WRAP_AROUND_MODE
                  TimChannelEnable = 0
                  TimChannelExtCaptureModeEnable = 0
                  TimChannelExtCaptureSrc = SEL0_NEW_VAL_IRQ
                  TimChannelGpr0InputSelect = TIMEBASE_TBU_TS0
                  TimChannelGpr1InputSelect = TIMEBASE_TBU_TS0
                  TimChannelInputSelect = INPUT_OF_CURRENT_TIM_CHANNEL
                  TimChannelModeSelect = PWM_MEASUREMENT_MODE_TPWM
                  TimChannelOneShotMode = 0
                  TimChannelPortPinSelect = NONE_SEL0
                  TimChannelSignalEdgeSelect = FALLING_EDGE
                  TimChannelTbu0Ts0BitsSelect = BITS_0_TO_23
                  TimChannelUsage = USED_BY_OTHER_DRIVERS_OR_UNUSED
                  TimChannelValInitSignal = VAL_LOW
                TimChannelInterrupt:
                  TimInterruptEnableOnCntOfl = 0
                  TimInterruptEnableOnEcntOfl = 0
                  TimInterruptEnableOnGlitchDet = 0
                  TimInterruptEnableOnGprxOfl = 0
                  TimInterruptEnableOnNewVal = 0
                  TimInterruptEnableOnToDet = 0
                  TimInterruptMode = GTM_INTERRUPT_LEVEL_MODE
                  TimNotification = NULL_PTR
                TimChannelTimeoutDetection: TimChTimeoutClockSelect=GTM_CONFIGURABLE_CLOCK_0, TimChTimeoutDetectionEnable=SEL0_TIMOUT_DISABLED, TimChTimeoutDuration=0
              TimChannel_5
                TimChannelErrorInterrupt:
                  TimInterruptEnableOnCntOflErr = 0
                  TimInterruptEnableOnEcntOflErr = 0
                  TimInterruptEnableOnGlitchDetErr = 0
                  TimInterruptEnableOnGprxOflErr = 0
                  TimInterruptEnableOnNewValErr = 0
                  TimInterruptEnableOnToDetErr = 0
                TimChannelFilterConfig:
                  TimChFilterCounterFreqSelect = GTM_CONFIGURABLE_CLOCK_0
                  TimChFilterModeForFallingEdge = IMMEDIATE_EDGE_PROPAGATION_MODE
                  TimChFilterModeForRisingEdge = IMMEDIATE_EDGE_PROPAGATION_MODE
                  TimChFilterTimeForFallingEdge = 0
                  TimChFilterTimeForRisingEdge = 0
                  TimChannelFilterEnable = 0
                TimChannelGeneral:
                  TimChannelAruEnable = 0
                  TimChannelClockSelect = GTM_CONFIGURABLE_CLOCK_0
                  TimChannelCntsInputSelect = CNT_VALUE
                  TimChannelCntsValue = 0
                  TimChannelEcntOvflwSetting = SEL0_OVRFLOW_SIG_ON_ECNT_BITWIDTH_8
                  TimChannelEcntResetSetting = SEL0_ECNT_IN_WRAP_AROUND_MODE
                  TimChannelEnable = 0
                  TimChannelExtCaptureModeEnable = 0
                  TimChannelExtCaptureSrc = SEL0_NEW_VAL_IRQ
                  TimChannelGpr0InputSelect = TIMEBASE_TBU_TS0
                  TimChannelGpr1InputSelect = TIMEBASE_TBU_TS0
                  TimChannelInputSelect = INPUT_OF_CURRENT_TIM_CHANNEL
                  TimChannelModeSelect = PWM_MEASUREMENT_MODE_TPWM
                  TimChannelOneShotMode = 0
                  TimChannelPortPinSelect = NONE_SEL0
                  TimChannelSignalEdgeSelect = FALLING_EDGE
                  TimChannelTbu0Ts0BitsSelect = BITS_0_TO_23
                  TimChannelUsage = USED_BY_OTHER_DRIVERS_OR_UNUSED
                  TimChannelValInitSignal = VAL_LOW
                TimChannelInterrupt:
                  TimInterruptEnableOnCntOfl = 0
                  TimInterruptEnableOnEcntOfl = 0
                  TimInterruptEnableOnGlitchDet = 0
                  TimInterruptEnableOnGprxOfl = 0
                  TimInterruptEnableOnNewVal = 0
                  TimInterruptEnableOnToDet = 0
                  TimInterruptMode = GTM_INTERRUPT_LEVEL_MODE
                  TimNotification = NULL_PTR
                TimChannelTimeoutDetection: TimChTimeoutClockSelect=GTM_CONFIGURABLE_CLOCK_0, TimChTimeoutDetectionEnable=SEL0_TIMOUT_DISABLED, TimChTimeoutDuration=0
              TimChannel_6
                TimChannelErrorInterrupt:
                  TimInterruptEnableOnCntOflErr = 0
                  TimInterruptEnableOnEcntOflErr = 0
                  TimInterruptEnableOnGlitchDetErr = 0
                  TimInterruptEnableOnGprxOflErr = 0
                  TimInterruptEnableOnNewValErr = 0
                  TimInterruptEnableOnToDetErr = 0
                TimChannelFilterConfig:
                  TimChFilterCounterFreqSelect = GTM_CONFIGURABLE_CLOCK_0
                  TimChFilterModeForFallingEdge = IMMEDIATE_EDGE_PROPAGATION_MODE
                  TimChFilterModeForRisingEdge = IMMEDIATE_EDGE_PROPAGATION_MODE
                  TimChFilterTimeForFallingEdge = 0
                  TimChFilterTimeForRisingEdge = 0
                  TimChannelFilterEnable = 0
                TimChannelGeneral:
                  TimChannelAruEnable = 0
                  TimChannelClockSelect = GTM_CONFIGURABLE_CLOCK_0
                  TimChannelCntsInputSelect = CNT_VALUE
                  TimChannelCntsValue = 0
                  TimChannelEcntOvflwSetting = SEL0_OVRFLOW_SIG_ON_ECNT_BITWIDTH_8
                  TimChannelEcntResetSetting = SEL0_ECNT_IN_WRAP_AROUND_MODE
                  TimChannelEnable = 0
                  TimChannelExtCaptureModeEnable = 0
                  TimChannelExtCaptureSrc = SEL0_NEW_VAL_IRQ
                  TimChannelGpr0InputSelect = TIMEBASE_TBU_TS0
                  TimChannelGpr1InputSelect = TIMEBASE_TBU_TS0
                  TimChannelInputSelect = INPUT_OF_CURRENT_TIM_CHANNEL
                  TimChannelModeSelect = PWM_MEASUREMENT_MODE_TPWM
                  TimChannelOneShotMode = 0
                  TimChannelPortPinSelect = NONE_SEL0
                  TimChannelSignalEdgeSelect = FALLING_EDGE
                  TimChannelTbu0Ts0BitsSelect = BITS_0_TO_23
                  TimChannelUsage = USED_BY_OTHER_DRIVERS_OR_UNUSED
                  TimChannelValInitSignal = VAL_LOW
                TimChannelInterrupt:
                  TimInterruptEnableOnCntOfl = 0
                  TimInterruptEnableOnEcntOfl = 0
                  TimInterruptEnableOnGlitchDet = 0
                  TimInterruptEnableOnGprxOfl = 0
                  TimInterruptEnableOnNewVal = 0
                  TimInterruptEnableOnToDet = 0
                  TimInterruptMode = GTM_INTERRUPT_LEVEL_MODE
                  TimNotification = NULL_PTR
                TimChannelTimeoutDetection: TimChTimeoutClockSelect=GTM_CONFIGURABLE_CLOCK_0, TimChTimeoutDetectionEnable=SEL0_TIMOUT_DISABLED, TimChTimeoutDuration=0
              TimChannel_7
                TimChannelErrorInterrupt:
                  TimInterruptEnableOnCntOflErr = 0
                  TimInterruptEnableOnEcntOflErr = 0
                  TimInterruptEnableOnGlitchDetErr = 0
                  TimInterruptEnableOnGprxOflErr = 0
                  TimInterruptEnableOnNewValErr = 0
                  TimInterruptEnableOnToDetErr = 0
                TimChannelFilterConfig:
                  TimChFilterCounterFreqSelect = GTM_CONFIGURABLE_CLOCK_0
                  TimChFilterModeForFallingEdge = IMMEDIATE_EDGE_PROPAGATION_MODE
                  TimChFilterModeForRisingEdge = IMMEDIATE_EDGE_PROPAGATION_MODE
                  TimChFilterTimeForFallingEdge = 0
                  TimChFilterTimeForRisingEdge = 0
                  TimChannelFilterEnable = 0
                TimChannelGeneral:
                  TimChannelAruEnable = 0
                  TimChannelClockSelect = GTM_CONFIGURABLE_CLOCK_0
                  TimChannelCntsInputSelect = CNT_VALUE
                  TimChannelCntsValue = 0
                  TimChannelEcntOvflwSetting = SEL0_OVRFLOW_SIG_ON_ECNT_BITWIDTH_8
                  TimChannelEcntResetSetting = SEL0_ECNT_IN_WRAP_AROUND_MODE
                  TimChannelEnable = 0
                  TimChannelExtCaptureModeEnable = 0
                  TimChannelExtCaptureSrc = SEL0_NEW_VAL_IRQ
                  TimChannelGpr0InputSelect = TIMEBASE_TBU_TS0
                  TimChannelGpr1InputSelect = TIMEBASE_TBU_TS0
                  TimChannelInputSelect = INPUT_OF_CURRENT_TIM_CHANNEL
                  TimChannelModeSelect = PWM_MEASUREMENT_MODE_TPWM
                  TimChannelOneShotMode = 0
                  TimChannelPortPinSelect = NONE_SEL0
                  TimChannelSignalEdgeSelect = FALLING_EDGE
                  TimChannelTbu0Ts0BitsSelect = BITS_0_TO_23
                  TimChannelUsage = USED_BY_OTHER_DRIVERS_OR_UNUSED
                  TimChannelValInitSignal = VAL_LOW
                TimChannelInterrupt:
                  TimInterruptEnableOnCntOfl = 0
                  TimInterruptEnableOnEcntOfl = 0
                  TimInterruptEnableOnGlitchDet = 0
                  TimInterruptEnableOnGprxOfl = 0
                  TimInterruptEnableOnNewVal = 0
                  TimInterruptEnableOnToDet = 0
                  TimInterruptMode = GTM_INTERRUPT_LEVEL_MODE
                  TimNotification = NULL_PTR
                TimChannelTimeoutDetection: TimChTimeoutClockSelect=GTM_CONFIGURABLE_CLOCK_0, TimChTimeoutDetectionEnable=SEL0_TIMOUT_DISABLED, TimChTimeoutDuration=0
          Tim_2
            8 x TimChannel:
              TimChannel_0
                TimChannelErrorInterrupt:
                  TimInterruptEnableOnCntOflErr = 0
                  TimInterruptEnableOnEcntOflErr = 0
                  TimInterruptEnableOnGlitchDetErr = 0
                  TimInterruptEnableOnGprxOflErr = 0
                  TimInterruptEnableOnNewValErr = 0
                  TimInterruptEnableOnToDetErr = 0
                TimChannelFilterConfig:
                  TimChFilterCounterFreqSelect = GTM_CONFIGURABLE_CLOCK_0
                  TimChFilterModeForFallingEdge = IMMEDIATE_EDGE_PROPAGATION_MODE
                  TimChFilterModeForRisingEdge = IMMEDIATE_EDGE_PROPAGATION_MODE
                  TimChFilterTimeForFallingEdge = 0
                  TimChFilterTimeForRisingEdge = 0
                  TimChannelFilterEnable = 0
                TimChannelGeneral:
                  TimChannelAruEnable = 0
                  TimChannelClockSelect = GTM_CONFIGURABLE_CLOCK_0
                  TimChannelCntsInputSelect = CNT_VALUE
                  TimChannelCntsValue = 0
                  TimChannelEcntOvflwSetting = SEL0_OVRFLOW_SIG_ON_ECNT_BITWIDTH_8
                  TimChannelEcntResetSetting = SEL0_ECNT_IN_WRAP_AROUND_MODE
                  TimChannelEnable = 0
                  TimChannelExtCaptureModeEnable = 0
                  TimChannelExtCaptureSrc = SEL0_NEW_VAL_IRQ
                  TimChannelGpr0InputSelect = TIMEBASE_TBU_TS0
                  TimChannelGpr1InputSelect = TIMEBASE_TBU_TS0
                  TimChannelInputSelect = INPUT_OF_CURRENT_TIM_CHANNEL
                  TimChannelModeSelect = PWM_MEASUREMENT_MODE_TPWM
                  TimChannelOneShotMode = 0
                  TimChannelPortPinSelect = NONE_SEL0
                  TimChannelSignalEdgeSelect = FALLING_EDGE
                  TimChannelTbu0Ts0BitsSelect = BITS_0_TO_23
                  TimChannelUsage = USED_BY_OTHER_DRIVERS_OR_UNUSED
                  TimChannelValInitSignal = VAL_LOW
                TimChannelInterrupt:
                  TimInterruptEnableOnCntOfl = 0
                  TimInterruptEnableOnEcntOfl = 0
                  TimInterruptEnableOnGlitchDet = 0
                  TimInterruptEnableOnGprxOfl = 0
                  TimInterruptEnableOnNewVal = 0
                  TimInterruptEnableOnToDet = 0
                  TimInterruptMode = GTM_INTERRUPT_LEVEL_MODE
                  TimNotification = NULL_PTR
                TimChannelTimeoutDetection: TimChTimeoutClockSelect=GTM_CONFIGURABLE_CLOCK_0, TimChTimeoutDetectionEnable=SEL0_TIMOUT_DISABLED, TimChTimeoutDuration=0
              TimChannel_1
                TimChannelErrorInterrupt:
                  TimInterruptEnableOnCntOflErr = 0
                  TimInterruptEnableOnEcntOflErr = 0
                  TimInterruptEnableOnGlitchDetErr = 0
                  TimInterruptEnableOnGprxOflErr = 0
                  TimInterruptEnableOnNewValErr = 0
                  TimInterruptEnableOnToDetErr = 0
                TimChannelFilterConfig:
                  TimChFilterCounterFreqSelect = GTM_CONFIGURABLE_CLOCK_0
                  TimChFilterModeForFallingEdge = IMMEDIATE_EDGE_PROPAGATION_MODE
                  TimChFilterModeForRisingEdge = IMMEDIATE_EDGE_PROPAGATION_MODE
                  TimChFilterTimeForFallingEdge = 0
                  TimChFilterTimeForRisingEdge = 0
                  TimChannelFilterEnable = 0
                TimChannelGeneral:
                  TimChannelAruEnable = 0
                  TimChannelClockSelect = GTM_CONFIGURABLE_CLOCK_0
                  TimChannelCntsInputSelect = CNT_VALUE
                  TimChannelCntsValue = 0
                  TimChannelEcntOvflwSetting = SEL0_OVRFLOW_SIG_ON_ECNT_BITWIDTH_8
                  TimChannelEcntResetSetting = SEL0_ECNT_IN_WRAP_AROUND_MODE
                  TimChannelEnable = 0
                  TimChannelExtCaptureModeEnable = 0
                  TimChannelExtCaptureSrc = SEL0_NEW_VAL_IRQ
                  TimChannelGpr0InputSelect = TIMEBASE_TBU_TS0
                  TimChannelGpr1InputSelect = TIMEBASE_TBU_TS0
                  TimChannelInputSelect = INPUT_OF_CURRENT_TIM_CHANNEL
                  TimChannelModeSelect = PWM_MEASUREMENT_MODE_TPWM
                  TimChannelOneShotMode = 0
                  TimChannelPortPinSelect = NONE_SEL0
                  TimChannelSignalEdgeSelect = FALLING_EDGE
                  TimChannelTbu0Ts0BitsSelect = BITS_0_TO_23
                  TimChannelUsage = USED_BY_OTHER_DRIVERS_OR_UNUSED
                  TimChannelValInitSignal = VAL_LOW
                TimChannelInterrupt:
                  TimInterruptEnableOnCntOfl = 0
                  TimInterruptEnableOnEcntOfl = 0
                  TimInterruptEnableOnGlitchDet = 0
                  TimInterruptEnableOnGprxOfl = 0
                  TimInterruptEnableOnNewVal = 0
                  TimInterruptEnableOnToDet = 0
                  TimInterruptMode = GTM_INTERRUPT_LEVEL_MODE
                  TimNotification = NULL_PTR
                TimChannelTimeoutDetection: TimChTimeoutClockSelect=GTM_CONFIGURABLE_CLOCK_0, TimChTimeoutDetectionEnable=SEL0_TIMOUT_DISABLED, TimChTimeoutDuration=0
              TimChannel_2
                TimChannelErrorInterrupt:
                  TimInterruptEnableOnCntOflErr = 0
                  TimInterruptEnableOnEcntOflErr = 0
                  TimInterruptEnableOnGlitchDetErr = 0
                  TimInterruptEnableOnGprxOflErr = 0
                  TimInterruptEnableOnNewValErr = 0
                  TimInterruptEnableOnToDetErr = 0
                TimChannelFilterConfig:
                  TimChFilterCounterFreqSelect = GTM_CONFIGURABLE_CLOCK_0
                  TimChFilterModeForFallingEdge = IMMEDIATE_EDGE_PROPAGATION_MODE
                  TimChFilterModeForRisingEdge = IMMEDIATE_EDGE_PROPAGATION_MODE
                  TimChFilterTimeForFallingEdge = 0
                  TimChFilterTimeForRisingEdge = 0
                  TimChannelFilterEnable = 0
                TimChannelGeneral:
                  TimChannelAruEnable = 0
                  TimChannelClockSelect = GTM_CONFIGURABLE_CLOCK_0
                  TimChannelCntsInputSelect = CNT_VALUE
                  TimChannelCntsValue = 0
                  TimChannelEcntOvflwSetting = SEL0_OVRFLOW_SIG_ON_ECNT_BITWIDTH_8
                  TimChannelEcntResetSetting = SEL0_ECNT_IN_WRAP_AROUND_MODE
                  TimChannelEnable = 0
                  TimChannelExtCaptureModeEnable = 0
                  TimChannelExtCaptureSrc = SEL0_NEW_VAL_IRQ
                  TimChannelGpr0InputSelect = TIMEBASE_TBU_TS0
                  TimChannelGpr1InputSelect = TIMEBASE_TBU_TS0
                  TimChannelInputSelect = INPUT_OF_CURRENT_TIM_CHANNEL
                  TimChannelModeSelect = PWM_MEASUREMENT_MODE_TPWM
                  TimChannelOneShotMode = 0
                  TimChannelPortPinSelect = NONE_SEL0
                  TimChannelSignalEdgeSelect = FALLING_EDGE
                  TimChannelTbu0Ts0BitsSelect = BITS_0_TO_23
                  TimChannelUsage = USED_BY_OTHER_DRIVERS_OR_UNUSED
                  TimChannelValInitSignal = VAL_LOW
                TimChannelInterrupt:
                  TimInterruptEnableOnCntOfl = 0
                  TimInterruptEnableOnEcntOfl = 0
                  TimInterruptEnableOnGlitchDet = 0
                  TimInterruptEnableOnGprxOfl = 0
                  TimInterruptEnableOnNewVal = 0
                  TimInterruptEnableOnToDet = 0
                  TimInterruptMode = GTM_INTERRUPT_LEVEL_MODE
                  TimNotification = NULL_PTR
                TimChannelTimeoutDetection: TimChTimeoutClockSelect=GTM_CONFIGURABLE_CLOCK_0, TimChTimeoutDetectionEnable=SEL0_TIMOUT_DISABLED, TimChTimeoutDuration=0
              TimChannel_3
                TimChannelErrorInterrupt:
                  TimInterruptEnableOnCntOflErr = 0
                  TimInterruptEnableOnEcntOflErr = 0
                  TimInterruptEnableOnGlitchDetErr = 0
                  TimInterruptEnableOnGprxOflErr = 0
                  TimInterruptEnableOnNewValErr = 0
                  TimInterruptEnableOnToDetErr = 0
                TimChannelFilterConfig:
                  TimChFilterCounterFreqSelect = GTM_CONFIGURABLE_CLOCK_0
                  TimChFilterModeForFallingEdge = IMMEDIATE_EDGE_PROPAGATION_MODE
                  TimChFilterModeForRisingEdge = IMMEDIATE_EDGE_PROPAGATION_MODE
                  TimChFilterTimeForFallingEdge = 0
                  TimChFilterTimeForRisingEdge = 0
                  TimChannelFilterEnable = 0
                TimChannelGeneral:
                  TimChannelAruEnable = 0
                  TimChannelClockSelect = GTM_CONFIGURABLE_CLOCK_0
                  TimChannelCntsInputSelect = CNT_VALUE
                  TimChannelCntsValue = 0
                  TimChannelEcntOvflwSetting = SEL0_OVRFLOW_SIG_ON_ECNT_BITWIDTH_8
                  TimChannelEcntResetSetting = SEL0_ECNT_IN_WRAP_AROUND_MODE
                  TimChannelEnable = 0
                  TimChannelExtCaptureModeEnable = 0
                  TimChannelExtCaptureSrc = SEL0_NEW_VAL_IRQ
                  TimChannelGpr0InputSelect = TIMEBASE_TBU_TS0
                  TimChannelGpr1InputSelect = TIMEBASE_TBU_TS0
                  TimChannelInputSelect = INPUT_OF_CURRENT_TIM_CHANNEL
                  TimChannelModeSelect = PWM_MEASUREMENT_MODE_TPWM
                  TimChannelOneShotMode = 0
                  TimChannelPortPinSelect = NONE_SEL0
                  TimChannelSignalEdgeSelect = FALLING_EDGE
                  TimChannelTbu0Ts0BitsSelect = BITS_0_TO_23
                  TimChannelUsage = USED_BY_OTHER_DRIVERS_OR_UNUSED
                  TimChannelValInitSignal = VAL_LOW
                TimChannelInterrupt:
                  TimInterruptEnableOnCntOfl = 0
                  TimInterruptEnableOnEcntOfl = 0
                  TimInterruptEnableOnGlitchDet = 0
                  TimInterruptEnableOnGprxOfl = 0
                  TimInterruptEnableOnNewVal = 0
                  TimInterruptEnableOnToDet = 0
                  TimInterruptMode = GTM_INTERRUPT_LEVEL_MODE
                  TimNotification = NULL_PTR
                TimChannelTimeoutDetection: TimChTimeoutClockSelect=GTM_CONFIGURABLE_CLOCK_0, TimChTimeoutDetectionEnable=SEL0_TIMOUT_DISABLED, TimChTimeoutDuration=0
              TimChannel_4
                TimChannelErrorInterrupt:
                  TimInterruptEnableOnCntOflErr = 0
                  TimInterruptEnableOnEcntOflErr = 0
                  TimInterruptEnableOnGlitchDetErr = 0
                  TimInterruptEnableOnGprxOflErr = 0
                  TimInterruptEnableOnNewValErr = 0
                  TimInterruptEnableOnToDetErr = 0
                TimChannelFilterConfig:
                  TimChFilterCounterFreqSelect = GTM_CONFIGURABLE_CLOCK_0
                  TimChFilterModeForFallingEdge = IMMEDIATE_EDGE_PROPAGATION_MODE
                  TimChFilterModeForRisingEdge = IMMEDIATE_EDGE_PROPAGATION_MODE
                  TimChFilterTimeForFallingEdge = 0
                  TimChFilterTimeForRisingEdge = 0
                  TimChannelFilterEnable = 0
                TimChannelGeneral:
                  TimChannelAruEnable = 0
                  TimChannelClockSelect = GTM_CONFIGURABLE_CLOCK_0
                  TimChannelCntsInputSelect = CNT_VALUE
                  TimChannelCntsValue = 0
                  TimChannelEcntOvflwSetting = SEL0_OVRFLOW_SIG_ON_ECNT_BITWIDTH_8
                  TimChannelEcntResetSetting = SEL0_ECNT_IN_WRAP_AROUND_MODE
                  TimChannelEnable = 0
                  TimChannelExtCaptureModeEnable = 0
                  TimChannelExtCaptureSrc = SEL0_NEW_VAL_IRQ
                  TimChannelGpr0InputSelect = TIMEBASE_TBU_TS0
                  TimChannelGpr1InputSelect = TIMEBASE_TBU_TS0
                  TimChannelInputSelect = INPUT_OF_CURRENT_TIM_CHANNEL
                  TimChannelModeSelect = PWM_MEASUREMENT_MODE_TPWM
                  TimChannelOneShotMode = 0
                  TimChannelPortPinSelect = NONE_SEL0
                  TimChannelSignalEdgeSelect = FALLING_EDGE
                  TimChannelTbu0Ts0BitsSelect = BITS_0_TO_23
                  TimChannelUsage = USED_BY_OTHER_DRIVERS_OR_UNUSED
                  TimChannelValInitSignal = VAL_LOW
                TimChannelInterrupt:
                  TimInterruptEnableOnCntOfl = 0
                  TimInterruptEnableOnEcntOfl = 0
                  TimInterruptEnableOnGlitchDet = 0
                  TimInterruptEnableOnGprxOfl = 0
                  TimInterruptEnableOnNewVal = 0
                  TimInterruptEnableOnToDet = 0
                  TimInterruptMode = GTM_INTERRUPT_LEVEL_MODE
                  TimNotification = NULL_PTR
                TimChannelTimeoutDetection: TimChTimeoutClockSelect=GTM_CONFIGURABLE_CLOCK_0, TimChTimeoutDetectionEnable=SEL0_TIMOUT_DISABLED, TimChTimeoutDuration=0
              TimChannel_5
                TimChannelErrorInterrupt:
                  TimInterruptEnableOnCntOflErr = 0
                  TimInterruptEnableOnEcntOflErr = 0
                  TimInterruptEnableOnGlitchDetErr = 0
                  TimInterruptEnableOnGprxOflErr = 0
                  TimInterruptEnableOnNewValErr = 0
                  TimInterruptEnableOnToDetErr = 0
                TimChannelFilterConfig:
                  TimChFilterCounterFreqSelect = GTM_CONFIGURABLE_CLOCK_0
                  TimChFilterModeForFallingEdge = IMMEDIATE_EDGE_PROPAGATION_MODE
                  TimChFilterModeForRisingEdge = IMMEDIATE_EDGE_PROPAGATION_MODE
                  TimChFilterTimeForFallingEdge = 0
                  TimChFilterTimeForRisingEdge = 0
                  TimChannelFilterEnable = 0
                TimChannelGeneral:
                  TimChannelAruEnable = 0
                  TimChannelClockSelect = GTM_CONFIGURABLE_CLOCK_0
                  TimChannelCntsInputSelect = CNT_VALUE
                  TimChannelCntsValue = 0
                  TimChannelEcntOvflwSetting = SEL0_OVRFLOW_SIG_ON_ECNT_BITWIDTH_8
                  TimChannelEcntResetSetting = SEL0_ECNT_IN_WRAP_AROUND_MODE
                  TimChannelEnable = 0
                  TimChannelExtCaptureModeEnable = 0
                  TimChannelExtCaptureSrc = SEL0_NEW_VAL_IRQ
                  TimChannelGpr0InputSelect = TIMEBASE_TBU_TS0
                  TimChannelGpr1InputSelect = TIMEBASE_TBU_TS0
                  TimChannelInputSelect = INPUT_OF_CURRENT_TIM_CHANNEL
                  TimChannelModeSelect = PWM_MEASUREMENT_MODE_TPWM
                  TimChannelOneShotMode = 0
                  TimChannelPortPinSelect = NONE_SEL0
                  TimChannelSignalEdgeSelect = FALLING_EDGE
                  TimChannelTbu0Ts0BitsSelect = BITS_0_TO_23
                  TimChannelUsage = USED_BY_OTHER_DRIVERS_OR_UNUSED
                  TimChannelValInitSignal = VAL_LOW
                TimChannelInterrupt:
                  TimInterruptEnableOnCntOfl = 0
                  TimInterruptEnableOnEcntOfl = 0
                  TimInterruptEnableOnGlitchDet = 0
                  TimInterruptEnableOnGprxOfl = 0
                  TimInterruptEnableOnNewVal = 0
                  TimInterruptEnableOnToDet = 0
                  TimInterruptMode = GTM_INTERRUPT_LEVEL_MODE
                  TimNotification = NULL_PTR
                TimChannelTimeoutDetection: TimChTimeoutClockSelect=GTM_CONFIGURABLE_CLOCK_0, TimChTimeoutDetectionEnable=SEL0_TIMOUT_DISABLED, TimChTimeoutDuration=0
              TimChannel_6
                TimChannelErrorInterrupt:
                  TimInterruptEnableOnCntOflErr = 0
                  TimInterruptEnableOnEcntOflErr = 0
                  TimInterruptEnableOnGlitchDetErr = 0
                  TimInterruptEnableOnGprxOflErr = 0
                  TimInterruptEnableOnNewValErr = 0
                  TimInterruptEnableOnToDetErr = 0
                TimChannelFilterConfig:
                  TimChFilterCounterFreqSelect = GTM_CONFIGURABLE_CLOCK_0
                  TimChFilterModeForFallingEdge = IMMEDIATE_EDGE_PROPAGATION_MODE
                  TimChFilterModeForRisingEdge = IMMEDIATE_EDGE_PROPAGATION_MODE
                  TimChFilterTimeForFallingEdge = 0
                  TimChFilterTimeForRisingEdge = 0
                  TimChannelFilterEnable = 0
                TimChannelGeneral:
                  TimChannelAruEnable = 0
                  TimChannelClockSelect = GTM_CONFIGURABLE_CLOCK_0
                  TimChannelCntsInputSelect = CNT_VALUE
                  TimChannelCntsValue = 0
                  TimChannelEcntOvflwSetting = SEL0_OVRFLOW_SIG_ON_ECNT_BITWIDTH_8
                  TimChannelEcntResetSetting = SEL0_ECNT_IN_WRAP_AROUND_MODE
                  TimChannelEnable = 0
                  TimChannelExtCaptureModeEnable = 0
                  TimChannelExtCaptureSrc = SEL0_NEW_VAL_IRQ
                  TimChannelGpr0InputSelect = TIMEBASE_TBU_TS0
                  TimChannelGpr1InputSelect = TIMEBASE_TBU_TS0
                  TimChannelInputSelect = INPUT_OF_CURRENT_TIM_CHANNEL
                  TimChannelModeSelect = PWM_MEASUREMENT_MODE_TPWM
                  TimChannelOneShotMode = 0
                  TimChannelPortPinSelect = NONE_SEL0
                  TimChannelSignalEdgeSelect = FALLING_EDGE
                  TimChannelTbu0Ts0BitsSelect = BITS_0_TO_23
                  TimChannelUsage = USED_BY_OTHER_DRIVERS_OR_UNUSED
                  TimChannelValInitSignal = VAL_LOW
                TimChannelInterrupt:
                  TimInterruptEnableOnCntOfl = 0
                  TimInterruptEnableOnEcntOfl = 0
                  TimInterruptEnableOnGlitchDet = 0
                  TimInterruptEnableOnGprxOfl = 0
                  TimInterruptEnableOnNewVal = 0
                  TimInterruptEnableOnToDet = 0
                  TimInterruptMode = GTM_INTERRUPT_LEVEL_MODE
                  TimNotification = NULL_PTR
                TimChannelTimeoutDetection: TimChTimeoutClockSelect=GTM_CONFIGURABLE_CLOCK_0, TimChTimeoutDetectionEnable=SEL0_TIMOUT_DISABLED, TimChTimeoutDuration=0
              TimChannel_7
                TimChannelErrorInterrupt:
                  TimInterruptEnableOnCntOflErr = 0
                  TimInterruptEnableOnEcntOflErr = 0
                  TimInterruptEnableOnGlitchDetErr = 0
                  TimInterruptEnableOnGprxOflErr = 0
                  TimInterruptEnableOnNewValErr = 0
                  TimInterruptEnableOnToDetErr = 0
                TimChannelFilterConfig:
                  TimChFilterCounterFreqSelect = GTM_CONFIGURABLE_CLOCK_0
                  TimChFilterModeForFallingEdge = IMMEDIATE_EDGE_PROPAGATION_MODE
                  TimChFilterModeForRisingEdge = IMMEDIATE_EDGE_PROPAGATION_MODE
                  TimChFilterTimeForFallingEdge = 0
                  TimChFilterTimeForRisingEdge = 0
                  TimChannelFilterEnable = 0
                TimChannelGeneral:
                  TimChannelAruEnable = 0
                  TimChannelClockSelect = GTM_CONFIGURABLE_CLOCK_0
                  TimChannelCntsInputSelect = CNT_VALUE
                  TimChannelCntsValue = 0
                  TimChannelEcntOvflwSetting = SEL0_OVRFLOW_SIG_ON_ECNT_BITWIDTH_8
                  TimChannelEcntResetSetting = SEL0_ECNT_IN_WRAP_AROUND_MODE
                  TimChannelEnable = 0
                  TimChannelExtCaptureModeEnable = 0
                  TimChannelExtCaptureSrc = SEL0_NEW_VAL_IRQ
                  TimChannelGpr0InputSelect = TIMEBASE_TBU_TS0
                  TimChannelGpr1InputSelect = TIMEBASE_TBU_TS0
                  TimChannelInputSelect = INPUT_OF_CURRENT_TIM_CHANNEL
                  TimChannelModeSelect = PWM_MEASUREMENT_MODE_TPWM
                  TimChannelOneShotMode = 0
                  TimChannelPortPinSelect = TIN75_SEL4_PORT15_PIN4
                  TimChannelSignalEdgeSelect = FALLING_EDGE
                  TimChannelTbu0Ts0BitsSelect = BITS_0_TO_23
                  TimChannelUsage = USED_BY_OTHER_DRIVERS_OR_UNUSED
                  TimChannelValInitSignal = VAL_LOW
                TimChannelInterrupt:
                  TimInterruptEnableOnCntOfl = 0
                  TimInterruptEnableOnEcntOfl = 0
                  TimInterruptEnableOnGlitchDet = 0
                  TimInterruptEnableOnGprxOfl = 0
                  TimInterruptEnableOnNewVal = 0
                  TimInterruptEnableOnToDet = 0
                  TimInterruptMode = GTM_INTERRUPT_LEVEL_MODE
                  TimNotification = NULL_PTR
                TimChannelTimeoutDetection: TimChTimeoutClockSelect=GTM_CONFIGURABLE_CLOCK_0, TimChTimeoutDetectionEnable=SEL0_TIMOUT_DISABLED, TimChTimeoutDuration=0
          Tim_3
            8 x TimChannel:
              TimChannel_0
                TimChannelErrorInterrupt:
                  TimInterruptEnableOnCntOflErr = 0
                  TimInterruptEnableOnEcntOflErr = 0
                  TimInterruptEnableOnGlitchDetErr = 0
                  TimInterruptEnableOnGprxOflErr = 0
                  TimInterruptEnableOnNewValErr = 0
                  TimInterruptEnableOnToDetErr = 0
                TimChannelFilterConfig:
                  TimChFilterCounterFreqSelect = GTM_CONFIGURABLE_CLOCK_0
                  TimChFilterModeForFallingEdge = IMMEDIATE_EDGE_PROPAGATION_MODE
                  TimChFilterModeForRisingEdge = IMMEDIATE_EDGE_PROPAGATION_MODE
                  TimChFilterTimeForFallingEdge = 0
                  TimChFilterTimeForRisingEdge = 0
                  TimChannelFilterEnable = 0
                TimChannelGeneral:
                  TimChannelAruEnable = 0
                  TimChannelClockSelect = GTM_CONFIGURABLE_CLOCK_0
                  TimChannelCntsInputSelect = CNT_VALUE
                  TimChannelCntsValue = 0
                  TimChannelEcntOvflwSetting = SEL0_OVRFLOW_SIG_ON_ECNT_BITWIDTH_8
                  TimChannelEcntResetSetting = SEL0_ECNT_IN_WRAP_AROUND_MODE
                  TimChannelEnable = 0
                  TimChannelExtCaptureModeEnable = 0
                  TimChannelExtCaptureSrc = SEL0_NEW_VAL_IRQ
                  TimChannelGpr0InputSelect = TIMEBASE_TBU_TS0
                  TimChannelGpr1InputSelect = TIMEBASE_TBU_TS0
                  TimChannelInputSelect = INPUT_OF_CURRENT_TIM_CHANNEL
                  TimChannelModeSelect = PWM_MEASUREMENT_MODE_TPWM
                  TimChannelOneShotMode = 0
                  TimChannelPortPinSelect = NONE_SEL0
                  TimChannelSignalEdgeSelect = FALLING_EDGE
                  TimChannelTbu0Ts0BitsSelect = BITS_0_TO_23
                  TimChannelUsage = USED_BY_OTHER_DRIVERS_OR_UNUSED
                  TimChannelValInitSignal = VAL_LOW
                TimChannelInterrupt:
                  TimInterruptEnableOnCntOfl = 0
                  TimInterruptEnableOnEcntOfl = 0
                  TimInterruptEnableOnGlitchDet = 0
                  TimInterruptEnableOnGprxOfl = 0
                  TimInterruptEnableOnNewVal = 0
                  TimInterruptEnableOnToDet = 0
                  TimInterruptMode = GTM_INTERRUPT_LEVEL_MODE
                  TimNotification = NULL_PTR
                TimChannelTimeoutDetection: TimChTimeoutClockSelect=GTM_CONFIGURABLE_CLOCK_0, TimChTimeoutDetectionEnable=SEL0_TIMOUT_DISABLED, TimChTimeoutDuration=0
              TimChannel_1
                TimChannelErrorInterrupt:
                  TimInterruptEnableOnCntOflErr = 0
                  TimInterruptEnableOnEcntOflErr = 0
                  TimInterruptEnableOnGlitchDetErr = 0
                  TimInterruptEnableOnGprxOflErr = 0
                  TimInterruptEnableOnNewValErr = 0
                  TimInterruptEnableOnToDetErr = 0
                TimChannelFilterConfig:
                  TimChFilterCounterFreqSelect = GTM_CONFIGURABLE_CLOCK_0
                  TimChFilterModeForFallingEdge = IMMEDIATE_EDGE_PROPAGATION_MODE
                  TimChFilterModeForRisingEdge = IMMEDIATE_EDGE_PROPAGATION_MODE
                  TimChFilterTimeForFallingEdge = 0
                  TimChFilterTimeForRisingEdge = 0
                  TimChannelFilterEnable = 0
                TimChannelGeneral:
                  TimChannelAruEnable = 0
                  TimChannelClockSelect = GTM_CONFIGURABLE_CLOCK_0
                  TimChannelCntsInputSelect = CNT_VALUE
                  TimChannelCntsValue = 0
                  TimChannelEcntOvflwSetting = SEL0_OVRFLOW_SIG_ON_ECNT_BITWIDTH_8
                  TimChannelEcntResetSetting = SEL0_ECNT_IN_WRAP_AROUND_MODE
                  TimChannelEnable = 0
                  TimChannelExtCaptureModeEnable = 0
                  TimChannelExtCaptureSrc = SEL0_NEW_VAL_IRQ
                  TimChannelGpr0InputSelect = TIMEBASE_TBU_TS0
                  TimChannelGpr1InputSelect = TIMEBASE_TBU_TS0
                  TimChannelInputSelect = INPUT_OF_CURRENT_TIM_CHANNEL
                  TimChannelModeSelect = PWM_MEASUREMENT_MODE_TPWM
                  TimChannelOneShotMode = 0
                  TimChannelPortPinSelect = NONE_SEL0
                  TimChannelSignalEdgeSelect = FALLING_EDGE
                  TimChannelTbu0Ts0BitsSelect = BITS_0_TO_23
                  TimChannelUsage = USED_BY_OTHER_DRIVERS_OR_UNUSED
                  TimChannelValInitSignal = VAL_LOW
                TimChannelInterrupt:
                  TimInterruptEnableOnCntOfl = 0
                  TimInterruptEnableOnEcntOfl = 0
                  TimInterruptEnableOnGlitchDet = 0
                  TimInterruptEnableOnGprxOfl = 0
                  TimInterruptEnableOnNewVal = 0
                  TimInterruptEnableOnToDet = 0
                  TimInterruptMode = GTM_INTERRUPT_LEVEL_MODE
                  TimNotification = NULL_PTR
                TimChannelTimeoutDetection: TimChTimeoutClockSelect=GTM_CONFIGURABLE_CLOCK_0, TimChTimeoutDetectionEnable=SEL0_TIMOUT_DISABLED, TimChTimeoutDuration=0
              TimChannel_2
                TimChannelErrorInterrupt:
                  TimInterruptEnableOnCntOflErr = 0
                  TimInterruptEnableOnEcntOflErr = 0
                  TimInterruptEnableOnGlitchDetErr = 0
                  TimInterruptEnableOnGprxOflErr = 0
                  TimInterruptEnableOnNewValErr = 0
                  TimInterruptEnableOnToDetErr = 0
                TimChannelFilterConfig:
                  TimChFilterCounterFreqSelect = GTM_CONFIGURABLE_CLOCK_0
                  TimChFilterModeForFallingEdge = IMMEDIATE_EDGE_PROPAGATION_MODE
                  TimChFilterModeForRisingEdge = IMMEDIATE_EDGE_PROPAGATION_MODE
                  TimChFilterTimeForFallingEdge = 0
                  TimChFilterTimeForRisingEdge = 0
                  TimChannelFilterEnable = 0
                TimChannelGeneral:
                  TimChannelAruEnable = 0
                  TimChannelClockSelect = GTM_CONFIGURABLE_CLOCK_0
                  TimChannelCntsInputSelect = CNT_VALUE
                  TimChannelCntsValue = 0
                  TimChannelEcntOvflwSetting = SEL0_OVRFLOW_SIG_ON_ECNT_BITWIDTH_8
                  TimChannelEcntResetSetting = SEL0_ECNT_IN_WRAP_AROUND_MODE
                  TimChannelEnable = 0
                  TimChannelExtCaptureModeEnable = 0
                  TimChannelExtCaptureSrc = SEL0_NEW_VAL_IRQ
                  TimChannelGpr0InputSelect = TIMEBASE_TBU_TS0
                  TimChannelGpr1InputSelect = TIMEBASE_TBU_TS0
                  TimChannelInputSelect = INPUT_OF_CURRENT_TIM_CHANNEL
                  TimChannelModeSelect = PWM_MEASUREMENT_MODE_TPWM
                  TimChannelOneShotMode = 0
                  TimChannelPortPinSelect = NONE_SEL0
                  TimChannelSignalEdgeSelect = FALLING_EDGE
                  TimChannelTbu0Ts0BitsSelect = BITS_0_TO_23
                  TimChannelUsage = USED_BY_OTHER_DRIVERS_OR_UNUSED
                  TimChannelValInitSignal = VAL_LOW
                TimChannelInterrupt:
                  TimInterruptEnableOnCntOfl = 0
                  TimInterruptEnableOnEcntOfl = 0
                  TimInterruptEnableOnGlitchDet = 0
                  TimInterruptEnableOnGprxOfl = 0
                  TimInterruptEnableOnNewVal = 0
                  TimInterruptEnableOnToDet = 0
                  TimInterruptMode = GTM_INTERRUPT_LEVEL_MODE
                  TimNotification = NULL_PTR
                TimChannelTimeoutDetection: TimChTimeoutClockSelect=GTM_CONFIGURABLE_CLOCK_0, TimChTimeoutDetectionEnable=SEL0_TIMOUT_DISABLED, TimChTimeoutDuration=0
              TimChannel_3
                TimChannelErrorInterrupt:
                  TimInterruptEnableOnCntOflErr = 0
                  TimInterruptEnableOnEcntOflErr = 0
                  TimInterruptEnableOnGlitchDetErr = 0
                  TimInterruptEnableOnGprxOflErr = 0
                  TimInterruptEnableOnNewValErr = 0
                  TimInterruptEnableOnToDetErr = 0
                TimChannelFilterConfig:
                  TimChFilterCounterFreqSelect = GTM_CONFIGURABLE_CLOCK_0
                  TimChFilterModeForFallingEdge = IMMEDIATE_EDGE_PROPAGATION_MODE
                  TimChFilterModeForRisingEdge = IMMEDIATE_EDGE_PROPAGATION_MODE
                  TimChFilterTimeForFallingEdge = 0
                  TimChFilterTimeForRisingEdge = 0
                  TimChannelFilterEnable = 0
                TimChannelGeneral:
                  TimChannelAruEnable = 0
                  TimChannelClockSelect = GTM_CONFIGURABLE_CLOCK_0
                  TimChannelCntsInputSelect = CNT_VALUE
                  TimChannelCntsValue = 0
                  TimChannelEcntOvflwSetting = SEL0_OVRFLOW_SIG_ON_ECNT_BITWIDTH_8
                  TimChannelEcntResetSetting = SEL0_ECNT_IN_WRAP_AROUND_MODE
                  TimChannelEnable = 0
                  TimChannelExtCaptureModeEnable = 0
                  TimChannelExtCaptureSrc = SEL0_NEW_VAL_IRQ
                  TimChannelGpr0InputSelect = TIMEBASE_TBU_TS0
                  TimChannelGpr1InputSelect = TIMEBASE_TBU_TS0
                  TimChannelInputSelect = INPUT_OF_CURRENT_TIM_CHANNEL
                  TimChannelModeSelect = PWM_MEASUREMENT_MODE_TPWM
                  TimChannelOneShotMode = 0
                  TimChannelPortPinSelect = NONE_SEL0
                  TimChannelSignalEdgeSelect = FALLING_EDGE
                  TimChannelTbu0Ts0BitsSelect = BITS_0_TO_23
                  TimChannelUsage = USED_BY_OTHER_DRIVERS_OR_UNUSED
                  TimChannelValInitSignal = VAL_LOW
                TimChannelInterrupt:
                  TimInterruptEnableOnCntOfl = 0
                  TimInterruptEnableOnEcntOfl = 0
                  TimInterruptEnableOnGlitchDet = 0
                  TimInterruptEnableOnGprxOfl = 0
                  TimInterruptEnableOnNewVal = 0
                  TimInterruptEnableOnToDet = 0
                  TimInterruptMode = GTM_INTERRUPT_LEVEL_MODE
                  TimNotification = NULL_PTR
                TimChannelTimeoutDetection: TimChTimeoutClockSelect=GTM_CONFIGURABLE_CLOCK_0, TimChTimeoutDetectionEnable=SEL0_TIMOUT_DISABLED, TimChTimeoutDuration=0
              TimChannel_4
                TimChannelErrorInterrupt:
                  TimInterruptEnableOnCntOflErr = 0
                  TimInterruptEnableOnEcntOflErr = 0
                  TimInterruptEnableOnGlitchDetErr = 0
                  TimInterruptEnableOnGprxOflErr = 0
                  TimInterruptEnableOnNewValErr = 0
                  TimInterruptEnableOnToDetErr = 0
                TimChannelFilterConfig:
                  TimChFilterCounterFreqSelect = GTM_CONFIGURABLE_CLOCK_0
                  TimChFilterModeForFallingEdge = IMMEDIATE_EDGE_PROPAGATION_MODE
                  TimChFilterModeForRisingEdge = IMMEDIATE_EDGE_PROPAGATION_MODE
                  TimChFilterTimeForFallingEdge = 0
                  TimChFilterTimeForRisingEdge = 0
                  TimChannelFilterEnable = 0
                TimChannelGeneral:
                  TimChannelAruEnable = 0
                  TimChannelClockSelect = GTM_CONFIGURABLE_CLOCK_0
                  TimChannelCntsInputSelect = CNT_VALUE
                  TimChannelCntsValue = 0
                  TimChannelEcntOvflwSetting = SEL0_OVRFLOW_SIG_ON_ECNT_BITWIDTH_8
                  TimChannelEcntResetSetting = SEL0_ECNT_IN_WRAP_AROUND_MODE
                  TimChannelEnable = 0
                  TimChannelExtCaptureModeEnable = 0
                  TimChannelExtCaptureSrc = SEL0_NEW_VAL_IRQ
                  TimChannelGpr0InputSelect = TIMEBASE_TBU_TS0
                  TimChannelGpr1InputSelect = TIMEBASE_TBU_TS0
                  TimChannelInputSelect = INPUT_OF_CURRENT_TIM_CHANNEL
                  TimChannelModeSelect = PWM_MEASUREMENT_MODE_TPWM
                  TimChannelOneShotMode = 0
                  TimChannelPortPinSelect = NONE_SEL0
                  TimChannelSignalEdgeSelect = FALLING_EDGE
                  TimChannelTbu0Ts0BitsSelect = BITS_0_TO_23
                  TimChannelUsage = USED_BY_OTHER_DRIVERS_OR_UNUSED
                  TimChannelValInitSignal = VAL_LOW
                TimChannelInterrupt:
                  TimInterruptEnableOnCntOfl = 0
                  TimInterruptEnableOnEcntOfl = 0
                  TimInterruptEnableOnGlitchDet = 0
                  TimInterruptEnableOnGprxOfl = 0
                  TimInterruptEnableOnNewVal = 0
                  TimInterruptEnableOnToDet = 0
                  TimInterruptMode = GTM_INTERRUPT_LEVEL_MODE
                  TimNotification = NULL_PTR
                TimChannelTimeoutDetection: TimChTimeoutClockSelect=GTM_CONFIGURABLE_CLOCK_0, TimChTimeoutDetectionEnable=SEL0_TIMOUT_DISABLED, TimChTimeoutDuration=0
              TimChannel_5
                TimChannelErrorInterrupt:
                  TimInterruptEnableOnCntOflErr = 0
                  TimInterruptEnableOnEcntOflErr = 0
                  TimInterruptEnableOnGlitchDetErr = 0
                  TimInterruptEnableOnGprxOflErr = 0
                  TimInterruptEnableOnNewValErr = 0
                  TimInterruptEnableOnToDetErr = 0
                TimChannelFilterConfig:
                  TimChFilterCounterFreqSelect = GTM_CONFIGURABLE_CLOCK_0
                  TimChFilterModeForFallingEdge = IMMEDIATE_EDGE_PROPAGATION_MODE
                  TimChFilterModeForRisingEdge = IMMEDIATE_EDGE_PROPAGATION_MODE
                  TimChFilterTimeForFallingEdge = 0
                  TimChFilterTimeForRisingEdge = 0
                  TimChannelFilterEnable = 0
                TimChannelGeneral:
                  TimChannelAruEnable = 0
                  TimChannelClockSelect = GTM_CONFIGURABLE_CLOCK_0
                  TimChannelCntsInputSelect = CNT_VALUE
                  TimChannelCntsValue = 0
                  TimChannelEcntOvflwSetting = SEL0_OVRFLOW_SIG_ON_ECNT_BITWIDTH_8
                  TimChannelEcntResetSetting = SEL0_ECNT_IN_WRAP_AROUND_MODE
                  TimChannelEnable = 0
                  TimChannelExtCaptureModeEnable = 0
                  TimChannelExtCaptureSrc = SEL0_NEW_VAL_IRQ
                  TimChannelGpr0InputSelect = TIMEBASE_TBU_TS0
                  TimChannelGpr1InputSelect = TIMEBASE_TBU_TS0
                  TimChannelInputSelect = INPUT_OF_CURRENT_TIM_CHANNEL
                  TimChannelModeSelect = PWM_MEASUREMENT_MODE_TPWM
                  TimChannelOneShotMode = 0
                  TimChannelPortPinSelect = NONE_SEL0
                  TimChannelSignalEdgeSelect = FALLING_EDGE
                  TimChannelTbu0Ts0BitsSelect = BITS_0_TO_23
                  TimChannelUsage = USED_BY_OTHER_DRIVERS_OR_UNUSED
                  TimChannelValInitSignal = VAL_LOW
                TimChannelInterrupt:
                  TimInterruptEnableOnCntOfl = 0
                  TimInterruptEnableOnEcntOfl = 0
                  TimInterruptEnableOnGlitchDet = 0
                  TimInterruptEnableOnGprxOfl = 0
                  TimInterruptEnableOnNewVal = 0
                  TimInterruptEnableOnToDet = 0
                  TimInterruptMode = GTM_INTERRUPT_LEVEL_MODE
                  TimNotification = NULL_PTR
                TimChannelTimeoutDetection: TimChTimeoutClockSelect=GTM_CONFIGURABLE_CLOCK_0, TimChTimeoutDetectionEnable=SEL0_TIMOUT_DISABLED, TimChTimeoutDuration=0
              TimChannel_6
                TimChannelErrorInterrupt:
                  TimInterruptEnableOnCntOflErr = 0
                  TimInterruptEnableOnEcntOflErr = 0
                  TimInterruptEnableOnGlitchDetErr = 0
                  TimInterruptEnableOnGprxOflErr = 0
                  TimInterruptEnableOnNewValErr = 0
                  TimInterruptEnableOnToDetErr = 0
                TimChannelFilterConfig:
                  TimChFilterCounterFreqSelect = GTM_CONFIGURABLE_CLOCK_0
                  TimChFilterModeForFallingEdge = IMMEDIATE_EDGE_PROPAGATION_MODE
                  TimChFilterModeForRisingEdge = IMMEDIATE_EDGE_PROPAGATION_MODE
                  TimChFilterTimeForFallingEdge = 0
                  TimChFilterTimeForRisingEdge = 0
                  TimChannelFilterEnable = 0
                TimChannelGeneral:
                  TimChannelAruEnable = 0
                  TimChannelClockSelect = GTM_CONFIGURABLE_CLOCK_0
                  TimChannelCntsInputSelect = CNT_VALUE
                  TimChannelCntsValue = 0
                  TimChannelEcntOvflwSetting = SEL0_OVRFLOW_SIG_ON_ECNT_BITWIDTH_8
                  TimChannelEcntResetSetting = SEL0_ECNT_IN_WRAP_AROUND_MODE
                  TimChannelEnable = 0
                  TimChannelExtCaptureModeEnable = 0
                  TimChannelExtCaptureSrc = SEL0_NEW_VAL_IRQ
                  TimChannelGpr0InputSelect = TIMEBASE_TBU_TS0
                  TimChannelGpr1InputSelect = TIMEBASE_TBU_TS0
                  TimChannelInputSelect = INPUT_OF_CURRENT_TIM_CHANNEL
                  TimChannelModeSelect = PWM_MEASUREMENT_MODE_TPWM
                  TimChannelOneShotMode = 0
                  TimChannelPortPinSelect = NONE_SEL0
                  TimChannelSignalEdgeSelect = FALLING_EDGE
                  TimChannelTbu0Ts0BitsSelect = BITS_0_TO_23
                  TimChannelUsage = USED_BY_OTHER_DRIVERS_OR_UNUSED
                  TimChannelValInitSignal = VAL_LOW
                TimChannelInterrupt:
                  TimInterruptEnableOnCntOfl = 0
                  TimInterruptEnableOnEcntOfl = 0
                  TimInterruptEnableOnGlitchDet = 0
                  TimInterruptEnableOnGprxOfl = 0
                  TimInterruptEnableOnNewVal = 0
                  TimInterruptEnableOnToDet = 0
                  TimInterruptMode = GTM_INTERRUPT_LEVEL_MODE
                  TimNotification = NULL_PTR
                TimChannelTimeoutDetection: TimChTimeoutClockSelect=GTM_CONFIGURABLE_CLOCK_0, TimChTimeoutDetectionEnable=SEL0_TIMOUT_DISABLED, TimChTimeoutDuration=0
              TimChannel_7
                TimChannelErrorInterrupt:
                  TimInterruptEnableOnCntOflErr = 0
                  TimInterruptEnableOnEcntOflErr = 0
                  TimInterruptEnableOnGlitchDetErr = 0
                  TimInterruptEnableOnGprxOflErr = 0
                  TimInterruptEnableOnNewValErr = 0
                  TimInterruptEnableOnToDetErr = 0
                TimChannelFilterConfig:
                  TimChFilterCounterFreqSelect = GTM_CONFIGURABLE_CLOCK_0
                  TimChFilterModeForFallingEdge = IMMEDIATE_EDGE_PROPAGATION_MODE
                  TimChFilterModeForRisingEdge = IMMEDIATE_EDGE_PROPAGATION_MODE
                  TimChFilterTimeForFallingEdge = 0
                  TimChFilterTimeForRisingEdge = 0
                  TimChannelFilterEnable = 0
                TimChannelGeneral:
                  TimChannelAruEnable = 0
                  TimChannelClockSelect = GTM_CONFIGURABLE_CLOCK_0
                  TimChannelCntsInputSelect = CNT_VALUE
                  TimChannelCntsValue = 0
                  TimChannelEcntOvflwSetting = SEL0_OVRFLOW_SIG_ON_ECNT_BITWIDTH_8
                  TimChannelEcntResetSetting = SEL0_ECNT_IN_WRAP_AROUND_MODE
                  TimChannelEnable = 0
                  TimChannelExtCaptureModeEnable = 0
                  TimChannelExtCaptureSrc = SEL0_NEW_VAL_IRQ
                  TimChannelGpr0InputSelect = TIMEBASE_TBU_TS0
                  TimChannelGpr1InputSelect = TIMEBASE_TBU_TS0
                  TimChannelInputSelect = INPUT_OF_CURRENT_TIM_CHANNEL
                  TimChannelModeSelect = PWM_MEASUREMENT_MODE_TPWM
                  TimChannelOneShotMode = 0
                  TimChannelPortPinSelect = NONE_SEL0
                  TimChannelSignalEdgeSelect = FALLING_EDGE
                  TimChannelTbu0Ts0BitsSelect = BITS_0_TO_23
                  TimChannelUsage = USED_BY_OTHER_DRIVERS_OR_UNUSED
                  TimChannelValInitSignal = VAL_LOW
                TimChannelInterrupt:
                  TimInterruptEnableOnCntOfl = 0
                  TimInterruptEnableOnEcntOfl = 0
                  TimInterruptEnableOnGlitchDet = 0
                  TimInterruptEnableOnGprxOfl = 0
                  TimInterruptEnableOnNewVal = 0
                  TimInterruptEnableOnToDet = 0
                  TimInterruptMode = GTM_INTERRUPT_LEVEL_MODE
                  TimNotification = NULL_PTR
                TimChannelTimeoutDetection: TimChTimeoutClockSelect=GTM_CONFIGURABLE_CLOCK_0, TimChTimeoutDetectionEnable=SEL0_TIMOUT_DISABLED, TimChTimeoutDuration=0
        3 x Tom:
          Tom_0
            16 x TomChannel:
              TomChannel_0
                TomChannelEnable: TomChDisableOnTgcTrigger=0, TomChannelEnable=AT_START
                TomChannelInterrupt: TomIntEnableOnDutyCycleMatchCcu1=0, TomIntEnableOnPeriodMatchCcu0=0, TomInterruptMode=GTM_INTERRUPT_LEVEL_MODE, TomNotification=NULL_PTR
                TomChannelOutput:
                  TomChOutputDisableOnTgcTrig = 0
                  TomChannelOutputControl = DONT_ENABLE_CHANNEL_OUTPUT
                  TomChannelOutputSignalLevel = LOW
                  TomChannelPortPinSelect = TOUT18_SELA_PORT0_PIN9
                TomChannelTimerParameters:
                  TomChDCycCompareShadowValSr1 = 0
                  TomChEnableForceUpdate = 0
                  TomChPeriodCompareShadowValSr0 = 0
                  TomChResetCn0OnForceUpdate = 0
                  TomChUpdateEnableOnCn0Reset = 0
                  TomChannelBitReversalMode = 0
                  TomChannelClockSelect = GTM_FIXED_CLOCK_0
                  TomChannelCounterCn0Reset = ON_COMPARE_MATCH_ON_CHANNEL
                  TomChannelCounterValCn0 = 0
                  TomChannelDutyCycleCompareValCm1 = 0
                  TomChannelGatedCounterMode = 0
                  TomChannelOneShotMode = 0
                  TomChannelPeriodCompareValCm0 = 0
                  TomChannelSpeMode = 0
                  TomChannelTriggerOutput = TRIG_FROM_PREVIOUS_CHANNEL
                TomChannelUsage: TomChannelUsage=USED_BY_OTHER_DRIVERS_OR_UNUSED
              TomChannel_1
                TomChannelEnable: TomChDisableOnTgcTrigger=0, TomChannelEnable=AT_START
                TomChannelInterrupt: TomIntEnableOnDutyCycleMatchCcu1=0, TomIntEnableOnPeriodMatchCcu0=0, TomInterruptMode=GTM_INTERRUPT_LEVEL_MODE, TomNotification=NULL_PTR
                TomChannelOutput:
                  TomChOutputDisableOnTgcTrig = 0
                  TomChannelOutputControl = DONT_ENABLE_CHANNEL_OUTPUT
                  TomChannelOutputSignalLevel = LOW
                  TomChannelPortPinSelect = TOUT19_SELA_PORT0_PIN10
                TomChannelTimerParameters:
                  TomChDCycCompareShadowValSr1 = 0
                  TomChEnableForceUpdate = 0
                  TomChPeriodCompareShadowValSr0 = 0
                  TomChResetCn0OnForceUpdate = 0
                  TomChUpdateEnableOnCn0Reset = 0
                  TomChannelBitReversalMode = 0
                  TomChannelClockSelect = GTM_FIXED_CLOCK_0
                  TomChannelCounterCn0Reset = ON_COMPARE_MATCH_ON_CHANNEL
                  TomChannelCounterValCn0 = 0
                  TomChannelDutyCycleCompareValCm1 = 0
                  TomChannelGatedCounterMode = 0
                  TomChannelOneShotMode = 0
                  TomChannelPeriodCompareValCm0 = 0
                  TomChannelSpeMode = 0
                  TomChannelTriggerOutput = TRIG_FROM_PREVIOUS_CHANNEL
                TomChannelUsage: TomChannelUsage=USED_BY_OTHER_DRIVERS_OR_UNUSED
              TomChannel_10
                TomChannelEnable: TomChDisableOnTgcTrigger=0, TomChannelEnable=AT_START
                TomChannelInterrupt: TomIntEnableOnDutyCycleMatchCcu1=0, TomIntEnableOnPeriodMatchCcu0=0, TomInterruptMode=GTM_INTERRUPT_LEVEL_MODE, TomNotification=NULL_PTR
                TomChannelOutput:
                  TomChOutputDisableOnTgcTrig = 0
                  TomChannelOutputControl = DONT_ENABLE_CHANNEL_OUTPUT
                  TomChannelOutputSignalLevel = LOW
                  TomChannelPortPinSelect = TOUT12_SELA_PORT0_PIN3
                TomChannelTimerParameters:
                  TomChDCycCompareShadowValSr1 = 0
                  TomChEnableForceUpdate = 0
                  TomChPeriodCompareShadowValSr0 = 0
                  TomChResetCn0OnForceUpdate = 0
                  TomChUpdateEnableOnCn0Reset = 0
                  TomChannelBitReversalMode = 0
                  TomChannelClockSelect = GTM_FIXED_CLOCK_0
                  TomChannelCounterCn0Reset = ON_COMPARE_MATCH_ON_CHANNEL
                  TomChannelCounterValCn0 = 0
                  TomChannelDutyCycleCompareValCm1 = 0
                  TomChannelGatedCounterMode = 0
                  TomChannelOneShotMode = 0
                  TomChannelPeriodCompareValCm0 = 0
                  TomChannelSpeMode = 0
                  TomChannelTriggerOutput = TRIG_FROM_PREVIOUS_CHANNEL
                TomChannelUsage: TomChannelUsage=USED_BY_OTHER_DRIVERS_OR_UNUSED
              TomChannel_11
                TomChannelEnable: TomChDisableOnTgcTrigger=0, TomChannelEnable=AT_START
                TomChannelInterrupt: TomIntEnableOnDutyCycleMatchCcu1=0, TomIntEnableOnPeriodMatchCcu0=0, TomInterruptMode=GTM_INTERRUPT_LEVEL_MODE, TomNotification=NULL_PTR
                TomChannelOutput:
                  TomChOutputDisableOnTgcTrig = 0
                  TomChannelOutputControl = DONT_ENABLE_CHANNEL_OUTPUT
                  TomChannelOutputSignalLevel = LOW
                  TomChannelPortPinSelect = TOUT13_SELA_PORT0_PIN4
                TomChannelTimerParameters:
                  TomChDCycCompareShadowValSr1 = 0
                  TomChEnableForceUpdate = 0
                  TomChPeriodCompareShadowValSr0 = 0
                  TomChResetCn0OnForceUpdate = 0
                  TomChUpdateEnableOnCn0Reset = 0
                  TomChannelBitReversalMode = 0
                  TomChannelClockSelect = GTM_FIXED_CLOCK_0
                  TomChannelCounterCn0Reset = ON_COMPARE_MATCH_ON_CHANNEL
                  TomChannelCounterValCn0 = 0
                  TomChannelDutyCycleCompareValCm1 = 0
                  TomChannelGatedCounterMode = 0
                  TomChannelOneShotMode = 0
                  TomChannelPeriodCompareValCm0 = 0
                  TomChannelSpeMode = 0
                  TomChannelTriggerOutput = TRIG_FROM_PREVIOUS_CHANNEL
                TomChannelUsage: TomChannelUsage=USED_BY_OTHER_DRIVERS_OR_UNUSED
              TomChannel_12
                TomChannelEnable: TomChDisableOnTgcTrigger=0, TomChannelEnable=AT_START
                TomChannelInterrupt: TomIntEnableOnDutyCycleMatchCcu1=0, TomIntEnableOnPeriodMatchCcu0=0, TomInterruptMode=GTM_INTERRUPT_LEVEL_MODE, TomNotification=NULL_PTR
                TomChannelOutput:
                  TomChOutputDisableOnTgcTrig = 0
                  TomChannelOutputControl = DONT_ENABLE_CHANNEL_OUTPUT
                  TomChannelOutputSignalLevel = LOW
                  TomChannelPortPinSelect = TOUT14_SELA_PORT0_PIN5
                TomChannelTimerParameters:
                  TomChDCycCompareShadowValSr1 = 0
                  TomChEnableForceUpdate = 0
                  TomChPeriodCompareShadowValSr0 = 0
                  TomChResetCn0OnForceUpdate = 0
                  TomChUpdateEnableOnCn0Reset = 0
                  TomChannelBitReversalMode = 0
                  TomChannelClockSelect = GTM_FIXED_CLOCK_0
                  TomChannelCounterCn0Reset = ON_COMPARE_MATCH_ON_CHANNEL
                  TomChannelCounterValCn0 = 0
                  TomChannelDutyCycleCompareValCm1 = 0
                  TomChannelGatedCounterMode = 0
                  TomChannelOneShotMode = 0
                  TomChannelPeriodCompareValCm0 = 0
                  TomChannelSpeMode = 0
                  TomChannelTriggerOutput = TRIG_FROM_PREVIOUS_CHANNEL
                TomChannelUsage: TomChannelUsage=USED_BY_OTHER_DRIVERS_OR_UNUSED
              TomChannel_13
                TomChannelEnable: TomChDisableOnTgcTrigger=0, TomChannelEnable=AT_START
                TomChannelInterrupt: TomIntEnableOnDutyCycleMatchCcu1=0, TomIntEnableOnPeriodMatchCcu0=0, TomInterruptMode=GTM_INTERRUPT_LEVEL_MODE, TomNotification=NULL_PTR
                TomChannelOutput:
                  TomChOutputDisableOnTgcTrig = 0
                  TomChannelOutputControl = DONT_ENABLE_CHANNEL_OUTPUT
                  TomChannelOutputSignalLevel = LOW
                  TomChannelPortPinSelect = TOUT15_SELA_PORT0_PIN6
                TomChannelTimerParameters:
                  TomChDCycCompareShadowValSr1 = 0
                  TomChEnableForceUpdate = 0
                  TomChPeriodCompareShadowValSr0 = 0
                  TomChResetCn0OnForceUpdate = 0
                  TomChUpdateEnableOnCn0Reset = 0
                  TomChannelBitReversalMode = 0
                  TomChannelClockSelect = GTM_FIXED_CLOCK_0
                  TomChannelCounterCn0Reset = ON_COMPARE_MATCH_ON_CHANNEL
                  TomChannelCounterValCn0 = 0
                  TomChannelDutyCycleCompareValCm1 = 0
                  TomChannelGatedCounterMode = 0
                  TomChannelOneShotMode = 0
                  TomChannelPeriodCompareValCm0 = 0
                  TomChannelSpeMode = 0
                  TomChannelTriggerOutput = TRIG_FROM_PREVIOUS_CHANNEL
                TomChannelUsage: TomChannelUsage=USED_BY_OTHER_DRIVERS_OR_UNUSED
              TomChannel_14
                TomChannelEnable: TomChDisableOnTgcTrigger=0, TomChannelEnable=AT_START
                TomChannelInterrupt: TomIntEnableOnDutyCycleMatchCcu1=0, TomIntEnableOnPeriodMatchCcu0=0, TomInterruptMode=GTM_INTERRUPT_LEVEL_MODE, TomNotification=NULL_PTR
                TomChannelOutput:
                  TomChOutputDisableOnTgcTrig = 0
                  TomChannelOutputControl = DONT_ENABLE_CHANNEL_OUTPUT
                  TomChannelOutputSignalLevel = LOW
                  TomChannelPortPinSelect = TOUT16_SELA_PORT0_PIN7
                TomChannelTimerParameters:
                  TomChDCycCompareShadowValSr1 = 0
                  TomChEnableForceUpdate = 0
                  TomChPeriodCompareShadowValSr0 = 0
                  TomChResetCn0OnForceUpdate = 0
                  TomChUpdateEnableOnCn0Reset = 0
                  TomChannelBitReversalMode = 0
                  TomChannelClockSelect = GTM_FIXED_CLOCK_0
                  TomChannelCounterCn0Reset = ON_COMPARE_MATCH_ON_CHANNEL
                  TomChannelCounterValCn0 = 0
                  TomChannelDutyCycleCompareValCm1 = 0
                  TomChannelGatedCounterMode = 0
                  TomChannelOneShotMode = 0
                  TomChannelPeriodCompareValCm0 = 0
                  TomChannelSpeMode = 0
                  TomChannelTriggerOutput = TRIG_FROM_PREVIOUS_CHANNEL
                TomChannelUsage: TomChannelUsage=USED_BY_OTHER_DRIVERS_OR_UNUSED
              TomChannel_15
                TomChannelEnable: TomChDisableOnTgcTrigger=0, TomChannelEnable=AT_START
                TomChannelInterrupt: TomIntEnableOnDutyCycleMatchCcu1=0, TomIntEnableOnPeriodMatchCcu0=0, TomInterruptMode=GTM_INTERRUPT_LEVEL_MODE, TomNotification=NULL_PTR
                TomChannelOutput:
                  TomChOutputDisableOnTgcTrig = 0
                  TomChannelOutputControl = DONT_ENABLE_CHANNEL_OUTPUT
                  TomChannelOutputSignalLevel = LOW
                  TomChannelPortPinSelect = TOUT17_SELA_PORT0_PIN8
                TomChannelTimerParameters:
                  TomChDCycCompareShadowValSr1 = 0
                  TomChEnableForceUpdate = 0
                  TomChPeriodCompareShadowValSr0 = 0
                  TomChResetCn0OnForceUpdate = 0
                  TomChUpdateEnableOnCn0Reset = 0
                  TomChannelBitReversalMode = 0
                  TomChannelClockSelect = GTM_FIXED_CLOCK_0
                  TomChannelCounterCn0Reset = ON_COMPARE_MATCH_ON_CHANNEL
                  TomChannelCounterValCn0 = 0
                  TomChannelDutyCycleCompareValCm1 = 0
                  TomChannelGatedCounterMode = 0
                  TomChannelOneShotMode = 0
                  TomChannelPeriodCompareValCm0 = 0
                  TomChannelSpeMode = 0
                  TomChannelTriggerOutput = TRIG_FROM_PREVIOUS_CHANNEL
                TomChannelUsage: TomChannelUsage=USED_BY_OTHER_DRIVERS_OR_UNUSED
              TomChannel_2
                TomChannelEnable: TomChDisableOnTgcTrigger=0, TomChannelEnable=AT_START
                TomChannelInterrupt: TomIntEnableOnDutyCycleMatchCcu1=0, TomIntEnableOnPeriodMatchCcu0=0, TomInterruptMode=GTM_INTERRUPT_LEVEL_MODE, TomNotification=NULL_PTR
                TomChannelOutput:
                  TomChOutputDisableOnTgcTrig = 0
                  TomChannelOutputControl = DONT_ENABLE_CHANNEL_OUTPUT
                  TomChannelOutputSignalLevel = LOW
                  TomChannelPortPinSelect = TOUT20_SELA_PORT0_PIN11
                TomChannelTimerParameters:
                  TomChDCycCompareShadowValSr1 = 0
                  TomChEnableForceUpdate = 0
                  TomChPeriodCompareShadowValSr0 = 0
                  TomChResetCn0OnForceUpdate = 0
                  TomChUpdateEnableOnCn0Reset = 0
                  TomChannelBitReversalMode = 0
                  TomChannelClockSelect = GTM_FIXED_CLOCK_0
                  TomChannelCounterCn0Reset = ON_COMPARE_MATCH_ON_CHANNEL
                  TomChannelCounterValCn0 = 0
                  TomChannelDutyCycleCompareValCm1 = 0
                  TomChannelGatedCounterMode = 0
                  TomChannelOneShotMode = 0
                  TomChannelPeriodCompareValCm0 = 0
                  TomChannelSpeMode = 0
                  TomChannelTriggerOutput = TRIG_FROM_PREVIOUS_CHANNEL
                TomChannelUsage: TomChannelUsage=USED_BY_OTHER_DRIVERS_OR_UNUSED
              TomChannel_3
                TomChannelEnable: TomChDisableOnTgcTrigger=0, TomChannelEnable=AT_START
                TomChannelInterrupt: TomIntEnableOnDutyCycleMatchCcu1=0, TomIntEnableOnPeriodMatchCcu0=0, TomInterruptMode=GTM_INTERRUPT_LEVEL_MODE, TomNotification=NULL_PTR
                TomChannelOutput:
                  TomChOutputDisableOnTgcTrig = 0
                  TomChannelOutputControl = DONT_ENABLE_CHANNEL_OUTPUT
                  TomChannelOutputSignalLevel = LOW
                  TomChannelPortPinSelect = TOUT21_SELA_PORT0_PIN12
                TomChannelTimerParameters:
                  TomChDCycCompareShadowValSr1 = 0
                  TomChEnableForceUpdate = 0
                  TomChPeriodCompareShadowValSr0 = 0
                  TomChResetCn0OnForceUpdate = 0
                  TomChUpdateEnableOnCn0Reset = 0
                  TomChannelBitReversalMode = 0
                  TomChannelClockSelect = GTM_FIXED_CLOCK_0
                  TomChannelCounterCn0Reset = ON_COMPARE_MATCH_ON_CHANNEL
                  TomChannelCounterValCn0 = 0
                  TomChannelDutyCycleCompareValCm1 = 0
                  TomChannelGatedCounterMode = 0
                  TomChannelOneShotMode = 0
                  TomChannelPeriodCompareValCm0 = 0
                  TomChannelSpeMode = 0
                  TomChannelTriggerOutput = TRIG_FROM_PREVIOUS_CHANNEL
                TomChannelUsage: TomChannelUsage=USED_BY_OTHER_DRIVERS_OR_UNUSED
              TomChannel_4
                TomChannelEnable: TomChDisableOnTgcTrigger=0, TomChannelEnable=AT_START
                TomChannelInterrupt: TomIntEnableOnDutyCycleMatchCcu1=0, TomIntEnableOnPeriodMatchCcu0=0, TomInterruptMode=GTM_INTERRUPT_LEVEL_MODE, TomNotification=NULL_PTR
                TomChannelOutput:
                  TomChOutputDisableOnTgcTrig = 0
                  TomChannelOutputControl = DONT_ENABLE_CHANNEL_OUTPUT
                  TomChannelOutputSignalLevel = LOW
                  TomChannelPortPinSelect = TOUT102_SELA_PORT10_PIN0
                TomChannelTimerParameters:
                  TomChDCycCompareShadowValSr1 = 0
                  TomChEnableForceUpdate = 0
                  TomChPeriodCompareShadowValSr0 = 0
                  TomChResetCn0OnForceUpdate = 0
                  TomChUpdateEnableOnCn0Reset = 0
                  TomChannelBitReversalMode = 0
                  TomChannelClockSelect = GTM_FIXED_CLOCK_0
                  TomChannelCounterCn0Reset = ON_COMPARE_MATCH_ON_CHANNEL
                  TomChannelCounterValCn0 = 0
                  TomChannelDutyCycleCompareValCm1 = 0
                  TomChannelGatedCounterMode = 0
                  TomChannelOneShotMode = 0
                  TomChannelPeriodCompareValCm0 = 0
                  TomChannelSpeMode = 0
                  TomChannelTriggerOutput = TRIG_FROM_PREVIOUS_CHANNEL
                TomChannelUsage: TomChannelUsage=USED_BY_OTHER_DRIVERS_OR_UNUSED
              TomChannel_5
                TomChannelEnable: TomChDisableOnTgcTrigger=0, TomChannelEnable=AT_START
                TomChannelInterrupt: TomIntEnableOnDutyCycleMatchCcu1=0, TomIntEnableOnPeriodMatchCcu0=0, TomInterruptMode=GTM_INTERRUPT_LEVEL_MODE, TomNotification=NULL_PTR
                TomChannelOutput:
                  TomChOutputDisableOnTgcTrig = 0
                  TomChannelOutputControl = DONT_ENABLE_CHANNEL_OUTPUT
                  TomChannelOutputSignalLevel = LOW
                  TomChannelPortPinSelect = TOUT110_SELA_PORT10_PIN8
                TomChannelTimerParameters:
                  TomChDCycCompareShadowValSr1 = 0
                  TomChEnableForceUpdate = 0
                  TomChPeriodCompareShadowValSr0 = 0
                  TomChResetCn0OnForceUpdate = 0
                  TomChUpdateEnableOnCn0Reset = 0
                  TomChannelBitReversalMode = 0
                  TomChannelClockSelect = GTM_FIXED_CLOCK_0
                  TomChannelCounterCn0Reset = ON_COMPARE_MATCH_ON_CHANNEL
                  TomChannelCounterValCn0 = 0
                  TomChannelDutyCycleCompareValCm1 = 0
                  TomChannelGatedCounterMode = 0
                  TomChannelOneShotMode = 0
                  TomChannelPeriodCompareValCm0 = 0
                  TomChannelSpeMode = 0
                  TomChannelTriggerOutput = TRIG_FROM_PREVIOUS_CHANNEL
                TomChannelUsage: TomChannelUsage=USED_BY_OTHER_DRIVERS_OR_UNUSED
              TomChannel_6
                TomChannelEnable: TomChDisableOnTgcTrigger=0, TomChannelEnable=AT_START
                TomChannelInterrupt: TomIntEnableOnDutyCycleMatchCcu1=0, TomIntEnableOnPeriodMatchCcu0=0, TomInterruptMode=GTM_INTERRUPT_LEVEL_MODE, TomNotification=NULL_PTR
                TomChannelOutput:
                  TomChOutputDisableOnTgcTrig = 0
                  TomChannelOutputControl = DONT_ENABLE_CHANNEL_OUTPUT
                  TomChannelOutputSignalLevel = LOW
                  TomChannelPortPinSelect = TOUT106_SELA_PORT10_PIN4
                TomChannelTimerParameters:
                  TomChDCycCompareShadowValSr1 = 0
                  TomChEnableForceUpdate = 0
                  TomChPeriodCompareShadowValSr0 = 0
                  TomChResetCn0OnForceUpdate = 0
                  TomChUpdateEnableOnCn0Reset = 0
                  TomChannelBitReversalMode = 0
                  TomChannelClockSelect = GTM_FIXED_CLOCK_0
                  TomChannelCounterCn0Reset = ON_COMPARE_MATCH_ON_CHANNEL
                  TomChannelCounterValCn0 = 0
                  TomChannelDutyCycleCompareValCm1 = 0
                  TomChannelGatedCounterMode = 0
                  TomChannelOneShotMode = 0
                  TomChannelPeriodCompareValCm0 = 0
                  TomChannelSpeMode = 0
                  TomChannelTriggerOutput = TRIG_FROM_PREVIOUS_CHANNEL
                TomChannelUsage: TomChannelUsage=USED_BY_OTHER_DRIVERS_OR_UNUSED
              TomChannel_7
                TomChannelEnable: TomChDisableOnTgcTrigger=0, TomChannelEnable=AT_START
                TomChannelInterrupt: TomIntEnableOnDutyCycleMatchCcu1=0, TomIntEnableOnPeriodMatchCcu0=0, TomInterruptMode=GTM_INTERRUPT_LEVEL_MODE, TomNotification=NULL_PTR
                TomChannelOutput:
                  TomChOutputDisableOnTgcTrig = 0
                  TomChannelOutputControl = DONT_ENABLE_CHANNEL_OUTPUT
                  TomChannelOutputSignalLevel = LOW
                  TomChannelPortPinSelect = TOUT93_SELA_PORT13_PIN2
                TomChannelTimerParameters:
                  TomChDCycCompareShadowValSr1 = 0
                  TomChEnableForceUpdate = 0
                  TomChPeriodCompareShadowValSr0 = 0
                  TomChResetCn0OnForceUpdate = 0
                  TomChUpdateEnableOnCn0Reset = 0
                  TomChannelBitReversalMode = 0
                  TomChannelClockSelect = GTM_FIXED_CLOCK_0
                  TomChannelCounterCn0Reset = ON_COMPARE_MATCH_ON_CHANNEL
                  TomChannelCounterValCn0 = 0
                  TomChannelDutyCycleCompareValCm1 = 0
                  TomChannelGatedCounterMode = 0
                  TomChannelOneShotMode = 0
                  TomChannelPeriodCompareValCm0 = 0
                  TomChannelSpeMode = 0
                  TomChannelTriggerOutput = TRIG_FROM_PREVIOUS_CHANNEL
                TomChannelUsage: TomChannelUsage=USED_BY_OTHER_DRIVERS_OR_UNUSED
              TomChannel_8
                TomChannelEnable: TomChDisableOnTgcTrigger=0, TomChannelEnable=AT_START
                TomChannelInterrupt: TomIntEnableOnDutyCycleMatchCcu1=0, TomIntEnableOnPeriodMatchCcu0=0, TomInterruptMode=GTM_INTERRUPT_LEVEL_MODE, TomNotification=NULL_PTR
                TomChannelOutput:
                  TomChOutputDisableOnTgcTrig = 0
                  TomChannelOutputControl = DONT_ENABLE_CHANNEL_OUTPUT
                  TomChannelOutputSignalLevel = LOW
                  TomChannelPortPinSelect = TOUT9_SELA_PORT0_PIN0
                TomChannelTimerParameters:
                  TomChDCycCompareShadowValSr1 = 0
                  TomChEnableForceUpdate = 0
                  TomChPeriodCompareShadowValSr0 = 0
                  TomChResetCn0OnForceUpdate = 0
                  TomChUpdateEnableOnCn0Reset = 0
                  TomChannelBitReversalMode = 0
                  TomChannelClockSelect = GTM_FIXED_CLOCK_0
                  TomChannelCounterCn0Reset = ON_COMPARE_MATCH_ON_CHANNEL
                  TomChannelCounterValCn0 = 0
                  TomChannelDutyCycleCompareValCm1 = 0
                  TomChannelGatedCounterMode = 0
                  TomChannelOneShotMode = 0
                  TomChannelPeriodCompareValCm0 = 0
                  TomChannelSpeMode = 0
                  TomChannelTriggerOutput = TRIG_FROM_PREVIOUS_CHANNEL
                TomChannelUsage: TomChannelUsage=USED_BY_OTHER_DRIVERS_OR_UNUSED
              TomChannel_9
                TomChannelEnable: TomChDisableOnTgcTrigger=0, TomChannelEnable=AT_START
                TomChannelInterrupt: TomIntEnableOnDutyCycleMatchCcu1=0, TomIntEnableOnPeriodMatchCcu0=0, TomInterruptMode=GTM_INTERRUPT_LEVEL_MODE, TomNotification=NULL_PTR
                TomChannelOutput:
                  TomChOutputDisableOnTgcTrig = 0
                  TomChannelOutputControl = DONT_ENABLE_CHANNEL_OUTPUT
                  TomChannelOutputSignalLevel = LOW
                  TomChannelPortPinSelect = TOUT10_SELA_PORT0_PIN1
                TomChannelTimerParameters:
                  TomChDCycCompareShadowValSr1 = 0
                  TomChEnableForceUpdate = 0
                  TomChPeriodCompareShadowValSr0 = 0
                  TomChResetCn0OnForceUpdate = 0
                  TomChUpdateEnableOnCn0Reset = 0
                  TomChannelBitReversalMode = 0
                  TomChannelClockSelect = GTM_FIXED_CLOCK_0
                  TomChannelCounterCn0Reset = ON_COMPARE_MATCH_ON_CHANNEL
                  TomChannelCounterValCn0 = 0
                  TomChannelDutyCycleCompareValCm1 = 0
                  TomChannelGatedCounterMode = 0
                  TomChannelOneShotMode = 0
                  TomChannelPeriodCompareValCm0 = 0
                  TomChannelSpeMode = 0
                  TomChannelTriggerOutput = TRIG_FROM_PREVIOUS_CHANNEL
                TomChannelUsage: TomChannelUsage=USED_BY_OTHER_DRIVERS_OR_UNUSED
            TomTriggersForTgc_0 (TomTriggersForTgc)
              TomTgcInternalTriggerSelect:
                TomTgcIntTriggerFromChannel{0..7} = 0
              TomTgcTriggerByTimebase: TomTgcTbuTimebaseSelect=TBU_TS0_TIMEBASE, TomTgcTimeBaseTriggerEnable=0, TomTgcTimebaseMatchValue=0
            TomTriggersForTgc_1 (TomTriggersForTgc)
              TomTgcInternalTriggerSelect:
                TomTgcIntTriggerFromChannel{0..7} = 0
              TomTgcTriggerByTimebase: TomTgcTbuTimebaseSelect=TBU_TS0_TIMEBASE, TomTgcTimeBaseTriggerEnable=0, TomTgcTimebaseMatchValue=0
          Tom_1
            16 x TomChannel:
              TomChannel_0
                TomChannelEnable: TomChDisableOnTgcTrigger=0, TomChannelEnable=AT_START
                TomChannelInterrupt: TomIntEnableOnDutyCycleMatchCcu1=0, TomIntEnableOnPeriodMatchCcu0=0, TomInterruptMode=GTM_INTERRUPT_LEVEL_MODE, TomNotification=NULL_PTR
                TomChannelOutput:
                  TomChOutputDisableOnTgcTrig = 0
                  TomChannelOutputControl = DONT_ENABLE_CHANNEL_OUTPUT
                  TomChannelOutputSignalLevel = LOW
                  TomChannelPortPinSelect = TOUT9_SELB_PORT0_PIN0
                TomChannelTimerParameters:
                  TomChDCycCompareShadowValSr1 = 0
                  TomChEnableForceUpdate = 0
                  TomChPeriodCompareShadowValSr0 = 0
                  TomChResetCn0OnForceUpdate = 0
                  TomChUpdateEnableOnCn0Reset = 0
                  TomChannelBitReversalMode = 0
                  TomChannelClockSelect = GTM_FIXED_CLOCK_0
                  TomChannelCounterCn0Reset = ON_COMPARE_MATCH_ON_CHANNEL
                  TomChannelCounterValCn0 = 0
                  TomChannelDutyCycleCompareValCm1 = 0
                  TomChannelGatedCounterMode = 0
                  TomChannelOneShotMode = 0
                  TomChannelPeriodCompareValCm0 = 0
                  TomChannelSpeMode = 0
                  TomChannelTriggerOutput = TRIG_FROM_PREVIOUS_CHANNEL
                TomChannelUsage: TomChannelUsage=USED_BY_OTHER_DRIVERS_OR_UNUSED
              TomChannel_1
                TomChannelEnable: TomChDisableOnTgcTrigger=0, TomChannelEnable=AT_START
                TomChannelInterrupt: TomIntEnableOnDutyCycleMatchCcu1=0, TomIntEnableOnPeriodMatchCcu0=0, TomInterruptMode=GTM_INTERRUPT_LEVEL_MODE, TomNotification=NULL_PTR
                TomChannelOutput:
                  TomChOutputDisableOnTgcTrig = 0
                  TomChannelOutputControl = DONT_ENABLE_CHANNEL_OUTPUT
                  TomChannelOutputSignalLevel = LOW
                  TomChannelPortPinSelect = TOUT10_SELB_PORT0_PIN1
                TomChannelTimerParameters:
                  TomChDCycCompareShadowValSr1 = 0
                  TomChEnableForceUpdate = 0
                  TomChPeriodCompareShadowValSr0 = 0
                  TomChResetCn0OnForceUpdate = 0
                  TomChUpdateEnableOnCn0Reset = 0
                  TomChannelBitReversalMode = 0
                  TomChannelClockSelect = GTM_FIXED_CLOCK_0
                  TomChannelCounterCn0Reset = ON_COMPARE_MATCH_ON_CHANNEL
                  TomChannelCounterValCn0 = 0
                  TomChannelDutyCycleCompareValCm1 = 0
                  TomChannelGatedCounterMode = 0
                  TomChannelOneShotMode = 0
                  TomChannelPeriodCompareValCm0 = 0
                  TomChannelSpeMode = 0
                  TomChannelTriggerOutput = TRIG_FROM_PREVIOUS_CHANNEL
                TomChannelUsage: TomChannelUsage=USED_BY_OTHER_DRIVERS_OR_UNUSED
              TomChannel_10
                TomChannelEnable: TomChDisableOnTgcTrigger=0, TomChannelEnable=AT_START
                TomChannelInterrupt: TomIntEnableOnDutyCycleMatchCcu1=0, TomIntEnableOnPeriodMatchCcu0=0, TomInterruptMode=GTM_INTERRUPT_LEVEL_MODE, TomNotification=NULL_PTR
                TomChannelOutput:
                  TomChOutputDisableOnTgcTrig = 0
                  TomChannelOutputControl = DONT_ENABLE_CHANNEL_OUTPUT
                  TomChannelOutputSignalLevel = LOW
                  TomChannelPortPinSelect = TOUT2_SELB_PORT2_PIN2
                TomChannelTimerParameters:
                  TomChDCycCompareShadowValSr1 = 0
                  TomChEnableForceUpdate = 0
                  TomChPeriodCompareShadowValSr0 = 0
                  TomChResetCn0OnForceUpdate = 0
                  TomChUpdateEnableOnCn0Reset = 0
                  TomChannelBitReversalMode = 0
                  TomChannelClockSelect = GTM_FIXED_CLOCK_0
                  TomChannelCounterCn0Reset = ON_COMPARE_MATCH_ON_CHANNEL
                  TomChannelCounterValCn0 = 0
                  TomChannelDutyCycleCompareValCm1 = 0
                  TomChannelGatedCounterMode = 0
                  TomChannelOneShotMode = 0
                  TomChannelPeriodCompareValCm0 = 0
                  TomChannelSpeMode = 0
                  TomChannelTriggerOutput = TRIG_FROM_PREVIOUS_CHANNEL
                TomChannelUsage: TomChannelUsage=USED_BY_OTHER_DRIVERS_OR_UNUSED
              TomChannel_11
                TomChannelEnable: TomChDisableOnTgcTrigger=0, TomChannelEnable=AT_START
                TomChannelInterrupt: TomIntEnableOnDutyCycleMatchCcu1=0, TomIntEnableOnPeriodMatchCcu0=0, TomInterruptMode=GTM_INTERRUPT_LEVEL_MODE, TomNotification=NULL_PTR
                TomChannelOutput:
                  TomChOutputDisableOnTgcTrig = 0
                  TomChannelOutputControl = DONT_ENABLE_CHANNEL_OUTPUT
                  TomChannelOutputSignalLevel = LOW
                  TomChannelPortPinSelect = TOUT3_SELB_PORT2_PIN3
                TomChannelTimerParameters:
                  TomChDCycCompareShadowValSr1 = 0
                  TomChEnableForceUpdate = 0
                  TomChPeriodCompareShadowValSr0 = 0
                  TomChResetCn0OnForceUpdate = 0
                  TomChUpdateEnableOnCn0Reset = 0
                  TomChannelBitReversalMode = 0
                  TomChannelClockSelect = GTM_FIXED_CLOCK_0
                  TomChannelCounterCn0Reset = ON_COMPARE_MATCH_ON_CHANNEL
                  TomChannelCounterValCn0 = 0
                  TomChannelDutyCycleCompareValCm1 = 0
                  TomChannelGatedCounterMode = 0
                  TomChannelOneShotMode = 0
                  TomChannelPeriodCompareValCm0 = 0
                  TomChannelSpeMode = 0
                  TomChannelTriggerOutput = TRIG_FROM_PREVIOUS_CHANNEL
                TomChannelUsage: TomChannelUsage=USED_BY_OTHER_DRIVERS_OR_UNUSED
              TomChannel_12
                TomChannelEnable: TomChDisableOnTgcTrigger=0, TomChannelEnable=AT_START
                TomChannelInterrupt: TomIntEnableOnDutyCycleMatchCcu1=0, TomIntEnableOnPeriodMatchCcu0=0, TomInterruptMode=GTM_INTERRUPT_LEVEL_MODE, TomNotification=NULL_PTR
                TomChannelOutput:
                  TomChOutputDisableOnTgcTrig = 0
                  TomChannelOutputControl = DONT_ENABLE_CHANNEL_OUTPUT
                  TomChannelOutputSignalLevel = LOW
                  TomChannelPortPinSelect = TOUT4_SELB_PORT2_PIN4
                TomChannelTimerParameters:
                  TomChDCycCompareShadowValSr1 = 0
                  TomChEnableForceUpdate = 0
                  TomChPeriodCompareShadowValSr0 = 0
                  TomChResetCn0OnForceUpdate = 0
                  TomChUpdateEnableOnCn0Reset = 0
                  TomChannelBitReversalMode = 0
                  TomChannelClockSelect = GTM_FIXED_CLOCK_0
                  TomChannelCounterCn0Reset = ON_COMPARE_MATCH_ON_CHANNEL
                  TomChannelCounterValCn0 = 0
                  TomChannelDutyCycleCompareValCm1 = 0
                  TomChannelGatedCounterMode = 0
                  TomChannelOneShotMode = 0
                  TomChannelPeriodCompareValCm0 = 0
                  TomChannelSpeMode = 0
                  TomChannelTriggerOutput = TRIG_FROM_PREVIOUS_CHANNEL
                TomChannelUsage: TomChannelUsage=USED_BY_OTHER_DRIVERS_OR_UNUSED
              TomChannel_13
                TomChannelEnable: TomChDisableOnTgcTrigger=0, TomChannelEnable=AT_START
                TomChannelInterrupt: TomIntEnableOnDutyCycleMatchCcu1=0, TomIntEnableOnPeriodMatchCcu0=0, TomInterruptMode=GTM_INTERRUPT_LEVEL_MODE, TomNotification=NULL_PTR
                TomChannelOutput:
                  TomChOutputDisableOnTgcTrig = 0
                  TomChannelOutputControl = DONT_ENABLE_CHANNEL_OUTPUT
                  TomChannelOutputSignalLevel = LOW
                  TomChannelPortPinSelect = TOUT5_SELB_PORT2_PIN5
                TomChannelTimerParameters:
                  TomChDCycCompareShadowValSr1 = 0
                  TomChEnableForceUpdate = 0
                  TomChPeriodCompareShadowValSr0 = 0
                  TomChResetCn0OnForceUpdate = 0
                  TomChUpdateEnableOnCn0Reset = 0
                  TomChannelBitReversalMode = 0
                  TomChannelClockSelect = GTM_FIXED_CLOCK_0
                  TomChannelCounterCn0Reset = ON_COMPARE_MATCH_ON_CHANNEL
                  TomChannelCounterValCn0 = 0
                  TomChannelDutyCycleCompareValCm1 = 0
                  TomChannelGatedCounterMode = 0
                  TomChannelOneShotMode = 0
                  TomChannelPeriodCompareValCm0 = 0
                  TomChannelSpeMode = 0
                  TomChannelTriggerOutput = TRIG_FROM_PREVIOUS_CHANNEL
                TomChannelUsage: TomChannelUsage=USED_BY_OTHER_DRIVERS_OR_UNUSED
              TomChannel_14
                TomChannelEnable: TomChDisableOnTgcTrigger=0, TomChannelEnable=AT_START
                TomChannelInterrupt: TomIntEnableOnDutyCycleMatchCcu1=0, TomIntEnableOnPeriodMatchCcu0=0, TomInterruptMode=GTM_INTERRUPT_LEVEL_MODE, TomNotification=NULL_PTR
                TomChannelOutput:
                  TomChOutputDisableOnTgcTrig = 0
                  TomChannelOutputControl = DONT_ENABLE_CHANNEL_OUTPUT
                  TomChannelOutputSignalLevel = LOW
                  TomChannelPortPinSelect = TOUT6_SELB_PORT2_PIN6
                TomChannelTimerParameters:
                  TomChDCycCompareShadowValSr1 = 0
                  TomChEnableForceUpdate = 0
                  TomChPeriodCompareShadowValSr0 = 0
                  TomChResetCn0OnForceUpdate = 0
                  TomChUpdateEnableOnCn0Reset = 0
                  TomChannelBitReversalMode = 0
                  TomChannelClockSelect = GTM_FIXED_CLOCK_0
                  TomChannelCounterCn0Reset = ON_COMPARE_MATCH_ON_CHANNEL
                  TomChannelCounterValCn0 = 0
                  TomChannelDutyCycleCompareValCm1 = 0
                  TomChannelGatedCounterMode = 0
                  TomChannelOneShotMode = 0
                  TomChannelPeriodCompareValCm0 = 0
                  TomChannelSpeMode = 0
                  TomChannelTriggerOutput = TRIG_FROM_PREVIOUS_CHANNEL
                TomChannelUsage: TomChannelUsage=USED_BY_OTHER_DRIVERS_OR_UNUSED
              TomChannel_15
                TomChannelEnable: TomChDisableOnTgcTrigger=0, TomChannelEnable=AT_START
                TomChannelInterrupt: TomIntEnableOnDutyCycleMatchCcu1=0, TomIntEnableOnPeriodMatchCcu0=0, TomInterruptMode=GTM_INTERRUPT_LEVEL_MODE, TomNotification=NULL_PTR
                TomChannelOutput:
                  TomChOutputDisableOnTgcTrig = 0
                  TomChannelOutputControl = DONT_ENABLE_CHANNEL_OUTPUT
                  TomChannelOutputSignalLevel = LOW
                  TomChannelPortPinSelect = TOUT7_SELB_PORT2_PIN7
                TomChannelTimerParameters:
                  TomChDCycCompareShadowValSr1 = 0
                  TomChEnableForceUpdate = 0
                  TomChPeriodCompareShadowValSr0 = 0
                  TomChResetCn0OnForceUpdate = 0
                  TomChUpdateEnableOnCn0Reset = 0
                  TomChannelBitReversalMode = 0
                  TomChannelClockSelect = GTM_FIXED_CLOCK_0
                  TomChannelCounterCn0Reset = ON_COMPARE_MATCH_ON_CHANNEL
                  TomChannelCounterValCn0 = 0
                  TomChannelDutyCycleCompareValCm1 = 0
                  TomChannelGatedCounterMode = 0
                  TomChannelOneShotMode = 0
                  TomChannelPeriodCompareValCm0 = 0
                  TomChannelSpeMode = 0
                  TomChannelTriggerOutput = TRIG_FROM_PREVIOUS_CHANNEL
                TomChannelUsage: TomChannelUsage=USED_BY_OTHER_DRIVERS_OR_UNUSED
              TomChannel_2
                TomChannelEnable: TomChDisableOnTgcTrigger=0, TomChannelEnable=AT_START
                TomChannelInterrupt: TomIntEnableOnDutyCycleMatchCcu1=0, TomIntEnableOnPeriodMatchCcu0=0, TomInterruptMode=GTM_INTERRUPT_LEVEL_MODE, TomNotification=NULL_PTR
                TomChannelOutput:
                  TomChOutputDisableOnTgcTrig = 0
                  TomChannelOutputControl = DONT_ENABLE_CHANNEL_OUTPUT
                  TomChannelOutputSignalLevel = LOW
                  TomChannelPortPinSelect = TOUT12_SELB_PORT0_PIN3
                TomChannelTimerParameters:
                  TomChDCycCompareShadowValSr1 = 0
                  TomChEnableForceUpdate = 0
                  TomChPeriodCompareShadowValSr0 = 0
                  TomChResetCn0OnForceUpdate = 0
                  TomChUpdateEnableOnCn0Reset = 0
                  TomChannelBitReversalMode = 0
                  TomChannelClockSelect = GTM_FIXED_CLOCK_0
                  TomChannelCounterCn0Reset = ON_COMPARE_MATCH_ON_CHANNEL
                  TomChannelCounterValCn0 = 0
                  TomChannelDutyCycleCompareValCm1 = 0
                  TomChannelGatedCounterMode = 0
                  TomChannelOneShotMode = 0
                  TomChannelPeriodCompareValCm0 = 0
                  TomChannelSpeMode = 0
                  TomChannelTriggerOutput = TRIG_FROM_PREVIOUS_CHANNEL
                TomChannelUsage: TomChannelUsage=USED_BY_OTHER_DRIVERS_OR_UNUSED
              TomChannel_3
                TomChannelEnable: TomChDisableOnTgcTrigger=0, TomChannelEnable=AT_START
                TomChannelInterrupt: TomIntEnableOnDutyCycleMatchCcu1=0, TomIntEnableOnPeriodMatchCcu0=0, TomInterruptMode=GTM_INTERRUPT_LEVEL_MODE, TomNotification=NULL_PTR
                TomChannelOutput:
                  TomChOutputDisableOnTgcTrig = 0
                  TomChannelOutputControl = DONT_ENABLE_CHANNEL_OUTPUT
                  TomChannelOutputSignalLevel = LOW
                  TomChannelPortPinSelect = TOUT13_SELB_PORT0_PIN4
                TomChannelTimerParameters:
                  TomChDCycCompareShadowValSr1 = 0
                  TomChEnableForceUpdate = 0
                  TomChPeriodCompareShadowValSr0 = 0
                  TomChResetCn0OnForceUpdate = 0
                  TomChUpdateEnableOnCn0Reset = 0
                  TomChannelBitReversalMode = 0
                  TomChannelClockSelect = GTM_FIXED_CLOCK_0
                  TomChannelCounterCn0Reset = ON_COMPARE_MATCH_ON_CHANNEL
                  TomChannelCounterValCn0 = 0
                  TomChannelDutyCycleCompareValCm1 = 0
                  TomChannelGatedCounterMode = 0
                  TomChannelOneShotMode = 0
                  TomChannelPeriodCompareValCm0 = 0
                  TomChannelSpeMode = 0
                  TomChannelTriggerOutput = TRIG_FROM_PREVIOUS_CHANNEL
                TomChannelUsage: TomChannelUsage=USED_BY_OTHER_DRIVERS_OR_UNUSED
              TomChannel_4
                TomChannelEnable: TomChDisableOnTgcTrigger=0, TomChannelEnable=AT_START
                TomChannelInterrupt: TomIntEnableOnDutyCycleMatchCcu1=0, TomIntEnableOnPeriodMatchCcu0=0, TomInterruptMode=GTM_INTERRUPT_LEVEL_MODE, TomNotification=NULL_PTR
                TomChannelOutput:
                  TomChOutputDisableOnTgcTrig = 0
                  TomChannelOutputControl = DONT_ENABLE_CHANNEL_OUTPUT
                  TomChannelOutputSignalLevel = LOW
                  TomChannelPortPinSelect = TOUT14_SELB_PORT0_PIN5
                TomChannelTimerParameters:
                  TomChDCycCompareShadowValSr1 = 0
                  TomChEnableForceUpdate = 0
                  TomChPeriodCompareShadowValSr0 = 0
                  TomChResetCn0OnForceUpdate = 0
                  TomChUpdateEnableOnCn0Reset = 0
                  TomChannelBitReversalMode = 0
                  TomChannelClockSelect = GTM_FIXED_CLOCK_0
                  TomChannelCounterCn0Reset = ON_COMPARE_MATCH_ON_CHANNEL
                  TomChannelCounterValCn0 = 0
                  TomChannelDutyCycleCompareValCm1 = 0
                  TomChannelGatedCounterMode = 0
                  TomChannelOneShotMode = 0
                  TomChannelPeriodCompareValCm0 = 0
                  TomChannelSpeMode = 0
                  TomChannelTriggerOutput = TRIG_FROM_PREVIOUS_CHANNEL
                TomChannelUsage: TomChannelUsage=USED_BY_OTHER_DRIVERS_OR_UNUSED
              TomChannel_5
                TomChannelEnable: TomChDisableOnTgcTrigger=0, TomChannelEnable=AT_START
                TomChannelInterrupt: TomIntEnableOnDutyCycleMatchCcu1=0, TomIntEnableOnPeriodMatchCcu0=0, TomInterruptMode=GTM_INTERRUPT_LEVEL_MODE, TomNotification=NULL_PTR
                TomChannelOutput:
                  TomChOutputDisableOnTgcTrig = 0
                  TomChannelOutputControl = DONT_ENABLE_CHANNEL_OUTPUT
                  TomChannelOutputSignalLevel = LOW
                  TomChannelPortPinSelect = TOUT15_SELB_PORT0_PIN6
                TomChannelTimerParameters:
                  TomChDCycCompareShadowValSr1 = 0
                  TomChEnableForceUpdate = 0
                  TomChPeriodCompareShadowValSr0 = 0
                  TomChResetCn0OnForceUpdate = 0
                  TomChUpdateEnableOnCn0Reset = 0
                  TomChannelBitReversalMode = 0
                  TomChannelClockSelect = GTM_FIXED_CLOCK_0
                  TomChannelCounterCn0Reset = ON_COMPARE_MATCH_ON_CHANNEL
                  TomChannelCounterValCn0 = 0
                  TomChannelDutyCycleCompareValCm1 = 0
                  TomChannelGatedCounterMode = 0
                  TomChannelOneShotMode = 0
                  TomChannelPeriodCompareValCm0 = 0
                  TomChannelSpeMode = 0
                  TomChannelTriggerOutput = TRIG_FROM_PREVIOUS_CHANNEL
                TomChannelUsage: TomChannelUsage=USED_BY_OTHER_DRIVERS_OR_UNUSED
              TomChannel_6
                TomChannelEnable: TomChDisableOnTgcTrigger=0, TomChannelEnable=AT_START
                TomChannelInterrupt: TomIntEnableOnDutyCycleMatchCcu1=0, TomIntEnableOnPeriodMatchCcu0=0, TomInterruptMode=GTM_INTERRUPT_LEVEL_MODE, TomNotification=NULL_PTR
                TomChannelOutput:
                  TomChOutputDisableOnTgcTrig = 0
                  TomChannelOutputControl = DONT_ENABLE_CHANNEL_OUTPUT
                  TomChannelOutputSignalLevel = LOW
                  TomChannelPortPinSelect = TOUT16_SELB_PORT0_PIN7
                TomChannelTimerParameters:
                  TomChDCycCompareShadowValSr1 = 0
                  TomChEnableForceUpdate = 0
                  TomChPeriodCompareShadowValSr0 = 0
                  TomChResetCn0OnForceUpdate = 0
                  TomChUpdateEnableOnCn0Reset = 0
                  TomChannelBitReversalMode = 0
                  TomChannelClockSelect = GTM_FIXED_CLOCK_0
                  TomChannelCounterCn0Reset = ON_COMPARE_MATCH_ON_CHANNEL
                  TomChannelCounterValCn0 = 0
                  TomChannelDutyCycleCompareValCm1 = 0
                  TomChannelGatedCounterMode = 0
                  TomChannelOneShotMode = 0
                  TomChannelPeriodCompareValCm0 = 0
                  TomChannelSpeMode = 0
                  TomChannelTriggerOutput = TRIG_FROM_PREVIOUS_CHANNEL
                TomChannelUsage: TomChannelUsage=USED_BY_OTHER_DRIVERS_OR_UNUSED
              TomChannel_7
                TomChannelEnable: TomChDisableOnTgcTrigger=0, TomChannelEnable=AT_START
                TomChannelInterrupt: TomIntEnableOnDutyCycleMatchCcu1=0, TomIntEnableOnPeriodMatchCcu0=0, TomInterruptMode=GTM_INTERRUPT_LEVEL_MODE, TomNotification=NULL_PTR
                TomChannelOutput:
                  TomChOutputDisableOnTgcTrig = 0
                  TomChannelOutputControl = DONT_ENABLE_CHANNEL_OUTPUT
                  TomChannelOutputSignalLevel = LOW
                  TomChannelPortPinSelect = TOUT17_SELB_PORT0_PIN8
                TomChannelTimerParameters:
                  TomChDCycCompareShadowValSr1 = 0
                  TomChEnableForceUpdate = 0
                  TomChPeriodCompareShadowValSr0 = 0
                  TomChResetCn0OnForceUpdate = 0
                  TomChUpdateEnableOnCn0Reset = 0
                  TomChannelBitReversalMode = 0
                  TomChannelClockSelect = GTM_FIXED_CLOCK_0
                  TomChannelCounterCn0Reset = ON_COMPARE_MATCH_ON_CHANNEL
                  TomChannelCounterValCn0 = 0
                  TomChannelDutyCycleCompareValCm1 = 0
                  TomChannelGatedCounterMode = 0
                  TomChannelOneShotMode = 0
                  TomChannelPeriodCompareValCm0 = 0
                  TomChannelSpeMode = 0
                  TomChannelTriggerOutput = TRIG_FROM_PREVIOUS_CHANNEL
                TomChannelUsage: TomChannelUsage=USED_BY_OTHER_DRIVERS_OR_UNUSED
              TomChannel_8
                TomChannelEnable: TomChDisableOnTgcTrigger=0, TomChannelEnable=AT_START
                TomChannelInterrupt: TomIntEnableOnDutyCycleMatchCcu1=0, TomIntEnableOnPeriodMatchCcu0=0, TomInterruptMode=GTM_INTERRUPT_LEVEL_MODE, TomNotification=NULL_PTR
                TomChannelOutput:
                  TomChOutputDisableOnTgcTrig = 0
                  TomChannelOutputControl = DONT_ENABLE_CHANNEL_OUTPUT
                  TomChannelOutputSignalLevel = LOW
                  TomChannelPortPinSelect = TOUT0_SELB_PORT2_PIN0
                TomChannelTimerParameters:
                  TomChDCycCompareShadowValSr1 = 0
                  TomChEnableForceUpdate = 0
                  TomChPeriodCompareShadowValSr0 = 0
                  TomChResetCn0OnForceUpdate = 0
                  TomChUpdateEnableOnCn0Reset = 0
                  TomChannelBitReversalMode = 0
                  TomChannelClockSelect = GTM_FIXED_CLOCK_0
                  TomChannelCounterCn0Reset = ON_COMPARE_MATCH_ON_CHANNEL
                  TomChannelCounterValCn0 = 0
                  TomChannelDutyCycleCompareValCm1 = 0
                  TomChannelGatedCounterMode = 0
                  TomChannelOneShotMode = 0
                  TomChannelPeriodCompareValCm0 = 0
                  TomChannelSpeMode = 0
                  TomChannelTriggerOutput = TRIG_FROM_PREVIOUS_CHANNEL
                TomChannelUsage: TomChannelUsage=USED_BY_OTHER_DRIVERS_OR_UNUSED
              TomChannel_9
                TomChannelEnable: TomChDisableOnTgcTrigger=0, TomChannelEnable=AT_START
                TomChannelInterrupt: TomIntEnableOnDutyCycleMatchCcu1=0, TomIntEnableOnPeriodMatchCcu0=0, TomInterruptMode=GTM_INTERRUPT_LEVEL_MODE, TomNotification=NULL_PTR
                TomChannelOutput:
                  TomChOutputDisableOnTgcTrig = 0
                  TomChannelOutputControl = DONT_ENABLE_CHANNEL_OUTPUT
                  TomChannelOutputSignalLevel = LOW
                  TomChannelPortPinSelect = TOUT1_SELB_PORT2_PIN1
                TomChannelTimerParameters:
                  TomChDCycCompareShadowValSr1 = 0
                  TomChEnableForceUpdate = 0
                  TomChPeriodCompareShadowValSr0 = 0
                  TomChResetCn0OnForceUpdate = 0
                  TomChUpdateEnableOnCn0Reset = 0
                  TomChannelBitReversalMode = 0
                  TomChannelClockSelect = GTM_FIXED_CLOCK_0
                  TomChannelCounterCn0Reset = ON_COMPARE_MATCH_ON_CHANNEL
                  TomChannelCounterValCn0 = 0
                  TomChannelDutyCycleCompareValCm1 = 0
                  TomChannelGatedCounterMode = 0
                  TomChannelOneShotMode = 0
                  TomChannelPeriodCompareValCm0 = 0
                  TomChannelSpeMode = 0
                  TomChannelTriggerOutput = TRIG_FROM_PREVIOUS_CHANNEL
                TomChannelUsage: TomChannelUsage=USED_BY_OTHER_DRIVERS_OR_UNUSED
            TomTriggersForTgc_0 (TomTriggersForTgc)
              TomTgcInternalTriggerSelect:
                TomTgcIntTriggerFromChannel{0..7} = 0
              TomTgcTriggerByTimebase: TomTgcTbuTimebaseSelect=TBU_TS0_TIMEBASE, TomTgcTimeBaseTriggerEnable=0, TomTgcTimebaseMatchValue=0
            TomTriggersForTgc_1 (TomTriggersForTgc)
              TomTgcInternalTriggerSelect:
                TomTgcIntTriggerFromChannel{0..7} = 0
              TomTgcTriggerByTimebase: TomTgcTbuTimebaseSelect=TBU_TS0_TIMEBASE, TomTgcTimeBaseTriggerEnable=0, TomTgcTimebaseMatchValue=0
          Tom_2
            16 x TomChannel:
              TomChannel_0
                TomChannelEnable: TomChDisableOnTgcTrigger=0, TomChannelEnable=AT_START
                TomChannelInterrupt: TomIntEnableOnDutyCycleMatchCcu1=0, TomIntEnableOnPeriodMatchCcu0=0, TomInterruptMode=GTM_INTERRUPT_LEVEL_MODE, TomNotification=NULL_PTR
                TomChannelOutput:
                  TomChOutputDisableOnTgcTrig = 0
                  TomChannelOutputControl = DONT_ENABLE_CHANNEL_OUTPUT
                  TomChannelOutputSignalLevel = LOW
                  TomChannelPortPinSelect = TOUT94_SELB_PORT13_PIN3
                TomChannelTimerParameters:
                  TomChDCycCompareShadowValSr1 = 0
                  TomChEnableForceUpdate = 0
                  TomChPeriodCompareShadowValSr0 = 0
                  TomChResetCn0OnForceUpdate = 0
                  TomChUpdateEnableOnCn0Reset = 0
                  TomChannelBitReversalMode = 0
                  TomChannelClockSelect = GTM_FIXED_CLOCK_0
                  TomChannelCounterCn0Reset = ON_COMPARE_MATCH_ON_CHANNEL
                  TomChannelCounterValCn0 = 0
                  TomChannelDutyCycleCompareValCm1 = 0
                  TomChannelGatedCounterMode = 0
                  TomChannelOneShotMode = 0
                  TomChannelPeriodCompareValCm0 = 0
                  TomChannelSpeMode = 0
                  TomChannelTriggerOutput = TRIG_FROM_PREVIOUS_CHANNEL
                TomChannelUsage: TomChannelUsage=USED_BY_OTHER_DRIVERS_OR_UNUSED
              TomChannel_1
                TomChannelEnable: TomChDisableOnTgcTrigger=0, TomChannelEnable=AT_START
                TomChannelInterrupt: TomIntEnableOnDutyCycleMatchCcu1=0, TomIntEnableOnPeriodMatchCcu0=0, TomInterruptMode=GTM_INTERRUPT_LEVEL_MODE, TomNotification=NULL_PTR
                TomChannelOutput:
                  TomChOutputDisableOnTgcTrig = 0
                  TomChannelOutputControl = DONT_ENABLE_CHANNEL_OUTPUT
                  TomChannelOutputSignalLevel = LOW
                  TomChannelPortPinSelect = TOUT95_SELB_PORT11_PIN2
                TomChannelTimerParameters:
                  TomChDCycCompareShadowValSr1 = 0
                  TomChEnableForceUpdate = 0
                  TomChPeriodCompareShadowValSr0 = 0
                  TomChResetCn0OnForceUpdate = 0
                  TomChUpdateEnableOnCn0Reset = 0
                  TomChannelBitReversalMode = 0
                  TomChannelClockSelect = GTM_FIXED_CLOCK_0
                  TomChannelCounterCn0Reset = ON_COMPARE_MATCH_ON_CHANNEL
                  TomChannelCounterValCn0 = 0
                  TomChannelDutyCycleCompareValCm1 = 0
                  TomChannelGatedCounterMode = 0
                  TomChannelOneShotMode = 0
                  TomChannelPeriodCompareValCm0 = 0
                  TomChannelSpeMode = 0
                  TomChannelTriggerOutput = TRIG_FROM_PREVIOUS_CHANNEL
                TomChannelUsage: TomChannelUsage=USED_BY_OTHER_DRIVERS_OR_UNUSED
              TomChannel_10
                TomChannelEnable: TomChDisableOnTgcTrigger=0, TomChannelEnable=AT_START
                TomChannelInterrupt: TomIntEnableOnDutyCycleMatchCcu1=0, TomIntEnableOnPeriodMatchCcu0=0, TomInterruptMode=GTM_INTERRUPT_LEVEL_MODE, TomNotification=NULL_PTR
                TomChannelOutput:
                  TomChOutputDisableOnTgcTrig = 0
                  TomChannelOutputControl = DONT_ENABLE_CHANNEL_OUTPUT
                  TomChannelOutputSignalLevel = LOW
                  TomChannelPortPinSelect = TOUT104_SELB_PORT10_PIN2
                TomChannelTimerParameters:
                  TomChDCycCompareShadowValSr1 = 0
                  TomChEnableForceUpdate = 0
                  TomChPeriodCompareShadowValSr0 = 0
                  TomChResetCn0OnForceUpdate = 0
                  TomChUpdateEnableOnCn0Reset = 0
                  TomChannelBitReversalMode = 0
                  TomChannelClockSelect = GTM_FIXED_CLOCK_0
                  TomChannelCounterCn0Reset = ON_COMPARE_MATCH_ON_CHANNEL
                  TomChannelCounterValCn0 = 0
                  TomChannelDutyCycleCompareValCm1 = 0
                  TomChannelGatedCounterMode = 0
                  TomChannelOneShotMode = 0
                  TomChannelPeriodCompareValCm0 = 0
                  TomChannelSpeMode = 0
                  TomChannelTriggerOutput = TRIG_FROM_PREVIOUS_CHANNEL
                TomChannelUsage: TomChannelUsage=USED_BY_OTHER_DRIVERS_OR_UNUSED
              TomChannel_11
                TomChannelEnable: TomChDisableOnTgcTrigger=0, TomChannelEnable=AT_START
                TomChannelInterrupt: TomIntEnableOnDutyCycleMatchCcu1=0, TomIntEnableOnPeriodMatchCcu0=0, TomInterruptMode=GTM_INTERRUPT_LEVEL_MODE, TomNotification=NULL_PTR
                TomChannelOutput:
                  TomChOutputDisableOnTgcTrig = 0
                  TomChannelOutputControl = DONT_ENABLE_CHANNEL_OUTPUT
                  TomChannelOutputSignalLevel = LOW
                  TomChannelPortPinSelect = TOUT105_SELB_PORT10_PIN3
                TomChannelTimerParameters:
                  TomChDCycCompareShadowValSr1 = 0
                  TomChEnableForceUpdate = 0
                  TomChPeriodCompareShadowValSr0 = 0
                  TomChResetCn0OnForceUpdate = 0
                  TomChUpdateEnableOnCn0Reset = 0
                  TomChannelBitReversalMode = 0
                  TomChannelClockSelect = GTM_FIXED_CLOCK_0
                  TomChannelCounterCn0Reset = ON_COMPARE_MATCH_ON_CHANNEL
                  TomChannelCounterValCn0 = 0
                  TomChannelDutyCycleCompareValCm1 = 0
                  TomChannelGatedCounterMode = 0
                  TomChannelOneShotMode = 0
                  TomChannelPeriodCompareValCm0 = 0
                  TomChannelSpeMode = 0
                  TomChannelTriggerOutput = TRIG_FROM_PREVIOUS_CHANNEL
                TomChannelUsage: TomChannelUsage=USED_BY_OTHER_DRIVERS_OR_UNUSED
              TomChannel_12
                TomChannelEnable: TomChDisableOnTgcTrigger=0, TomChannelEnable=AT_START
                TomChannelInterrupt: TomIntEnableOnDutyCycleMatchCcu1=0, TomIntEnableOnPeriodMatchCcu0=0, TomInterruptMode=GTM_INTERRUPT_LEVEL_MODE, TomNotification=NULL_PTR
                TomChannelOutput:
                  TomChOutputDisableOnTgcTrig = 0
                  TomChannelOutputControl = DONT_ENABLE_CHANNEL_OUTPUT
                  TomChannelOutputSignalLevel = LOW
                  TomChannelPortPinSelect = TOUT102_SELB_PORT10_PIN0
                TomChannelTimerParameters:
                  TomChDCycCompareShadowValSr1 = 0
                  TomChEnableForceUpdate = 0
                  TomChPeriodCompareShadowValSr0 = 0
                  TomChResetCn0OnForceUpdate = 0
                  TomChUpdateEnableOnCn0Reset = 0
                  TomChannelBitReversalMode = 0
                  TomChannelClockSelect = GTM_FIXED_CLOCK_0
                  TomChannelCounterCn0Reset = ON_COMPARE_MATCH_ON_CHANNEL
                  TomChannelCounterValCn0 = 0
                  TomChannelDutyCycleCompareValCm1 = 0
                  TomChannelGatedCounterMode = 0
                  TomChannelOneShotMode = 0
                  TomChannelPeriodCompareValCm0 = 0
                  TomChannelSpeMode = 0
                  TomChannelTriggerOutput = TRIG_FROM_PREVIOUS_CHANNEL
                TomChannelUsage: TomChannelUsage=USED_BY_OTHER_DRIVERS_OR_UNUSED
              TomChannel_13
                TomChannelEnable: TomChDisableOnTgcTrigger=0, TomChannelEnable=AT_START
                TomChannelInterrupt: TomIntEnableOnDutyCycleMatchCcu1=0, TomIntEnableOnPeriodMatchCcu0=0, TomInterruptMode=GTM_INTERRUPT_LEVEL_MODE, TomNotification=NULL_PTR
                TomChannelOutput:
                  TomChOutputDisableOnTgcTrig = 0
                  TomChannelOutputControl = DONT_ENABLE_CHANNEL_OUTPUT
                  TomChannelOutputSignalLevel = LOW
                  TomChannelPortPinSelect = TOUT110_SELB_PORT10_PIN8
                TomChannelTimerParameters:
                  TomChDCycCompareShadowValSr1 = 0
                  TomChEnableForceUpdate = 0
                  TomChPeriodCompareShadowValSr0 = 0
                  TomChResetCn0OnForceUpdate = 0
                  TomChUpdateEnableOnCn0Reset = 0
                  TomChannelBitReversalMode = 0
                  TomChannelClockSelect = GTM_FIXED_CLOCK_0
                  TomChannelCounterCn0Reset = ON_COMPARE_MATCH_ON_CHANNEL
                  TomChannelCounterValCn0 = 0
                  TomChannelDutyCycleCompareValCm1 = 0
                  TomChannelGatedCounterMode = 0
                  TomChannelOneShotMode = 0
                  TomChannelPeriodCompareValCm0 = 0
                  TomChannelSpeMode = 0
                  TomChannelTriggerOutput = TRIG_FROM_PREVIOUS_CHANNEL
                TomChannelUsage: TomChannelUsage=USED_BY_OTHER_DRIVERS_OR_UNUSED
              TomChannel_14
                TomChannelEnable: TomChDisableOnTgcTrigger=0, TomChannelEnable=AT_START
                TomChannelInterrupt: TomIntEnableOnDutyCycleMatchCcu1=0, TomIntEnableOnPeriodMatchCcu0=0, TomInterruptMode=GTM_INTERRUPT_LEVEL_MODE, TomNotification=NULL_PTR
                TomChannelOutput:
                  TomChOutputDisableOnTgcTrig = 0
                  TomChannelOutputControl = DONT_ENABLE_CHANNEL_OUTPUT
                  TomChannelOutputSignalLevel = LOW
                  TomChannelPortPinSelect = TOUT74_SELB_PORT15_PIN3
                TomChannelTimerParameters:
                  TomChDCycCompareShadowValSr1 = 0
                  TomChEnableForceUpdate = 0
                  TomChPeriodCompareShadowValSr0 = 0
                  TomChResetCn0OnForceUpdate = 0
                  TomChUpdateEnableOnCn0Reset = 0
                  TomChannelBitReversalMode = 0
                  TomChannelClockSelect = GTM_FIXED_CLOCK_0
                  TomChannelCounterCn0Reset = ON_COMPARE_MATCH_ON_CHANNEL
                  TomChannelCounterValCn0 = 0
                  TomChannelDutyCycleCompareValCm1 = 0
                  TomChannelGatedCounterMode = 0
                  TomChannelOneShotMode = 0
                  TomChannelPeriodCompareValCm0 = 0
                  TomChannelSpeMode = 0
                  TomChannelTriggerOutput = TRIG_FROM_PREVIOUS_CHANNEL
                TomChannelUsage: TomChannelUsage=USED_BY_OTHER_DRIVERS_OR_UNUSED
              TomChannel_15
                TomChannelEnable: TomChDisableOnTgcTrigger=0, TomChannelEnable=AT_START
                TomChannelInterrupt: TomIntEnableOnDutyCycleMatchCcu1=0, TomIntEnableOnPeriodMatchCcu0=0, TomInterruptMode=GTM_INTERRUPT_LEVEL_MODE, TomNotification=NULL_PTR
                TomChannelOutput:
                  TomChOutputDisableOnTgcTrig = 0
                  TomChannelOutputControl = DONT_ENABLE_CHANNEL_OUTPUT
                  TomChannelOutputSignalLevel = LOW
                  TomChannelPortPinSelect = TOUT75_SELB_PORT15_PIN4
                TomChannelTimerParameters:
                  TomChDCycCompareShadowValSr1 = 0
                  TomChEnableForceUpdate = 0
                  TomChPeriodCompareShadowValSr0 = 0
                  TomChResetCn0OnForceUpdate = 0
                  TomChUpdateEnableOnCn0Reset = 0
                  TomChannelBitReversalMode = 0
                  TomChannelClockSelect = GTM_FIXED_CLOCK_0
                  TomChannelCounterCn0Reset = ON_COMPARE_MATCH_ON_CHANNEL
                  TomChannelCounterValCn0 = 0
                  TomChannelDutyCycleCompareValCm1 = 0
                  TomChannelGatedCounterMode = 0
                  TomChannelOneShotMode = 0
                  TomChannelPeriodCompareValCm0 = 0
                  TomChannelSpeMode = 0
                  TomChannelTriggerOutput = TRIG_FROM_PREVIOUS_CHANNEL
                TomChannelUsage: TomChannelUsage=USED_BY_OTHER_DRIVERS_OR_UNUSED
              TomChannel_2
                TomChannelEnable: TomChDisableOnTgcTrigger=0, TomChannelEnable=AT_START
                TomChannelInterrupt: TomIntEnableOnDutyCycleMatchCcu1=0, TomIntEnableOnPeriodMatchCcu0=0, TomInterruptMode=GTM_INTERRUPT_LEVEL_MODE, TomNotification=NULL_PTR
                TomChannelOutput:
                  TomChOutputDisableOnTgcTrig = 0
                  TomChannelOutputControl = DONT_ENABLE_CHANNEL_OUTPUT
                  TomChannelOutputSignalLevel = LOW
                  TomChannelPortPinSelect = TOUT96_SELB_PORT11_PIN3
                TomChannelTimerParameters:
                  TomChDCycCompareShadowValSr1 = 0
                  TomChEnableForceUpdate = 0
                  TomChPeriodCompareShadowValSr0 = 0
                  TomChResetCn0OnForceUpdate = 0
                  TomChUpdateEnableOnCn0Reset = 0
                  TomChannelBitReversalMode = 0
                  TomChannelClockSelect = GTM_FIXED_CLOCK_0
                  TomChannelCounterCn0Reset = ON_COMPARE_MATCH_ON_CHANNEL
                  TomChannelCounterValCn0 = 0
                  TomChannelDutyCycleCompareValCm1 = 0
                  TomChannelGatedCounterMode = 0
                  TomChannelOneShotMode = 0
                  TomChannelPeriodCompareValCm0 = 0
                  TomChannelSpeMode = 0
                  TomChannelTriggerOutput = TRIG_FROM_PREVIOUS_CHANNEL
                TomChannelUsage: TomChannelUsage=USED_BY_OTHER_DRIVERS_OR_UNUSED
              TomChannel_3
                TomChannelEnable: TomChDisableOnTgcTrigger=0, TomChannelEnable=AT_START
                TomChannelInterrupt: TomIntEnableOnDutyCycleMatchCcu1=0, TomIntEnableOnPeriodMatchCcu0=0, TomInterruptMode=GTM_INTERRUPT_LEVEL_MODE, TomNotification=NULL_PTR
                TomChannelOutput:
                  TomChOutputDisableOnTgcTrig = 0
                  TomChannelOutputControl = DONT_ENABLE_CHANNEL_OUTPUT
                  TomChannelOutputSignalLevel = LOW
                  TomChannelPortPinSelect = TOUT97_SELB_PORT11_PIN6
                TomChannelTimerParameters:
                  TomChDCycCompareShadowValSr1 = 0
                  TomChEnableForceUpdate = 0
                  TomChPeriodCompareShadowValSr0 = 0
                  TomChResetCn0OnForceUpdate = 0
                  TomChUpdateEnableOnCn0Reset = 0
                  TomChannelBitReversalMode = 0
                  TomChannelClockSelect = GTM_FIXED_CLOCK_0
                  TomChannelCounterCn0Reset = ON_COMPARE_MATCH_ON_CHANNEL
                  TomChannelCounterValCn0 = 0
                  TomChannelDutyCycleCompareValCm1 = 0
                  TomChannelGatedCounterMode = 0
                  TomChannelOneShotMode = 0
                  TomChannelPeriodCompareValCm0 = 0
                  TomChannelSpeMode = 0
                  TomChannelTriggerOutput = TRIG_FROM_PREVIOUS_CHANNEL
                TomChannelUsage: TomChannelUsage=USED_BY_OTHER_DRIVERS_OR_UNUSED
              TomChannel_4
                TomChannelEnable: TomChDisableOnTgcTrigger=0, TomChannelEnable=AT_START
                TomChannelInterrupt: TomIntEnableOnDutyCycleMatchCcu1=0, TomIntEnableOnPeriodMatchCcu0=0, TomInterruptMode=GTM_INTERRUPT_LEVEL_MODE, TomNotification=NULL_PTR
                TomChannelOutput:
                  TomChOutputDisableOnTgcTrig = 0
                  TomChannelOutputControl = DONT_ENABLE_CHANNEL_OUTPUT
                  TomChannelOutputSignalLevel = LOW
                  TomChannelPortPinSelect = TOUT98_SELB_PORT11_PIN9
                TomChannelTimerParameters:
                  TomChDCycCompareShadowValSr1 = 0
                  TomChEnableForceUpdate = 0
                  TomChPeriodCompareShadowValSr0 = 0
                  TomChResetCn0OnForceUpdate = 0
                  TomChUpdateEnableOnCn0Reset = 0
                  TomChannelBitReversalMode = 0
                  TomChannelClockSelect = GTM_FIXED_CLOCK_0
                  TomChannelCounterCn0Reset = ON_COMPARE_MATCH_ON_CHANNEL
                  TomChannelCounterValCn0 = 0
                  TomChannelDutyCycleCompareValCm1 = 0
                  TomChannelGatedCounterMode = 0
                  TomChannelOneShotMode = 0
                  TomChannelPeriodCompareValCm0 = 0
                  TomChannelSpeMode = 0
                  TomChannelTriggerOutput = TRIG_FROM_PREVIOUS_CHANNEL
                TomChannelUsage: TomChannelUsage=USED_BY_OTHER_DRIVERS_OR_UNUSED
              TomChannel_5
                TomChannelEnable: TomChDisableOnTgcTrigger=0, TomChannelEnable=AT_START
                TomChannelInterrupt: TomIntEnableOnDutyCycleMatchCcu1=0, TomIntEnableOnPeriodMatchCcu0=0, TomInterruptMode=GTM_INTERRUPT_LEVEL_MODE, TomNotification=NULL_PTR
                TomChannelOutput:
                  TomChOutputDisableOnTgcTrig = 0
                  TomChannelOutputControl = DONT_ENABLE_CHANNEL_OUTPUT
                  TomChannelOutputSignalLevel = LOW
                  TomChannelPortPinSelect = TOUT99_SELB_PORT11_PIN10
                TomChannelTimerParameters:
                  TomChDCycCompareShadowValSr1 = 0
                  TomChEnableForceUpdate = 0
                  TomChPeriodCompareShadowValSr0 = 0
                  TomChResetCn0OnForceUpdate = 0
                  TomChUpdateEnableOnCn0Reset = 0
                  TomChannelBitReversalMode = 0
                  TomChannelClockSelect = GTM_FIXED_CLOCK_0
                  TomChannelCounterCn0Reset = ON_COMPARE_MATCH_ON_CHANNEL
                  TomChannelCounterValCn0 = 0
                  TomChannelDutyCycleCompareValCm1 = 0
                  TomChannelGatedCounterMode = 0
                  TomChannelOneShotMode = 0
                  TomChannelPeriodCompareValCm0 = 0
                  TomChannelSpeMode = 0
                  TomChannelTriggerOutput = TRIG_FROM_PREVIOUS_CHANNEL
                TomChannelUsage: TomChannelUsage=USED_BY_OTHER_DRIVERS_OR_UNUSED
              TomChannel_6
                TomChannelEnable: TomChDisableOnTgcTrigger=0, TomChannelEnable=AT_START
                TomChannelInterrupt: TomIntEnableOnDutyCycleMatchCcu1=0, TomIntEnableOnPeriodMatchCcu0=0, TomInterruptMode=GTM_INTERRUPT_LEVEL_MODE, TomNotification=NULL_PTR
                TomChannelOutput:
                  TomChOutputDisableOnTgcTrig = 0
                  TomChannelOutputControl = DONT_ENABLE_CHANNEL_OUTPUT
                  TomChannelOutputSignalLevel = LOW
                  TomChannelPortPinSelect = TOUT106_SELB_PORT10_PIN4
                TomChannelTimerParameters:
                  TomChDCycCompareShadowValSr1 = 0
                  TomChEnableForceUpdate = 0
                  TomChPeriodCompareShadowValSr0 = 0
                  TomChResetCn0OnForceUpdate = 0
                  TomChUpdateEnableOnCn0Reset = 0
                  TomChannelBitReversalMode = 0
                  TomChannelClockSelect = GTM_FIXED_CLOCK_0
                  TomChannelCounterCn0Reset = ON_COMPARE_MATCH_ON_CHANNEL
                  TomChannelCounterValCn0 = 0
                  TomChannelDutyCycleCompareValCm1 = 0
                  TomChannelGatedCounterMode = 0
                  TomChannelOneShotMode = 0
                  TomChannelPeriodCompareValCm0 = 0
                  TomChannelSpeMode = 0
                  TomChannelTriggerOutput = TRIG_FROM_PREVIOUS_CHANNEL
                TomChannelUsage: TomChannelUsage=USED_BY_OTHER_DRIVERS_OR_UNUSED
              TomChannel_7
                TomChannelEnable: TomChDisableOnTgcTrigger=0, TomChannelEnable=AT_START
                TomChannelInterrupt: TomIntEnableOnDutyCycleMatchCcu1=0, TomIntEnableOnPeriodMatchCcu0=0, TomInterruptMode=GTM_INTERRUPT_LEVEL_MODE, TomNotification=NULL_PTR
                TomChannelOutput:
                  TomChOutputDisableOnTgcTrig = 0
                  TomChannelOutputControl = DONT_ENABLE_CHANNEL_OUTPUT
                  TomChannelOutputSignalLevel = LOW
                  TomChannelPortPinSelect = TOUT101_SELB_PORT11_PIN12
                TomChannelTimerParameters:
                  TomChDCycCompareShadowValSr1 = 0
                  TomChEnableForceUpdate = 0
                  TomChPeriodCompareShadowValSr0 = 0
                  TomChResetCn0OnForceUpdate = 0
                  TomChUpdateEnableOnCn0Reset = 0
                  TomChannelBitReversalMode = 0
                  TomChannelClockSelect = GTM_FIXED_CLOCK_0
                  TomChannelCounterCn0Reset = ON_COMPARE_MATCH_ON_CHANNEL
                  TomChannelCounterValCn0 = 0
                  TomChannelDutyCycleCompareValCm1 = 0
                  TomChannelGatedCounterMode = 0
                  TomChannelOneShotMode = 0
                  TomChannelPeriodCompareValCm0 = 0
                  TomChannelSpeMode = 0
                  TomChannelTriggerOutput = TRIG_FROM_PREVIOUS_CHANNEL
                TomChannelUsage: TomChannelUsage=USED_BY_OTHER_DRIVERS_OR_UNUSED
              TomChannel_8
                TomChannelEnable: TomChDisableOnTgcTrigger=0, TomChannelEnable=AT_START
                TomChannelInterrupt: TomIntEnableOnDutyCycleMatchCcu1=0, TomIntEnableOnPeriodMatchCcu0=0, TomInterruptMode=GTM_INTERRUPT_LEVEL_MODE, TomNotification=NULL_PTR
                TomChannelOutput:
                  TomChOutputDisableOnTgcTrig = 0
                  TomChannelOutputControl = DONT_ENABLE_CHANNEL_OUTPUT
                  TomChannelOutputSignalLevel = LOW
                  TomChannelPortPinSelect = TOUT109_SELB_PORT10_PIN7
                TomChannelTimerParameters:
                  TomChDCycCompareShadowValSr1 = 0
                  TomChEnableForceUpdate = 0
                  TomChPeriodCompareShadowValSr0 = 0
                  TomChResetCn0OnForceUpdate = 0
                  TomChUpdateEnableOnCn0Reset = 0
                  TomChannelBitReversalMode = 0
                  TomChannelClockSelect = GTM_FIXED_CLOCK_0
                  TomChannelCounterCn0Reset = ON_COMPARE_MATCH_ON_CHANNEL
                  TomChannelCounterValCn0 = 0
                  TomChannelDutyCycleCompareValCm1 = 0
                  TomChannelGatedCounterMode = 0
                  TomChannelOneShotMode = 0
                  TomChannelPeriodCompareValCm0 = 0
                  TomChannelSpeMode = 0
                  TomChannelTriggerOutput = TRIG_FROM_PREVIOUS_CHANNEL
                TomChannelUsage: TomChannelUsage=USED_BY_OTHER_DRIVERS_OR_UNUSED
              TomChannel_9
                TomChannelEnable: TomChDisableOnTgcTrigger=0, TomChannelEnable=AT_START
                TomChannelInterrupt: TomIntEnableOnDutyCycleMatchCcu1=0, TomIntEnableOnPeriodMatchCcu0=0, TomInterruptMode=GTM_INTERRUPT_LEVEL_MODE, TomNotification=NULL_PTR
                TomChannelOutput:
                  TomChOutputDisableOnTgcTrig = 0
                  TomChannelOutputControl = DONT_ENABLE_CHANNEL_OUTPUT
                  TomChannelOutputSignalLevel = LOW
                  TomChannelPortPinSelect = TOUT103_SELB_PORT10_PIN1
                TomChannelTimerParameters:
                  TomChDCycCompareShadowValSr1 = 0
                  TomChEnableForceUpdate = 0
                  TomChPeriodCompareShadowValSr0 = 0
                  TomChResetCn0OnForceUpdate = 0
                  TomChUpdateEnableOnCn0Reset = 0
                  TomChannelBitReversalMode = 0
                  TomChannelClockSelect = GTM_FIXED_CLOCK_0
                  TomChannelCounterCn0Reset = ON_COMPARE_MATCH_ON_CHANNEL
                  TomChannelCounterValCn0 = 0
                  TomChannelDutyCycleCompareValCm1 = 0
                  TomChannelGatedCounterMode = 0
                  TomChannelOneShotMode = 0
                  TomChannelPeriodCompareValCm0 = 0
                  TomChannelSpeMode = 0
                  TomChannelTriggerOutput = TRIG_FROM_PREVIOUS_CHANNEL
                TomChannelUsage: TomChannelUsage=USED_BY_OTHER_DRIVERS_OR_UNUSED
            TomTriggersForTgc_0 (TomTriggersForTgc)
              TomTgcInternalTriggerSelect:
                TomTgcIntTriggerFromChannel{0..7} = 0
              TomTgcTriggerByTimebase: TomTgcTbuTimebaseSelect=TBU_TS0_TIMEBASE, TomTgcTimeBaseTriggerEnable=0, TomTgcTimebaseMatchValue=0
            TomTriggersForTgc_1 (TomTriggersForTgc)
              TomTgcInternalTriggerSelect:
                TomTgcIntTriggerFromChannel{0..7} = 0
              TomTgcTriggerByTimebase: TomTgcTbuTimebaseSelect=TBU_TS0_TIMEBASE, TomTgcTimeBaseTriggerEnable=0, TomTgcTimebaseMatchValue=0
      McuClockSettingConfig_0 (McuClockSettingConfig): McuClockSettingId=0
        McuClockReferencePoint:
          McuASCLINFDivider = 2
          McuASCLINSDivider = 2
          McuBAUD1Divider = 2
          McuBAUD2Divider = 2
          McuBBBDivider = 2
          McuCANDivider = 2
          McuCPU{0..2}Divider = 0
          McuClockASCLINFFrequency = 8.0E7
          McuClockASCLINSFrequency = 8.0E7
          McuClockBAUD1Frequency = 8.0E7
          McuClockBAUD2Frequency = 8.0E7
          McuClockBBBFrequency = 8.0E7
          McuClockCANFrequency = 8.0E7
          McuClockCPU{0..2}Frequency = 1.6E8
          McuClockEBUFrequency = 0.0
          McuClockErayFrequency = 8.0E7
          McuClockErayPll2Frequency = 9.6E7
          McuClockErayPllFrequency = 1.6E8
          McuClockFSI2Frequency = 1.6E8
          McuClockFSIFrequency = 8.0E7
          McuClockGTMFrequency = 8.0E7
          McuClockMAXFrequency = 1.6E8
          McuClockReferencePoint2Frequency = 9.6E7
          McuClockReferencePointFrequency = 1.6E8
          McuClockSPBFrequency = 8.0E7
          McuClockSRIFrequency = 1.6E8
          McuClockSTMFrequency = 8.0E7
          McuClockSettingMode = NORMAL_MODE
          McuEBUDivider = 0
          McuETHDivider = 1
          McuETHFrequency = 4.0E7
          McuErayDivider = 2
          McuErayPllK2Divider = 2
          McuErayPllK3Divider = 4
          McuErayPllNDivider = 23
          McuErayPllPDivider = 0
          McuFMPllModAmp = 1.25
          McuFSI2Divider = 1
          McuFSIDivider = 2
          McuGTMDivider = 2
          McuK2DivRampToBackUpConfDelay = 10
          McuK2DivRampToPllConfDelay = 10
          McuK2DivSteps = 4
          McuMAXDivider = 1
          McuPllK1Divider = 1
          McuPllK2Divider = 2
          McuPllK3Divider = 4
          McuPllNDivider = 23
          McuPllPDivider = 0
          McuSPBDivider = 2
          McuSRIDivider = 1
          McuSTMDivider = 2
      McuModeSettingConf_0 (McuModeSettingConf): McuIdleReqAckSeqDisable=0, McuMode=0
        McuStandbySettingConf:
          McuESR0TristateEnable = 0
          McuESR1DigitalFilterEnable = 0
          McuESR1EdgeDetection = TRIGGER_ANY_EDGE
          McuESR1WakeUpEnable = 0
          McuExtSupplyBlankingFilterDelay = T2_5MS
          McuPORSTDigitalFilterEnable = 0
          McuPinADigitalFilterEnable = 0
          McuPinAEdgeDetection = TRIGGER_ANY_EDGE
          McuPinAWakeUpEnable = 0
          McuPinBDigitalFilterEnable = 0
          McuPinBEdgeDetection = TRIGGER_ANY_EDGE
          McuPinBWakeUpEnable = 0
          McuRARCrcCheckEnable = 0
          McuRampToBackupFreqApi = 0
          McuSetStandbyWakeupControlApi = 0
          McuStandbyRAMSupplyEnable = 1
          McuTristateEnable = 0
          McuWakeupOnExtSupplyRampUpEnable = 0
      McuTriggerReset: ESR0ResetTrigger=0, ESR1ResetTrigger=0, SMUResetTrigger=1, STM0ResetTrigger=0, STM1ResetTrigger=0, STM2ResetTrigger=0
    McuSafety: McuClockMonitoringEnable=1, McuGetModeApi=1, McuInitCheckApi=1, McuSafetyEnable=0
    CommonPublishedInformation:
      ArMajorVersion = 3
      ArMinorVersion = 2
      ArPatchVersion = 0
      ModuleId = 101
      Release = _TRICORE_TC275
      SwMajorVersion = 4
      SwMinorVersion = 9
      SwPatchVersion = 1
      VendorId = 17
package /Irq
  module config Irq: implementation-config-variant=VARIANT-PRE-COMPILE
    IrqGeneral: IrqOsekEnable=1
    IrqAscLinConfig_0 (IrqAscLinConfig)
      IrqAscLinCatConfig
        IrqAscLinErrCatConfig: IrqAscLin0ErrorCat=CAT1, IrqAscLin1ErrorCat=CAT1, IrqAscLin2ErrorCat=CAT1, IrqAscLin3ErrorCat=CAT1
        IrqAscLinRxCatConfig: IrqAscLin0RxCat=CAT1, IrqAscLin1RxCat=CAT1, IrqAscLin2RxCat=CAT1, IrqAscLin3RxCat=CAT1
        IrqAscLinTxCatConfig: IrqAscLin0TxCat=CAT1, IrqAscLin1TxCat=CAT1, IrqAscLin2TxCat=CAT1, IrqAscLin3TxCat=CAT1
      IrqAscLinPrioConfig
        IrqAscLinErrPrioConfig: IrqAscLin0ErrorPrio=0, IrqAscLin1ErrorPrio=0, IrqAscLin2ErrorPrio=0, IrqAscLin3ErrorPrio=0
        IrqAscLinRxPrioConfig: IrqAscLin0RxPrio=0, IrqAscLin1RxPrio=0, IrqAscLin2RxPrio=0, IrqAscLin3RxPrio=0
        IrqAscLinTxPrioConfig: IrqAscLin0TxPrio=0, IrqAscLin1TxPrio=0, IrqAscLin2TxPrio=0, IrqAscLin3TxPrio=0
      IrqAscLinTosConfig
        IrqAscLinErrTosConfig: IrqAscLin0ErrTos=CPU0, IrqAscLin1ErrTos=CPU0, IrqAscLin2ErrTos=CPU0, IrqAscLin3ErrTos=CPU0
        IrqAscLinRxTosConfig: IrqAscLin0RxTos=CPU0, IrqAscLin1RxTos=CPU0, IrqAscLin2RxTos=CPU0, IrqAscLin3RxTos=CPU0
        IrqAscLinTxTosConfig: IrqAscLin0TxTos=CPU0, IrqAscLin1TxTos=CPU0, IrqAscLin2TxTos=CPU0, IrqAscLin3TxTos=CPU0
    IrqQspiConfig_0 (IrqQspiConfig)
      IrqQspiCatConfig
        IrqQspiErrCatConfig: IrqQspi0ErrCat=CAT1, IrqQspi1ErrCat=CAT1, IrqQspi2ErrCat=CAT1, IrqQspi3ErrCat=CAT1
        IrqQspiHCCatConfig: IrqQspi0HCCat=CAT1, IrqQspi1HCCat=CAT1, IrqQspi2HCCat=CAT1, IrqQspi3HCCat=CAT1
        IrqQspiPTCatConfig: IrqQspi0PTCat=CAT1, IrqQspi1PTCat=CAT1, IrqQspi2PTCat=CAT1, IrqQspi3PTCat=CAT1
        IrqQspiRxCatConfig: IrqQspi0RxCat=CAT1, IrqQspi1RxCat=CAT1, IrqQspi2RxCat=CAT1, IrqQspi3RxCat=CAT1
        IrqQspiTxCatConfig: IrqQspi0TxCat=CAT1, IrqQspi1TxCat=CAT1, IrqQspi2TxCat=CAT1, IrqQspi3TxCat=CAT1
        IrqQspiUDCatConfig: IrqQspi0UDCat=CAT1, IrqQspi1UDCat=CAT1, IrqQspi2UDCat=CAT1, IrqQspi3UDCat=CAT1
      IrqQspiPrioConfig
        IrqQspiErrPrioConfig: IrqQspi0ErrPrio=0, IrqQspi1ErrPrio=0, IrqQspi2ErrPrio=0, IrqQspi3ErrPrio=0
        IrqQspiHCPrioConfig: IrqQspi0HCPrio=0, IrqQspi1HCPrio=0, IrqQspi2HCPrio=0, IrqQspi3HCPrio=0
        IrqQspiPTPrioConfig: IrqQspi0PTPrio=0, IrqQspi1PTPrio=0, IrqQspi2PTPrio=0, IrqQspi3PTPrio=0
        IrqQspiRxPrioConfig: IrqQspi0RxPrio=0, IrqQspi1RxPrio=0, IrqQspi2RxPrio=0, IrqQspi3RxPrio=0
        IrqQspiTxPrioConfig: IrqQspi0TxPrio=0, IrqQspi1TxPrio=0, IrqQspi2TxPrio=0, IrqQspi3TxPrio=0
        IrqQspiUDPrioConfig: IrqQspi0UDPrio=0, IrqQspi1UDPrio=0, IrqQspi2UDPrio=0, IrqQspi3UDPrio=0
      IrqQspiTosConfig
        IrqQspiErrTosConfig: IrqQspi0ErrTos=CPU0, IrqQspi1ErrTos=CPU0, IrqQspi2ErrTos=CPU0, IrqQspi3ErrTos=CPU0
        IrqQspiHCTosConfig: IrqQspi0HCTos=CPU0, IrqQspi1HCTos=CPU0, IrqQspi2HCTos=CPU0, IrqQspi3HCTos=CPU0
        IrqQspiPTTosConfig: IrqQspi0PTTos=CPU0, IrqQspi1PTTos=CPU0, IrqQspi2PTTos=CPU0, IrqQspi3PTTos=CPU0
        IrqQspiRxTosConfig: IrqQspi0RxTos=CPU0, IrqQspi1RxTos=CPU0, IrqQspi2RxTos=CPU0, IrqQspi3RxTos=CPU0
        IrqQspiTxTosConfig: IrqQspi0TxTos=CPU0, IrqQspi1TxTos=CPU0, IrqQspi2TxTos=CPU0, IrqQspi3TxTos=CPU0
        IrqQspiUDTosConfig: IrqQspi0UDTos=CPU0, IrqQspi1UDTos=CPU0, IrqQspi2UDTos=CPU0, IrqQspi3UDTos=CPU0
    IrqMscConfig_0 (IrqMscConfig)
      IrqMsc0Config
        IrqMsc0CatConfig: IrqMsc0SR0Cat=CAT1, IrqMsc0SR1Cat=CAT1, IrqMsc0SR2Cat=CAT1, IrqMsc0SR3Cat=CAT1, IrqMsc0SR4Cat=CAT1
        IrqMsc0PrioConfig: IrqMsc0SR0Prio=0, IrqMsc0SR1Prio=0, IrqMsc0SR2Prio=0, IrqMsc0SR3Prio=0, IrqMsc0SR4Prio=0
        IrqMsc0TosConfig: IrqMsc0SR0Tos=CPU0, IrqMsc0SR1Tos=CPU0, IrqMsc0SR2Tos=CPU0, IrqMsc0SR3Tos=CPU0, IrqMsc0SR4Tos=CPU0
      IrqMsc1Config
        IrqMsc1CatConfig: IrqMsc1SR0Cat=CAT1, IrqMsc1SR1Cat=CAT1, IrqMsc1SR2Cat=CAT1, IrqMsc1SR3Cat=CAT1, IrqMsc1SR4Cat=CAT1
        IrqMsc1PrioConfig: IrqMsc1SR0Prio=0, IrqMsc1SR1Prio=0, IrqMsc1SR2Prio=0, IrqMsc1SR3Prio=0, IrqMsc1SR4Prio=0
        IrqMsc1TosConfig: IrqMsc1SR0Tos=CPU0, IrqMsc1SR1Tos=CPU0, IrqMsc1SR2Tos=CPU0, IrqMsc1SR3Tos=CPU0, IrqMsc1SR4Tos=CPU0
    IrqCCU6Config_0 (IrqCCU6Config)
      IrqCCU60Config
        IrqCCU60CatConfig: IrqCCU60SR0Cat=CAT1, IrqCCU60SR1Cat=CAT1, IrqCCU60SR2Cat=CAT1, IrqCCU60SR3Cat=CAT1
        IrqCCU60PrioConfig: IrqCCU60SR0Prio=0, IrqCCU60SR1Prio=0, IrqCCU60SR2Prio=0, IrqCCU60SR3Prio=0
        IrqCCU60TosConfig: IrqCCU60SR0Tos=CPU0, IrqCCU60SR1Tos=CPU0, IrqCCU60SR2Tos=CPU0, IrqCCU60SR3Tos=CPU0
      IrqCCU61Config
        IrqCCU61CatConfig: IrqCCU61SR0Cat=CAT1, IrqCCU61SR1Cat=CAT1, IrqCCU61SR2Cat=CAT1, IrqCCU61SR3Cat=CAT1
        IrqCCU61PrioConfig: IrqCCU61SR0Prio=0, IrqCCU61SR1Prio=0, IrqCCU61SR2Prio=0, IrqCCU61SR3Prio=0
        IrqCCU61TosConfig: IrqCCU61SR0Tos=CPU0, IrqCCU61SR1Tos=CPU0, IrqCCU61SR2Tos=CPU0, IrqCCU61SR3Tos=CPU0
    IrqGptConfig_0 (IrqGptConfig)
      IrqGpt120Config
        IrqGpt120CatConfig: IrqGpt120CARPELCat=CAT1, IrqGpt120T2Cat=CAT1, IrqGpt120T3Cat=CAT1, IrqGpt120T4Cat=CAT1, IrqGpt120T5Cat=CAT1, IrqGpt120T6Cat=CAT1
        IrqGpt120PrioConfig: IrqGpt120CARPELPrio=0, IrqGpt120T2Prio=0, IrqGpt120T3Prio=0, IrqGpt120T4Prio=0, IrqGpt120T5Prio=0, IrqGpt120T6Prio=0
        IrqGpt120TosConfig: IrqGpt120CARPELTos=CPU0, IrqGpt120T2Tos=CPU0, IrqGpt120T3Tos=CPU0, IrqGpt120T4Tos=CPU0, IrqGpt120T5Tos=CPU0, IrqGpt120T6Tos=CPU0
    IrqStmConfig_0 (IrqStmConfig)
      IrqStm0Config
        IrqStm0CatConfig: IrqStm0SR0Cat=CAT1, IrqStm0SR1Cat=CAT1
        IrqStm0PrioConfig: IrqStm0SR0Prio=0, IrqStm0SR1Prio=0
        IrqStm0TosConfig: IrqStm0SR0Tos=CPU0, IrqStm0SR1Tos=CPU0
      IrqStm1Config
        IrqStm1CatConfig: IrqStm1SR0Cat=CAT1, IrqStm1SR1Cat=CAT1
        IrqStm1PrioConfig: IrqStm1SR0Prio=0, IrqStm1SR1Prio=0
        IrqStm1TosConfig: IrqStm1SR0Tos=CPU0, IrqStm1SR1Tos=CPU0
      IrqStm2Config
        IrqStm2CatConfig: IrqStm2SR0Cat=CAT1, IrqStm2SR1Cat=CAT1
        IrqStm2PrioConfig: IrqStm2SR0Prio=0, IrqStm2SR1Prio=0
        IrqStm2TosConfig: IrqStm2SR0Tos=CPU0, IrqStm2SR1Tos=CPU0
    IrqDmaConfig_0 (IrqDmaConfig)
      IrqDmaCatConfig:
        IrqDmaCh0SRCat = CAT1
        IrqDmaCh{10..19}SRCat = CAT1
        IrqDmaCh1SRCat = CAT1
        IrqDmaCh{20..29}SRCat = CAT1
        IrqDmaCh2SRCat = CAT1
        IrqDmaCh{30..39}SRCat = CAT1
        IrqDmaCh3SRCat = CAT1
        IrqDmaCh{40..49}SRCat = CAT1
        IrqDmaCh4SRCat = CAT1
        IrqDmaCh{50..59}SRCat = CAT1
        IrqDmaCh5SRCat = CAT1
        IrqDmaCh{60..63}SRCat = CAT1
        IrqDmaCh{6..9}SRCat = CAT1
        IrqDmaErrSRCat = CAT1
      IrqDmaPrioConfig:
        IrqDmaCh0SRPrio = 0
        IrqDmaCh{10..19}SRPrio = 0
        IrqDmaCh1SRPrio = 0
        IrqDmaCh{20..29}SRPrio = 0
        IrqDmaCh2SRPrio = 0
        IrqDmaCh{30..39}SRPrio = 0
        IrqDmaCh3SRPrio = 0
        IrqDmaCh{40..49}SRPrio = 0
        IrqDmaCh4SRPrio = 0
        IrqDmaCh{50..59}SRPrio = 0
        IrqDmaCh5SRPrio = 0
        IrqDmaCh{60..63}SRPrio = 0
        IrqDmaCh{6..9}SRPrio = 0
        IrqDmaErrSRPrio = 0
      IrqDmaTosConfig:
        IrqDmaCh0SRTos = CPU0
        IrqDmaCh{10..19}SRTos = CPU0
        IrqDmaCh1SRTos = CPU0
        IrqDmaCh{20..29}SRTos = CPU0
        IrqDmaCh2SRTos = CPU0
        IrqDmaCh{30..39}SRTos = CPU0
        IrqDmaCh3SRTos = CPU0
        IrqDmaCh{40..49}SRTos = CPU0
        IrqDmaCh4SRTos = CPU0
        IrqDmaCh{50..59}SRTos = CPU0
        IrqDmaCh5SRTos = CPU0
        IrqDmaCh{60..63}SRTos = CPU0
        IrqDmaCh{6..9}SRTos = CPU0
        IrqDmaErrSRTos = CPU0
    IrqETHConfig_0 (IrqETHConfig)
      IrqETHCatConfig: IrqETHSRCat=CAT1
      IrqETHPrioConfig: IrqETHSRPrio=0
      IrqETHTosConfig: IrqETHSRTos=CPU0
    IrqCanConfig_0 (IrqCanConfig)
      IrqCanCatConfig:
        IrqCanSR0Cat = CAT1
        IrqCanSR{10..15}Cat = CAT1
        IrqCanSR{1..9}Cat = CAT1
      IrqCanPrioConfig:
        IrqCanSR0Prio = 10
        IrqCanSR10Prio = 20
        IrqCanSR11Prio = 21
        IrqCanSR12Prio = 22
        IrqCanSR13Prio = 23
        IrqCanSR14Prio = 24
        IrqCanSR15Prio = 25
        IrqCanSR1Prio = 11
        IrqCanSR2Prio = 12
        IrqCanSR3Prio = 13
        IrqCanSR4Prio = 14
        IrqCanSR5Prio = 15
        IrqCanSR6Prio = 16
        IrqCanSR7Prio = 17
        IrqCanSR8Prio = 18
        IrqCanSR9Prio = 19
      IrqCanTosConfig:
        IrqCanSR0Tos = CPU0
        IrqCanSR{10..15}Tos = CPU0
        IrqCanSR{1..9}Tos = CPU0
    IrqAdcConfig_0 (IrqAdcConfig)
      IrqAdc0Config
        IrqAdc0CatConfig: IrqAdc0SR0Cat=CAT1, IrqAdc0SR1Cat=CAT1, IrqAdc0SR2Cat=CAT1, IrqAdc0SR3Cat=CAT1
        IrqAdc0PrioConfig: IrqAdc0SR0Prio=0, IrqAdc0SR1Prio=0, IrqAdc0SR2Prio=0, IrqAdc0SR3Prio=0
        IrqAdc0TosConfig: IrqAdc0SR0Tos=CPU0, IrqAdc0SR1Tos=CPU0, IrqAdc0SR2Tos=CPU0, IrqAdc0SR3Tos=CPU0
      IrqAdc1Config
        IrqAdc1CatConfig: IrqAdc1SR0Cat=CAT1, IrqAdc1SR1Cat=CAT1, IrqAdc1SR2Cat=CAT1, IrqAdc1SR3Cat=CAT1
        IrqAdc1PrioConfig: IrqAdc1SR0Prio=0, IrqAdc1SR1Prio=0, IrqAdc1SR2Prio=0, IrqAdc1SR3Prio=0
        IrqAdc1TosConfig: IrqAdc1SR0Tos=CPU0, IrqAdc1SR1Tos=CPU0, IrqAdc1SR2Tos=CPU0, IrqAdc1SR3Tos=CPU0
      IrqAdc2Config
        IrqAdc2CatConfig: IrqAdc2SR0Cat=CAT1, IrqAdc2SR1Cat=CAT1, IrqAdc2SR2Cat=CAT1, IrqAdc2SR3Cat=CAT1
        IrqAdc2PrioConfig: IrqAdc2SR0Prio=0, IrqAdc2SR1Prio=0, IrqAdc2SR2Prio=0, IrqAdc2SR3Prio=0
        IrqAdc2TosConfig: IrqAdc2SR0Tos=CPU0, IrqAdc2SR1Tos=CPU0, IrqAdc2SR2Tos=CPU0, IrqAdc2SR3Tos=CPU0
      IrqAdc3Config
        IrqAdc3CatConfig: IrqAdc3SR0Cat=CAT1, IrqAdc3SR1Cat=CAT1, IrqAdc3SR2Cat=CAT1, IrqAdc3SR3Cat=CAT1
        IrqAdc3PrioConfig: IrqAdc3SR0Prio=0, IrqAdc3SR1Prio=0, IrqAdc3SR2Prio=0, IrqAdc3SR3Prio=0
        IrqAdc3TosConfig: IrqAdc3SR0Tos=CPU0, IrqAdc3SR1Tos=CPU0, IrqAdc3SR2Tos=CPU0, IrqAdc3SR3Tos=CPU0
      IrqAdc4Config
        IrqAdc4CatConfig: IrqAdc4SR0Cat=CAT1, IrqAdc4SR1Cat=CAT1, IrqAdc4SR2Cat=CAT1, IrqAdc4SR3Cat=CAT1
        IrqAdc4PrioConfig: IrqAdc4SR0Prio=0, IrqAdc4SR1Prio=0, IrqAdc4SR2Prio=0, IrqAdc4SR3Prio=0
        IrqAdc4TosConfig: IrqAdc4SR0Tos=CPU0, IrqAdc4SR1Tos=CPU0, IrqAdc4SR2Tos=CPU0, IrqAdc4SR3Tos=CPU0
      IrqAdc5Config
        IrqAdc5CatConfig: IrqAdc5SR0Cat=CAT1, IrqAdc5SR1Cat=CAT1, IrqAdc5SR2Cat=CAT1, IrqAdc5SR3Cat=CAT1
        IrqAdc5PrioConfig: IrqAdc5SR0Prio=0, IrqAdc5SR1Prio=0, IrqAdc5SR2Prio=0, IrqAdc5SR3Prio=0
        IrqAdc5TosConfig: IrqAdc5SR0Tos=CPU0, IrqAdc5SR1Tos=CPU0, IrqAdc5SR2Tos=CPU0, IrqAdc5SR3Tos=CPU0
      IrqAdc6Config
        IrqAdc6CatConfig: IrqAdc6SR0Cat=CAT1, IrqAdc6SR1Cat=CAT1, IrqAdc6SR2Cat=CAT1, IrqAdc6SR3Cat=CAT1
        IrqAdc6PrioConfig: IrqAdc6SR0Prio=0, IrqAdc6SR1Prio=0, IrqAdc6SR2Prio=0, IrqAdc6SR3Prio=0
        IrqAdc6TosConfig: IrqAdc6SR0Tos=CPU0, IrqAdc6SR1Tos=CPU0, IrqAdc6SR2Tos=CPU0, IrqAdc6SR3Tos=CPU0
      IrqAdc7Config
        IrqAdc7CatConfig: IrqAdc7SR0Cat=CAT1, IrqAdc7SR1Cat=CAT1, IrqAdc7SR2Cat=CAT1, IrqAdc7SR3Cat=CAT1
        IrqAdc7PrioConfig: IrqAdc7SR0Prio=0, IrqAdc7SR1Prio=0, IrqAdc7SR2Prio=0, IrqAdc7SR3Prio=0
        IrqAdc7TosConfig: IrqAdc7SR0Tos=CPU0, IrqAdc7SR1Tos=CPU0, IrqAdc7SR2Tos=CPU0, IrqAdc7SR3Tos=CPU0
      IrqAdcCG0Config
        IrqAdcCG0CatConfig: IrqAdcCG0SR0Cat=CAT1, IrqAdcCG0SR1Cat=CAT1, IrqAdcCG0SR2Cat=CAT1, IrqAdcCG0SR3Cat=CAT1
        IrqAdcCG0PrioConfig: IrqAdcCG0SR0Prio=0, IrqAdcCG0SR1Prio=0, IrqAdcCG0SR2Prio=0, IrqAdcCG0SR3Prio=0
        IrqAdcCG0TosConfig: IrqAdcCG0SR0Tos=CPU0, IrqAdcCG0SR1Tos=CPU0, IrqAdcCG0SR2Tos=CPU0, IrqAdcCG0SR3Tos=CPU0
      IrqAdcCG1Config
        IrqAdcCG1CatConfig: IrqAdcCG1SR0Cat=CAT1, IrqAdcCG1SR1Cat=CAT1, IrqAdcCG1SR2Cat=CAT1, IrqAdcCG1SR3Cat=CAT1
        IrqAdcCG1PrioConfig: IrqAdcCG1SR0Prio=0, IrqAdcCG1SR1Prio=0, IrqAdcCG1SR2Prio=0, IrqAdcCG1SR3Prio=0
        IrqAdcCG1TosConfig: IrqAdcCG1SR0Tos=CPU0, IrqAdcCG1SR1Tos=CPU0, IrqAdcCG1SR2Tos=CPU0, IrqAdcCG1SR3Tos=CPU0
    IrqDSAdcConfig_0 (IrqDSAdcConfig)
      IrqDSAdcCatConfig:
        IrqDSAdcSRA{0..5}Cat = CAT1
        IrqDSAdcSRM{0..5}Cat = CAT1
      IrqDSAdcPrioConfig:
        IrqDSAdcSRA{0..5}Prio = 0
        IrqDSAdcSRM{0..5}Prio = 0
      IrqDSAdcTosConfig:
        IrqDSAdcSRA{0..5}Tos = CPU0
        IrqDSAdcSRM{0..5}Tos = CPU0
    IrqFlexRayConfig_0 (IrqFlexRayConfig)
      IrqFlexRay0Config
        IrqFlexRay0CatConfig:
          IrqFlexRay0IBBusyCat = CAT1
          IrqFlexRay0MBSC0Cat = CAT1
          IrqFlexRay0MBSC1Cat = CAT1
          IrqFlexRay0NewData0Cat = CAT1
          IrqFlexRay0NewData1Cat = CAT1
          IrqFlexRay0OBBusyCat = CAT1
          IrqFlexRay0SR0Cat = CAT1
          IrqFlexRay0SR1Cat = CAT1
          IrqFlexRay0TimerInt0Cat = CAT1
          IrqFlexRay0TimerInt1Cat = CAT1
        IrqFlexRay0PrioConfig:
          IrqFlexRay0IBBusyPrio = 0
          IrqFlexRay0MBSC0Prio = 0
          IrqFlexRay0MBSC1Prio = 0
          IrqFlexRay0NewData0Prio = 0
          IrqFlexRay0NewData1Prio = 0
          IrqFlexRay0OBBusyPrio = 0
          IrqFlexRay0SR0Prio = 0
          IrqFlexRay0SR1Prio = 0
          IrqFlexRay0TimerInt0Prio = 0
          IrqFlexRay0TimerInt1Prio = 0
        IrqFlexRay0TosConfig:
          IrqFlexRay0IBBusyTos = CPU0
          IrqFlexRay0MBSC0Tos = CPU0
          IrqFlexRay0MBSC1Tos = CPU0
          IrqFlexRay0NewData0Tos = CPU0
          IrqFlexRay0NewData1Tos = CPU0
          IrqFlexRay0OBBusyTos = CPU0
          IrqFlexRay0SR0Tos = CPU0
          IrqFlexRay0SR1Tos = CPU0
          IrqFlexRay0TimerInt0Tos = CPU0
          IrqFlexRay0TimerInt1Tos = CPU0
    IrqPMU0Config_0 (IrqPMU0Config)
      IrqPMU0CatConfig: IrqPMU0SR0Cat=CAT1, IrqPMU0SR1Cat=CAT1
      IrqPMU0PrioConfig: IrqPMU0SR0Prio=0, IrqPMU0SR1Prio=0
      IrqPMU0TosConfig: IrqPMU0SR0Tos=CPU0, IrqPMU0SR1Tos=CPU0
    IrqScuConfig_0 (IrqScuConfig)
      IrqScuCatConfig: IrqScuDtsSRCat=CAT1, IrqScuEruSR0Cat=CAT1, IrqScuEruSR1Cat=CAT1, IrqScuEruSR2Cat=CAT1, IrqScuEruSR3Cat=CAT1
      IrqScuPrioConfig: IrqScuDtsSRPrio=0, IrqScuEruSR0Prio=0, IrqScuEruSR1Prio=0, IrqScuEruSR2Prio=0, IrqScuEruSR3Prio=0
      IrqScuTosConfig: IrqScuDtsSRTos=CPU0, IrqScuEruSR0Tos=CPU0, IrqScuEruSR1Tos=CPU0, IrqScuEruSR2Tos=CPU0, IrqScuEruSR3Tos=CPU0
    IrqGPSRGroupConfig_0 (IrqGPSRGroupConfig)
      IrqGPSRGroup0Config
        IrqGPSRGroup0CatConfig: IrqGPSRGroup0SR0Cat=CAT1, IrqGPSRGroup0SR1Cat=CAT1, IrqGPSRGroup0SR2Cat=CAT1, IrqGPSRGroup0SR3Cat=CAT1
        IrqGPSRGroup0PrioConfig: IrqGPSRGroup0SR0Prio=0, IrqGPSRGroup0SR1Prio=0, IrqGPSRGroup0SR2Prio=0, IrqGPSRGroup0SR3Prio=0
        IrqGPSRGroup0TosConfig: IrqGPSRGroup0SR0Tos=CPU0, IrqGPSRGroup0SR1Tos=CPU0, IrqGPSRGroup0SR2Tos=CPU0, IrqGPSRGroup0SR3Tos=CPU0
      IrqGPSRGroup1Config
        IrqGPSRGroup1CatConfig: IrqGPSRGroup1SR0Cat=CAT1, IrqGPSRGroup1SR1Cat=CAT1, IrqGPSRGroup1SR2Cat=CAT1, IrqGPSRGroup1SR3Cat=CAT1
        IrqGPSRGroup1PrioConfig: IrqGPSRGroup1SR0Prio=0, IrqGPSRGroup1SR1Prio=0, IrqGPSRGroup1SR2Prio=0, IrqGPSRGroup1SR3Prio=0
        IrqGPSRGroup1TosConfig: IrqGPSRGroup1SR0Tos=CPU0, IrqGPSRGroup1SR1Tos=CPU0, IrqGPSRGroup1SR2Tos=CPU0, IrqGPSRGroup1SR3Tos=CPU0
      IrqGPSRGroup2Config
        IrqGPSRGroup2CatConfig: IrqGPSRGroup2SR0Cat=CAT1, IrqGPSRGroup2SR1Cat=CAT1, IrqGPSRGroup2SR2Cat=CAT1, IrqGPSRGroup2SR3Cat=CAT1
        IrqGPSRGroup2PrioConfig: IrqGPSRGroup2SR0Prio=0, IrqGPSRGroup2SR1Prio=0, IrqGPSRGroup2SR2Prio=0, IrqGPSRGroup2SR3Prio=0
        IrqGPSRGroup2TosConfig: IrqGPSRGroup2SR0Tos=CPU0, IrqGPSRGroup2SR1Tos=CPU0, IrqGPSRGroup2SR2Tos=CPU0, IrqGPSRGroup2SR3Tos=CPU0
    IrqGtmConfig_0 (IrqGtmConfig)
      IrqGtmAEIConfig
        IrqGtmAEICatConfig: IrqGtmAEICat=CAT1
        IrqGtmAEIPrioConfig: IrqGtmAEIPrio=0
        IrqGtmAEITosConfig: IrqGtmAEITos=CPU0
      IrqGtmARUConfig
        IrqGtmARUCatConfig: IrqGtmARUSR0Cat=CAT1, IrqGtmARUSR1Cat=CAT1, IrqGtmARUSR2Cat=CAT1
        IrqGtmARUPrioConfig: IrqGtmARUSR0Prio=0, IrqGtmARUSR1Prio=0, IrqGtmARUSR2Prio=0
        IrqGtmARUTosConfig: IrqGtmARUSR0Tos=CPU0, IrqGtmARUSR1Tos=CPU0, IrqGtmARUSR2Tos=CPU0
      IrqGtmATOM0Config
        IrqGtmATOM0CatConfig: IrqGtmATOM0SR0Cat=CAT1, IrqGtmATOM0SR1Cat=CAT1, IrqGtmATOM0SR2Cat=CAT1, IrqGtmATOM0SR3Cat=CAT1
        IrqGtmATOM0PrioConfig: IrqGtmATOM0SR0Prio=0, IrqGtmATOM0SR1Prio=0, IrqGtmATOM0SR2Prio=0, IrqGtmATOM0SR3Prio=0
        IrqGtmATOM0TosConfig: IrqGtmATOM0SR0Tos=CPU0, IrqGtmATOM0SR1Tos=CPU0, IrqGtmATOM0SR2Tos=CPU0, IrqGtmATOM0SR3Tos=CPU0
      IrqGtmATOM1Config
        IrqGtmATOM1CatConfig: IrqGtmATOM1SR0Cat=CAT1, IrqGtmATOM1SR1Cat=CAT1, IrqGtmATOM1SR2Cat=CAT1, IrqGtmATOM1SR3Cat=CAT1
        IrqGtmATOM1PrioConfig: IrqGtmATOM1SR0Prio=0, IrqGtmATOM1SR1Prio=0, IrqGtmATOM1SR2Prio=0, IrqGtmATOM1SR3Prio=0
        IrqGtmATOM1TosConfig: IrqGtmATOM1SR0Tos=CPU0, IrqGtmATOM1SR1Tos=CPU0, IrqGtmATOM1SR2Tos=CPU0, IrqGtmATOM1SR3Tos=CPU0
      IrqGtmATOM2Config
        IrqGtmATOM2CatConfig: IrqGtmATOM2SR0Cat=CAT1, IrqGtmATOM2SR1Cat=CAT1, IrqGtmATOM2SR2Cat=CAT1, IrqGtmATOM2SR3Cat=CAT1
        IrqGtmATOM2PrioConfig: IrqGtmATOM2SR0Prio=0, IrqGtmATOM2SR1Prio=0, IrqGtmATOM2SR2Prio=0, IrqGtmATOM2SR3Prio=0
        IrqGtmATOM2TosConfig: IrqGtmATOM2SR0Tos=CPU0, IrqGtmATOM2SR1Tos=CPU0, IrqGtmATOM2SR2Tos=CPU0, IrqGtmATOM2SR3Tos=CPU0
      IrqGtmATOM3Config
        IrqGtmATOM3CatConfig: IrqGtmATOM3SR0Cat=CAT1, IrqGtmATOM3SR1Cat=CAT1, IrqGtmATOM3SR2Cat=CAT1, IrqGtmATOM3SR3Cat=CAT1
        IrqGtmATOM3PrioConfig: IrqGtmATOM3SR0Prio=0, IrqGtmATOM3SR1Prio=0, IrqGtmATOM3SR2Prio=0, IrqGtmATOM3SR3Prio=0
        IrqGtmATOM3TosConfig: IrqGtmATOM3SR0Tos=CPU0, IrqGtmATOM3SR1Tos=CPU0, IrqGtmATOM3SR2Tos=CPU0, IrqGtmATOM3SR3Tos=CPU0
      IrqGtmATOM4Config
        IrqGtmATOM4CatConfig: IrqGtmATOM4SR0Cat=CAT1, IrqGtmATOM4SR1Cat=CAT1, IrqGtmATOM4SR2Cat=CAT1, IrqGtmATOM4SR3Cat=CAT1
        IrqGtmATOM4PrioConfig: IrqGtmATOM4SR0Prio=0, IrqGtmATOM4SR1Prio=0, IrqGtmATOM4SR2Prio=0, IrqGtmATOM4SR3Prio=0
        IrqGtmATOM4TosConfig: IrqGtmATOM4SR0Tos=CPU0, IrqGtmATOM4SR1Tos=CPU0, IrqGtmATOM4SR2Tos=CPU0, IrqGtmATOM4SR3Tos=CPU0
      IrqGtmBRCConfig
        IrqGtmBRCCatConfig: IrqGtmBRCCat=CAT1
        IrqGtmBRCPrioConfig: IrqGtmBRCPrio=0
        IrqGtmBRCTosConfig: IrqGtmBRCTos=CPU0
      IrqGtmCMPConfig
        IrqGtmCMPCatConfig: IrqGtmCMPCat=CAT1
        IrqGtmCMPPrioConfig: IrqGtmCMPPrio=0
        IrqGtmCMPTosConfig: IrqGtmCMPTos=CPU0
      IrqGtmDPLLConfig
        IrqGtmDPLLCatConfig:
          IrqGtmDPLLSR0Cat = CAT1
          IrqGtmDPLLSR{10..19}Cat = CAT1
          IrqGtmDPLLSR1Cat = CAT1
          IrqGtmDPLLSR{20..26}Cat = CAT1
          IrqGtmDPLLSR{2..9}Cat = CAT1
        IrqGtmDPLLPrioConfig:
          IrqGtmDPLLSR0Prio = 0
          IrqGtmDPLLSR{10..19}Prio = 0
          IrqGtmDPLLSR1Prio = 0
          IrqGtmDPLLSR{20..26}Prio = 0
          IrqGtmDPLLSR{2..9}Prio = 0
        IrqGtmDPLLTosConfig:
          IrqGtmDPLLSR0Tos = CPU0
          IrqGtmDPLLSR{10..19}Tos = CPU0
          IrqGtmDPLLSR1Tos = CPU0
          IrqGtmDPLLSR{20..26}Tos = CPU0
          IrqGtmDPLLSR{2..9}Tos = CPU0
      IrqGtmERRConfig
        IrqGtmERRCatConfig: IrqGtmERRSRCat=CAT1
        IrqGtmERRPrioConfig: IrqGtmERRSRPrio=0
        IrqGtmERRTosConfig: IrqGtmERRSRTos=CPU0
      IrqGtmMCS0Config
        IrqGtmMCS0CatConfig:
          IrqGtmMCS0SR{0..7}Cat = CAT1
        IrqGtmMCS0PrioConfig:
          IrqGtmMCS0SR{0..7}Prio = 0
        IrqGtmMCS0TosConfig:
          IrqGtmMCS0SR{0..7}Tos = CPU0
      IrqGtmMCS1Config
        IrqGtmMCS1CatConfig:
          IrqGtmMCS1SR{0..7}Cat = CAT1
        IrqGtmMCS1PrioConfig:
          IrqGtmMCS1SR{0..7}Prio = 0
        IrqGtmMCS1TosConfig:
          IrqGtmMCS1SR{0..7}Tos = CPU0
      IrqGtmMCS2Config
        IrqGtmMCS2CatConfig:
          IrqGtmMCS2SR{0..7}Cat = CAT1
        IrqGtmMCS2PrioConfig:
          IrqGtmMCS2SR{0..7}Prio = 0
        IrqGtmMCS2TosConfig:
          IrqGtmMCS2SR{0..7}Tos = CPU0
      IrqGtmMCS3Config
        IrqGtmMCS3CatConfig:
          IrqGtmMCS3SR{0..7}Cat = CAT1
        IrqGtmMCS3PrioConfig:
          IrqGtmMCS3SR{0..7}Prio = 0
        IrqGtmMCS3TosConfig:
          IrqGtmMCS3SR{0..7}Tos = CPU0
      IrqGtmPSM0Config
        IrqGtmPSM0CatConfig:
          IrqGtmPSM0SR{0..7}Cat = CAT1
        IrqGtmPSM0PrioConfig:
          IrqGtmPSM0SR{0..7}Prio = 0
        IrqGtmPSM0TosConfig:
          IrqGtmPSM0SR{0..7}Tos = CPU0
      IrqGtmSPEConfig
        IrqGtmSPECatConfig: IrqGtmSPE0Cat=CAT1, IrqGtmSPE1Cat=CAT1
        IrqGtmSPEPrioConfig: IrqGtmSPE0Prio=0, IrqGtmSPE1Prio=0
        IrqGtmSPETosConfig: IrqGtmSPE0Tos=CPU0, IrqGtmSPE1Tos=CPU0
      IrqGtmTIM0Config
        IrqGtmTIM0CatConfig:
          IrqGtmTIM0SR{0..7}Cat = CAT1
        IrqGtmTIM0PrioConfig:
          IrqGtmTIM0SR{0..7}Prio = 0
        IrqGtmTIM0TosConfig:
          IrqGtmTIM0SR{0..7}Tos = CPU0
      IrqGtmTIM1Config
        IrqGtmTIM1CatConfig:
          IrqGtmTIM1SR{0..7}Cat = CAT1
        IrqGtmTIM1PrioConfig:
          IrqGtmTIM1SR{0..7}Prio = 0
        IrqGtmTIM1TosConfig:
          IrqGtmTIM1SR{0..7}Tos = CPU0
      IrqGtmTIM2Config
        IrqGtmTIM2CatConfig:
          IrqGtmTIM2SR{0..6}Cat = CAT1
          IrqGtmTIM2SR7Cat = CAT23
        IrqGtmTIM2PrioConfig:
          IrqGtmTIM2SR{0..6}Prio = 0
          IrqGtmTIM2SR7Prio = 9
        IrqGtmTIM2TosConfig:
          IrqGtmTIM2SR{0..7}Tos = CPU0
      IrqGtmTIM3Config
        IrqGtmTIM3CatConfig:
          IrqGtmTIM3SR{0..7}Cat = CAT1
        IrqGtmTIM3PrioConfig:
          IrqGtmTIM3SR{0..7}Prio = 0
        IrqGtmTIM3TosConfig:
          IrqGtmTIM3SR{0..7}Tos = CPU0
      IrqGtmTOM0Config
        IrqGtmTOM0CatConfig:
          IrqGtmTOM0SR{0..7}Cat = CAT1
        IrqGtmTOM0PrioConfig:
          IrqGtmTOM0SR{0..7}Prio = 0
        IrqGtmTOM0TosConfig:
          IrqGtmTOM0SR{0..7}Tos = CPU0
      IrqGtmTOM1Config
        IrqGtmTOM1CatConfig:
          IrqGtmTOM1SR{0..7}Cat = CAT1
        IrqGtmTOM1PrioConfig:
          IrqGtmTOM1SR{0..7}Prio = 0
        IrqGtmTOM1TosConfig:
          IrqGtmTOM1SR{0..7}Tos = CPU0
      IrqGtmTOM2Config
        IrqGtmTOM2CatConfig:
          IrqGtmTOM2SR{0..7}Cat = CAT1
        IrqGtmTOM2PrioConfig:
          IrqGtmTOM2SR{0..7}Prio = 0
        IrqGtmTOM2TosConfig:
          IrqGtmTOM2SR{0..7}Tos = CPU0
    IrqSentConfig_0 (IrqSentConfig)
      IrqSentCatConfig:
        IrqSentSR{0..9}Cat = CAT1
      IrqSentPrioConfig:
        IrqSentSR{0..9}Prio = 0
      IrqSentTosConfig:
        IrqSentSR{0..9}Tos = CPU0
    IrqI2CConfig_0 (IrqI2CConfig)
      IrqI2C0Config
        IrqI2C0CatConfig: IrqI2C0BReqCat=CAT1, IrqI2C0ErrCat=CAT1, IrqI2C0LBReqCat=CAT1, IrqI2C0LSReqCat=CAT1, IrqI2C0PCat=CAT1, IrqI2C0SReqCat=CAT1
        IrqI2C0PrioConfig: IrqI2C0BReqPrio=0, IrqI2C0ErrPrio=0, IrqI2C0LBReqPrio=0, IrqI2C0LSReqPrio=0, IrqI2C0PPrio=0, IrqI2C0SReqPrio=0
        IrqI2C0TosConfig: IrqI2C0BReqTos=CPU0, IrqI2C0ErrTos=CPU0, IrqI2C0LBReqTos=CPU0, IrqI2C0LSReqTos=CPU0, IrqI2C0PTos=CPU0, IrqI2C0SReqTos=CPU0
    IrqHSMConfig_0 (IrqHSMConfig)
      IrqHSMCatConfig: IrqHSMSR0Cat=CAT1, IrqHSMSR1Cat=CAT1
      IrqHSMPrioConfig: IrqHSMSR0Prio=0, IrqHSMSR1Prio=0
      IrqHSMTosConfig: IrqHSMSR0Tos=CPU0, IrqHSMSR1Tos=CPU0
    IrqHsslConfig_0 (IrqHsslConfig)
      IrqHsslCatConfig
        IrqHsslCokCatConfig: IrqHssl0CokCat=CAT1, IrqHssl1CokCat=CAT1, IrqHssl2CokCat=CAT1, IrqHssl3CokCat=CAT1
        IrqHsslErrCatConfig: IrqHssl0ErrCat=CAT1, IrqHssl1ErrCat=CAT1, IrqHssl2ErrCat=CAT1, IrqHssl3ErrCat=CAT1
        IrqHsslExiCatConfig: IrqHsslExiCat=CAT1
        IrqHsslRdiCatConfig: IrqHssl0RdiCat=CAT1, IrqHssl1RdiCat=CAT1, IrqHssl2RdiCat=CAT1, IrqHssl3RdiCat=CAT1
        IrqHsslTrgCatConfig: IrqHssl0TrgCat=CAT1, IrqHssl1TrgCat=CAT1, IrqHssl2TrgCat=CAT1, IrqHssl3TrgCat=CAT1
      IrqHsslPrioConfig
        IrqHsslCokPrioConfig: IrqHssl0CokPrio=0, IrqHssl1CokPrio=0, IrqHssl2CokPrio=0, IrqHssl3CokPrio=0
        IrqHsslErrPrioConfig: IrqHssl0ErrPrio=0, IrqHssl1ErrPrio=0, IrqHssl2ErrPrio=0, IrqHssl3ErrPrio=0
        IrqHsslExiPrioConfig: IrqHsslExiPrio=0
        IrqHsslRdiPrioConfig: IrqHssl0RdiPrio=0, IrqHssl1RdiPrio=0, IrqHssl2RdiPrio=0, IrqHssl3RdiPrio=0
        IrqHsslTrgPrioConfig: IrqHssl0TrgPrio=0, IrqHssl1TrgPrio=0, IrqHssl2TrgPrio=0, IrqHssl3TrgPrio=0
      IrqHsslTosConfig
        IrqHsslCokTosConfig: IrqHssl0CokTos=CPU0, IrqHssl1CokTos=CPU0, IrqHssl2CokTos=CPU0, IrqHssl3CokTos=CPU0
        IrqHsslErrTosConfig: IrqHssl0ErrTos=CPU0, IrqHssl1ErrTos=CPU0, IrqHssl2ErrTos=CPU0, IrqHssl3ErrTos=CPU0
        IrqHsslExiTosConfig: IrqHsslExiTos=CPU0
        IrqHsslRdiTosConfig: IrqHssl0RdiTos=CPU0, IrqHssl1RdiTos=CPU0, IrqHssl2RdiTos=CPU0, IrqHssl3RdiTos=CPU0
        IrqHsslTrgTosConfig: IrqHssl0TrgTos=CPU0, IrqHssl1TrgTos=CPU0, IrqHssl2TrgTos=CPU0, IrqHssl3TrgTos=CPU0
    CommonPublishedInformation:
      ArMajorVersion = 0
      ArMinorVersion = 0
      ArPatchVersion = 0
      ModuleId = 255
      Release = _TRICORE_TC275
      SwMajorVersion = 5
      SwMinorVersion = 1
      SwPatchVersion = 0
      VendorId = 17
package /Adc
  module config Adc: implementation-config-variant=VARIANT-POST-BUILD-LOADABLE
    AdcConfigSet_0 (AdcConfigSet):
      AdcAnalogClockDivider = 10
      AdcDigitalArbiterClockDivider = 0
      AdcLowPowerSupplyVoltage = POWER_SUPPLY_5V
      AdcRefPrechargeControl = USE_VDDM_PRECH_VAREF_ADJ
      AdcSleepMode = SLEEP_MODE_ACCEPT
      AdcCcu6ModuleRef = (unset)
      AdcSystemClock = McuClockReferencePoint
      AdcGlobInputClass_0 (AdcGlobInputClass): AdcGlobChResolution=CH_RES_10BIT, AdcGlobChSampleTime=0
      AdcGlobInputClass_1 (AdcGlobInputClass): AdcGlobChResolution=CH_RES_10BIT, AdcGlobChSampleTime=0
      AdcHwUnit_0 (AdcHwUnit):
        AdcArbitrationRoundLength = ARBITRATION_SLOTS_4
        AdcClockSource = CLK_SRC_SYS_CLK
        AdcHwUnitId = HWUNIT_ADC0
        AdcPostCal = POST_CAL_DISABLE
        AdcSyncConvMode = ADC_STANDALONE
        AdcChannel_0 (AdcChannel):
          AdcAnChannelNum = 0
          AdcChannelHighLimit = 255
          AdcChannelId = 0
          AdcChannelLimitCheck = 0
          AdcChannelLowLimit = 0
          AdcChannelRangeSelect = ADC_RANGE_ALWAYS
          AdcChannelRefVoltsrcHigh = REF_VOLTAGE_VAREF
          AdcChannelRefVoltsrcLow = REF_VOLTAGE_VAGND
          AdcSyncChannel = 0
          AdcInputClassSelection = AdcGlobInputClass_0
        AdcGroup_0 (AdcGroup):
          AdcEmuxScanEnable = 0
          AdcGroupAccessMode = ADC_ACCESS_MODE_SINGLE
          AdcGroupConversionMode = ADC_CONV_MODE_ONESHOT
          AdcGroupId = 0
          AdcGroupRequestSource = REQSRC1_NCH_SCAN
          AdcGroupTriggSrc = ADC_TRIGG_SRC_SW
          AdcHwGateSignal = ADC_GATE_SIGNAL_NONE
          AdcStreamingBufferMode = ADC_STREAM_BUFFER_LINEAR
          AdcStreamingNumSamples = 1
          AdcGroupDefinition = AdcChannel_0
        AdcKernelInputClass_0 (AdcKernelInputClass): AdcKernelChResolution=CH_RES_10BIT, AdcKernelChSampleTime=0
        AdcKernelInputClass_1 (AdcKernelInputClass): AdcKernelChResolution=CH_RES_10BIT, AdcKernelChSampleTime=0
    AdcGeneral:
      AdcCcu6Synchronization = 0
      AdcDeInitApi = 0
      AdcDebugSupport = 0
      AdcDevErrorDetect = 0
      AdcEnableLimitCheck = 0
      AdcEnableQueuing = 0
      AdcEnableStartStopGroupApi = 1
      AdcGrpNotifCapability = 0
      AdcHwTriggerApi = 0
      AdcMasterSlaveSync = 0
      AdcMaxChConvTimeCount = 10000
      AdcNonAutosarDmaResultHandling = 0
      AdcNonAutosarResultPolling = 0
      AdcPBFixedAddress = 0
      AdcPriorityImplementation = ADC_PRIORITY_NONE
      AdcReadGroupApi = 0
      AdcResetSfrAtInit = 0
      AdcResultAlignment = ADC_ALIGN_RIGHT
      AdcRunningInUser0Mode = 0
      AdcSameChannelQueuing = 0
      AdcUseEmux = 0
      AdcUserModeDeInitApiEnable = 0
      AdcUserModeInitApiEnable = 0
      AdcUserModeRuntimeApiEnable = 0
      AdcVersionInfoApi = 0
    AdcSafety: AdcSafetyEnable=0
    AdcPublishedInformation: AdcChannelValueSigned=0, AdcGroupFirstChannelFixed=0, AdcMaxChannelResolution=12
    CommonPublishedInformation:
      ArMajorVersion = 4
      ArMinorVersion = 2
      ArPatchVersion = 0
      ModuleId = 123
      Release = _TRICORE_TC275
      SwMajorVersion = 3
      SwMinorVersion = 2
      SwPatchVersion = 1
      VendorId = 17
