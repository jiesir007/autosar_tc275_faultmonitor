AUTOSAR XML (schema 4-0-3)
package /DaVinci_Project
  module config Com
    ComConfig
      10 x ComSignalGroup:
        SG_Sig_Grp_0x210_oSupF_Led_State_oDBCNetWork_ec44dd46_Tx
          4 x ComGroupSignal, all with ComSignalType=UINT8:
            F_Led1_State_oSupF_Led_State_oDBCNetWork_8a0569d2_Tx
            F_Led2_State_oSupF_Led_State_oDBCNetWork_01d657cb_Tx
            F_Led3_State_oSupF_Led_State_oDBCNetWork_ce484003_Tx
            F_Led4_State_oSupF_Led_State_oDBCNetWork_cd012db8_Tx
        SG_Sig_Grp_0x211_oSupF_Button_State_oDBCNetWork_b368711c_Tx
          4 x ComGroupSignal, all with ComSignalType=UINT8:
            F_Button1_State_oSupF_Button_State_oDBCNetWork_ab1ba929_Tx
            F_Button2_State_oSupF_Button_State_oDBCNetWork_e6f3a94e_Tx
            F_Button3_State_oSupF_Button_State_oDBCNetWork_6b7b54ac_Tx
            F_Button4_State_oSupF_Button_State_oDBCNetWork_7d23a980_Tx
        SG_Sig_Grp_0x212_oSupF_PowerMode_oDBCNetWork_de62da88_Tx
          3 x ComGroupSignal, all with ComSignalType=UINT8:
            F_PowerMode_oSupF_PowerMode_oDBCNetWork_16d1a370_Tx
            SupF_Checksum_0x212_oSupF_PowerMode_oDBCNetWork_8c3e64a3_Tx
            SupF_Counter_0x212_oSupF_PowerMode_oDBCNetWork_35c7002c_Tx
        SG_Sig_Grp_0x213_oSupF_Angle_oDBCNetWork_3c68f302_Tx
          F_AAA_Angle_oSupF_Angle_oDBCNetWork_d35fb591_Tx (ComGroupSignal): ComSignalType=UINT8
        SG_Sig_Grp_0x214_oSupF_Function_1_oDBCNetWork_0607409d_Tx
          4 x ComGroupSignal, all with ComSignalType=UINT16:
            F_Sig_0x214_Used_1_oSupF_Function_1_oDBCNetWork_cbe4e15e_Tx
            F_Sig_0x214_Used_2_oSupF_Function_1_oDBCNetWork_8f45c446_Tx
            F_Sig_0x214_Used_3_oSupF_Function_1_oDBCNetWork_b325274e_Tx
            F_Sig_0x214_Used_5_oSupF_Function_1_oDBCNetWork_3a676d7e_Tx
        SG_Sig_Grp_0x216_oSupF_ComError_oDBCNetWork_8d63d174_Tx
          F_Meg_E2E_Error_oSupF_ComError_oDBCNetWork_edc11637_Tx (ComGroupSignal): ComSignalType=UINT8
          F_Mes_Lost_Error_oSupF_ComError_oDBCNetWork_72d68791_Tx (ComGroupSignal): ComSignalType=UINT8
        SG_Sig_Grp_0x300_oSupD_Led_Control_oDBCNetWork_89733210_Rx
          6 x ComGroupSignal, all with ComSignalType=UINT8:
            D_Led1_Control_oSupD_Led_Control_oDBCNetWork_34bc1d83_Rx
            D_Led2_Control_oSupD_Led_Control_oDBCNetWork_e7270178_Rx
            D_Led3_Control_oSupD_Led_Control_oDBCNetWork_a9ae0ad1_Rx
            D_Led4_Control_oSupD_Led_Control_oDBCNetWork_9b603ecf_Rx
            SupD_Checksum_0x300_oSupD_Led_Control_oDBCNetWork_2c493488_Rx
            SupD_Counter_0x300_oSupD_Led_Control_oDBCNetWork_b943cd4b_Rx
        SG_Sig_Grp_0x301_oSupD_Button_Control_oDBCNetWork_188cbd42_Rx
          4 x ComGroupSignal, all with ComSignalType=UINT8:
            D_Button1_Control_oSupD_Button_Control_oDBCNetWork_fc1efec2_Rx
            D_Button2_Control_oSupD_Button_Control_oDBCNetWork_c42575b1_Rx
            D_Button3_Control_oSupD_Button_Control_oDBCNetWork_651cf15f_Rx
            D_Button4_Control_oSupD_Button_Control_oDBCNetWork_b4526357_Rx
        SG_Sig_Grp_0x302_oSupE_Function_1_oDBCNetWork_28664efe_Rx
          3 x ComGroupSignal:
            E_Sig_0x302_Used_1_oSupE_Function_1_oDBCNetWork_5fb2dd52_Rx: ComSignalType=UINT16
            E_Sig_0x302_Used_2_oSupE_Function_1_oDBCNetWork_1b13f84a_Rx: ComSignalType=UINT8
            E_Sig_0x302_Used_3_oSupE_Function_1_oDBCNetWork_27731b42_Rx: ComSignalType=UINT8
        SG_Sig_Grp_0x304_oSupD_Led_CtrlMode_oDBCNetWork_663125ab_Rx
          6 x ComGroupSignal, all with ComSignalType=UINT8:
            D_Led1_CtrlMode_oSupD_Led_CtrlMode_oDBCNetWork_e2fdf3e9_Rx
            D_Led2_CtrlMode_oSupD_Led_CtrlMode_oDBCNetWork_01b4444b_Rx
            D_Led3_CtrlMode_oSupD_Led_CtrlMode_oDBCNetWork_e9a3d4ea_Rx
            D_Led4_CtrlMode_oSupD_Led_CtrlMode_oDBCNetWork_1c562d4e_Rx
            SupD_Checksum_0x304_oSupD_Led_CtrlMode_oDBCNetWork_984004db_Rx
            SupD_Counter_0x304_oSupD_Led_CtrlMode_oDBCNetWork_9ab89d28_Rx
  module config Rte
    22 x RteBswModuleInstance:
      Adc
      BswM
        BswM_MainFunctionTimingEvent0 (RteBswEventToTaskMapping): RteBswUsedOsEventRef=Rte_Ev_Cyclic2_OsTask_Bsw5ms_Core0_0_5ms, RteBswUsedOsAlarmRef=Os/Rte_Al_TE2_OsTask_Bsw5ms_Core0_0_5ms
      Can
        5 x RteBswEventToTaskMapping:
          Can_MainFunction_BusOffTimingEvent0
          Can_MainFunction_ModeTimingEvent0: RteBswUsedOsEventRef=Rte_Ev_Cyclic2_OsTask_Bsw5ms_Core0_0_5ms, RteBswUsedOsAlarmRef=Os/Rte_Al_TE2_OsTask_Bsw5ms_Core0_0_5ms
          Can_MainFunction_ReadTimingEvent0
          Can_MainFunction_WakeupTimingEvent0: RteBswUsedOsEventRef=Rte_Ev_Cyclic2_OsTask_Bsw5ms_Core0_0_5ms, RteBswUsedOsAlarmRef=Os/Rte_Al_TE2_OsTask_Bsw5ms_Core0_0_5ms
          Can_MainFunction_WriteTimingEvent0
      CanIf
      CanNm
        CanNm_MainFunctionTimingEvent0 (RteBswEventToTaskMapping): RteBswUsedOsEventRef=Rte_Ev_Cyclic2_OsTask_Bsw5ms_Core0_0_5ms, RteBswUsedOsAlarmRef=Os/Rte_Al_TE2_OsTask_Bsw5ms_Core0_0_5ms
      CanSM
        CanSM_MainFunctionTimingEvent0 (RteBswEventToTaskMapping): RteBswUsedOsEventRef=Rte_Ev_Cyclic2_OsTask_Bsw5ms_Core0_0_5ms, RteBswUsedOsAlarmRef=Os/Rte_Al_TE2_OsTask_Bsw5ms_Core0_0_5ms
      CanTp
        CanTp_MainFunctionTimingEvent0 (RteBswEventToTaskMapping): RteBswUsedOsEventRef=Rte_Ev_Cyclic2_OsTask_Bsw5ms_Core0_0_5ms, RteBswUsedOsAlarmRef=Os/Rte_Al_TE2_OsTask_Bsw5ms_Core0_0_5ms
      CanTrcv
        CanTrcv_30_Tja1043_MainFunctionTimingEvent0 (RteBswEventToTaskMapping): RteBswUsedOsEventRef=Rte_Ev_Cyclic2_OsTask_Bsw5ms_Core0_0_5ms, RteBswUsedOsAlarmRef=Os/Rte_Al_TE2_OsTask_Bsw5ms_Core0_0_5ms
      Com
        Com_MainFunctionRxTimingEvent0 (RteBswEventToTaskMapping): RteBswUsedOsEventRef=Rte_Ev_Cyclic2_OsTask_Bsw5ms_Core0_0_5ms, RteBswUsedOsAlarmRef=Os/Rte_Al_TE2_OsTask_Bsw5ms_Core0_0_5ms
        Com_MainFunctionTxTimingEvent0 (RteBswEventToTaskMapping): RteBswUsedOsEventRef=Rte_Ev_Cyclic2_OsTask_Bsw5ms_Core0_0_5ms, RteBswUsedOsAlarmRef=Os/Rte_Al_TE2_OsTask_Bsw5ms_Core0_0_5ms
      ComM
        ComM_MainFunction_0TimingEvent0 (RteBswEventToTaskMapping): RteBswUsedOsEventRef=Rte_Ev_Cyclic2_OsTask_Bsw5ms_Core0_0_5ms, RteBswUsedOsAlarmRef=Os/Rte_Al_TE2_OsTask_Bsw5ms_Core0_0_5ms
        ComM_MainFunction_1TimingEvent0 (RteBswEventToTaskMapping): RteBswUsedOsEventRef=Rte_Ev_Cyclic2_OsTask_Bsw5ms_Core0_0_5ms, RteBswUsedOsAlarmRef=Os/Rte_Al_TE2_OsTask_Bsw5ms_Core0_0_5ms
      Dcm
        Dcm_MainFunctionTimingEvent0 (RteBswEventToTaskMapping): RteBswUsedOsEventRef=Rte_Ev_Cyclic2_OsTask_Bsw5ms_Core0_0_5ms, RteBswUsedOsAlarmRef=Os/Rte_Al_TE2_OsTask_Bsw5ms_Core0_0_5ms
      Dem
        Dem_MasterMainFunctionTimingEvent0 (RteBswEventToTaskMapping): RteBswUsedOsEventRef=Rte_Ev_Cyclic2_OsTask_Bsw5ms_Core0_0_5ms, RteBswUsedOsAlarmRef=Os/Rte_Al_TE2_OsTask_Bsw5ms_Core0_0_5ms
        Dem_SatelliteMainFunctionTimingEvent0 (RteBswEventToTaskMapping): RteBswUsedOsEventRef=Rte_Ev_Cyclic2_OsTask_Bsw5ms_Core0_0_5ms, RteBswUsedOsAlarmRef=Os/Rte_Al_TE2_OsTask_Bsw5ms_Core0_0_5ms
      Det
      Dio
      EcuM
        3 x RteBswEventToTaskMapping:
          EcuM_MainFunctionTimingEvent0: RteBswUsedOsEventRef=Rte_Ev_Cyclic2_OsTask_Bsw5ms_Core0_0_5ms, RteBswUsedOsAlarmRef=Os/Rte_Al_TE2_OsTask_Bsw5ms_Core0_0_5ms
          EcuM_MainFunctionTimingEvent1: RteBswUsedOsEventRef=Rte_Ev_RunS2_EcuM_EcuM_MainFunction, RteBswUsedOsAlarmRef=Os/Rte_Al_TE2_EcuM_EcuM_MainFunction
          EcuM_MainFunctionTimingEvent2: RteBswUsedOsEventRef=Rte_Ev_Cyclic2_OsTask_App10ms_Core2_0_5ms, RteBswUsedOsAlarmRef=Os/Rte_Al_TE2_OsTask_App10ms_Core2_0_5ms
      Icu
      IoHwAb_0
      Irq
      Mcu
      Nm
      PduR
      Port
    20 x RteSwComponentInstance:
      AppButtonCtrl_EcuSwComposition
        TMT_AppButtonCtrl_MainFunction (RteEventToTaskMapping): RteUsedOsAlarmRef=Os/Rte_Al_TE_OsTask_App10ms_Core0_0_10ms
      AppComRx_EcuSwComposition
        TMT_AppComRx_MainFunction (RteEventToTaskMapping): RteUsedOsAlarmRef=Os/Rte_Al_TE_OsTask_App10ms_Core0_0_10ms
      AppComTx_EcuSwComposition
        TMT_AppComTx_MainFunction (RteEventToTaskMapping): RteUsedOsAlarmRef=Os/Rte_Al_TE_OsTask_App10ms_Core0_0_10ms
      AppCtrl_EcuSwComposition
        TMT_AppCtrl_MainFunction (RteEventToTaskMapping): RteUsedOsAlarmRef=Os/Rte_Al_TE_OsTask_App10ms_Core0_0_10ms
      AppCtrl1_EcuSwComposition
        TMT_AppCtrl1_MainFuntion (RteEventToTaskMapping): RteUsedOsEventRef=Rte_Ev_Run_AppCtrl1_AppCtrl1_MainFuntion, RteUsedOsAlarmRef=Os/Rte_Al_TE_AppCtrl1_AppCtrl1_MainFuntion
      AppCtrl2_EcuSwComposition
        TMT_AppCtrl2_MainFunction (RteEventToTaskMapping): RteUsedOsEventRef=Rte_Ev_Run_AppCtrl2_AppCtrl2_MainFunction, RteUsedOsAlarmRef=Os/Rte_Al_TE_AppCtrl2_AppCtrl2_MainFunction
      AppLedCtrl_EcuSwComposition
        TMT_Runnable (RteEventToTaskMapping): RteUsedOsAlarmRef=Os/Rte_Al_TE_OsTask_App10ms_Core0_0_10ms
      AppWakeUpCtrl_EcuSwComposition
        TMT_AppWakeUpCtrl_MainFunction (RteEventToTaskMapping): RteUsedOsAlarmRef=Os/Rte_Al_TE_OsTask_App10ms_Core0_0_10ms
      BswM_EcuSwComposition
        Timer_BswM_MainFunction (RteEventToTaskMapping): RteUsedOsEventRef=Rte_Ev_Cyclic2_OsTask_Bsw5ms_Core0_0_5ms, RteUsedOsAlarmRef=Os/Rte_Al_TE2_OsTask_Bsw5ms_Core0_0_5ms
      ComM_EcuSwComposition
        Timer_ComM_MainFunction_0 (RteEventToTaskMapping): RteUsedOsEventRef=Rte_Ev_Cyclic2_OsTask_Bsw5ms_Core0_0_5ms, RteUsedOsAlarmRef=Os/Rte_Al_TE2_OsTask_Bsw5ms_Core0_0_5ms
        Timer_ComM_MainFunction_1 (RteEventToTaskMapping): RteUsedOsEventRef=Rte_Ev_Cyclic2_OsTask_Bsw5ms_Core0_0_5ms, RteUsedOsAlarmRef=Os/Rte_Al_TE2_OsTask_Bsw5ms_Core0_0_5ms
      Dcm_EcuSwComposition
        Timer_Dcm_MainFunction (RteEventToTaskMapping): RteUsedOsEventRef=Rte_Ev_Cyclic2_OsTask_Bsw5ms_Core0_0_5ms, RteUsedOsAlarmRef=Os/Rte_Al_TE2_OsTask_Bsw5ms_Core0_0_5ms
      DemMaster_0_EcuSwComposition
        Timer_Dem_MasterMainFunction (RteEventToTaskMapping): RteUsedOsEventRef=Rte_Ev_Cyclic2_OsTask_Bsw5ms_Core0_0_5ms, RteUsedOsAlarmRef=Os/Rte_Al_TE2_OsTask_Bsw5ms_Core0_0_5ms
      DemSatellite_0_EcuSwComposition
        Timer_Dem_SatelliteMainFunction (RteEventToTaskMapping): RteUsedOsEventRef=Rte_Ev_Cyclic2_OsTask_Bsw5ms_Core0_0_5ms, RteUsedOsAlarmRef=Os/Rte_Al_TE2_OsTask_Bsw5ms_Core0_0_5ms
      Det_EcuSwComposition
      EcuM_EcuSwComposition
        Timer_EcuM_MainFunction (RteEventToTaskMapping): RteUsedOsEventRef=Rte_Ev_Cyclic2_OsTask_App10ms_Core2_0_5ms, RteUsedOsAlarmRef=Os/Rte_Al_TE2_OsTask_App10ms_Core2_0_5ms
      IcuCdd_EcuSwComposition
        TMT_IcuCdd_MainFunction (RteEventToTaskMapping): RteUsedOsAlarmRef=Os/Rte_Al_TE_OsTask_App10ms_Core0_0_10ms
      IoHwAb_EcuSwComposition
        Timer_IoHwAb_IoHwAbRunnable (RteEventToTaskMapping): RteUsedOsEventRef=Rte_Ev_Run_IoHwAb_IoHwAb_IoHwAbRunnable, RteUsedOsAlarmRef=Os/Rte_Al_TE_IoHwAb_IoHwAb_IoHwAbRunnable
      Os_OsCore{0..2}_swc_EcuSwComposition
    RteOsInteraction
      7 x RteUsedOsActivation, all with RteExpectedActivationOffset=0:
        Rte_Al_TE_OsTask_App10ms_Core0_0_10ms: RteActivationOsAlarmRef=Os/Rte_Al_TE_OsTask_App10ms_Core0_0_10ms, RteActivationOsTaskRef=OsTask_App10ms_Core0
        Rte_Al_TE2_EcuM_EcuM_MainFunction: RteActivationOsAlarmRef=Os/Rte_Al_TE2_EcuM_EcuM_MainFunction, RteActivationOsTaskRef=OsTask_App10ms_Core1
        Rte_Al_TE_AppCtrl1_AppCtrl1_MainFuntion: RteActivationOsAlarmRef=Os/Rte_Al_TE_AppCtrl1_AppCtrl1_MainFuntion, RteActivationOsTaskRef=OsTask_App10ms_Core1
        Rte_Al_TE2_OsTask_App10ms_Core2_0_5ms: RteActivationOsAlarmRef=Os/Rte_Al_TE2_OsTask_App10ms_Core2_0_5ms, RteActivationOsTaskRef=OsTask_App10ms_Core2
        Rte_Al_TE_AppCtrl2_AppCtrl2_MainFunction: RteActivationOsAlarmRef=Os/Rte_Al_TE_AppCtrl2_AppCtrl2_MainFunction, RteActivationOsTaskRef=OsTask_App10ms_Core2
        Rte_Al_TE2_OsTask_Bsw5ms_Core0_0_5ms: RteActivationOsAlarmRef=Os/Rte_Al_TE2_OsTask_Bsw5ms_Core0_0_5ms, RteActivationOsTaskRef=OsTask_Bsw5ms_Core0
        Rte_Al_TE_IoHwAb_IoHwAb_IoHwAbRunnable: RteActivationOsAlarmRef=Os/Rte_Al_TE_IoHwAb_IoHwAb_IoHwAbRunnable, RteActivationOsTaskRef=OsTask_Bsw5ms_Core0
  module config NvM
  module config Os
    OsTask_App10ms_Core0 (OsTask):
      OsTaskActivation = 1
      OsTaskPriority = 34
      OsTaskSchedule = NON
      OsTaskAccessingApplication = SystemApplication_OsCore1
      OsTaskAccessingApplication = SystemApplication_OsCore2
    Rte_Al_TE_OsTask_App10ms_Core0_0_10ms (OsAlarm):
      OsAlarmCounterRef = SystemTimer_Core0
      OsAlarmAccessingApplication = SystemApplication_OsCore1
      OsAlarmAccessingApplication = SystemApplication_OsCore2
      OsAlarmAction
        OsAlarmActivateTask: OsAlarmActivateTaskRef=OsTask_App10ms_Core0
    OsTask_App10ms_Core1 (OsTask):
      OsTaskActivation = 1
      OsTaskPriority = 42
      OsTaskSchedule = NON
      OsTaskEventRef = Rte_Ev_RunS2_EcuM_EcuM_MainFunction
      OsTaskEventRef = Rte_Ev_Run_AppCtrl1_AppCtrl1_MainFuntion
      OsTaskAccessingApplication = SystemApplication_OsCore0
      OsTaskAccessingApplication = SystemApplication_OsCore2
    Rte_Al_TE2_EcuM_EcuM_MainFunction (OsAlarm):
      OsAlarmCounterRef = SystemTimer_Core1
      OsAlarmAccessingApplication = SystemApplication_OsCore0
      OsAlarmAccessingApplication = SystemApplication_OsCore2
      OsAlarmAction
        OsAlarmSetEvent: OsAlarmSetEventRef=Rte_Ev_RunS2_EcuM_EcuM_MainFunction, OsAlarmSetEventTaskRef=OsTask_App10ms_Core1
    Rte_Al_TE_AppCtrl1_AppCtrl1_MainFuntion (OsAlarm):
      OsAlarmCounterRef = SystemTimer_Core1
      OsAlarmAccessingApplication = SystemApplication_OsCore0
      OsAlarmAccessingApplication = SystemApplication_OsCore2
      OsAlarmAction
        OsAlarmSetEvent: OsAlarmSetEventRef=Rte_Ev_Run_AppCtrl1_AppCtrl1_MainFuntion, OsAlarmSetEventTaskRef=OsTask_App10ms_Core1
    OsTask_App10ms_Core2 (OsTask):
      OsTaskActivation = 1
      OsTaskPriority = 46
      OsTaskSchedule = NON
      OsTaskEventRef = Rte_Ev_Cyclic2_OsTask_App10ms_Core2_0_5ms
      OsTaskEventRef = Rte_Ev_Run_AppCtrl2_AppCtrl2_MainFunction
      OsTaskAccessingApplication = SystemApplication_OsCore0
      OsTaskAccessingApplication = SystemApplication_OsCore1
    Rte_Al_TE2_OsTask_App10ms_Core2_0_5ms (OsAlarm):
      OsAlarmCounterRef = SystemTimer_Core2
      OsAlarmAccessingApplication = SystemApplication_OsCore0
      OsAlarmAccessingApplication = SystemApplication_OsCore1
      OsAlarmAction
        OsAlarmSetEvent: OsAlarmSetEventRef=Rte_Ev_Cyclic2_OsTask_App10ms_Core2_0_5ms, OsAlarmSetEventTaskRef=OsTask_App10ms_Core2
    Rte_Al_TE_AppCtrl2_AppCtrl2_MainFunction (OsAlarm):
      OsAlarmCounterRef = SystemTimer_Core2
      OsAlarmAccessingApplication = SystemApplication_OsCore0
      OsAlarmAccessingApplication = SystemApplication_OsCore1
      OsAlarmAction
        OsAlarmSetEvent: OsAlarmSetEventRef=Rte_Ev_Run_AppCtrl2_AppCtrl2_MainFunction, OsAlarmSetEventTaskRef=OsTask_App10ms_Core2
    OsTask_App_Init_Task (OsTask):
      OsTaskActivation = 1
      OsTaskPriority = 50
      OsTaskSchedule = NON
      OsTaskAccessingApplication = SystemApplication_OsCore1
      OsTaskAccessingApplication = SystemApplication_OsCore2
    OsTask_Bsw5ms_Core0 (OsTask):
      OsTaskActivation = 1
      OsTaskPriority = 35
      OsTaskSchedule = NON
      OsTaskEventRef = Rte_Ev_Cyclic2_OsTask_Bsw5ms_Core0_0_5ms
      OsTaskEventRef = Rte_Ev_Run_IoHwAb_IoHwAb_IoHwAbRunnable
      OsTaskAccessingApplication = SystemApplication_OsCore1
      OsTaskAccessingApplication = SystemApplication_OsCore2
    Rte_Al_TE2_OsTask_Bsw5ms_Core0_0_5ms (OsAlarm):
      OsAlarmCounterRef = SystemTimer_Core0
      OsAlarmAccessingApplication = SystemApplication_OsCore1
      OsAlarmAccessingApplication = SystemApplication_OsCore2
      OsAlarmAction
        OsAlarmSetEvent: OsAlarmSetEventRef=Rte_Ev_Cyclic2_OsTask_Bsw5ms_Core0_0_5ms, OsAlarmSetEventTaskRef=OsTask_Bsw5ms_Core0
    Rte_Al_TE_IoHwAb_IoHwAb_IoHwAbRunnable (OsAlarm):
      OsAlarmCounterRef = SystemTimer_Core0
      OsAlarmAccessingApplication = SystemApplication_OsCore1
      OsAlarmAccessingApplication = SystemApplication_OsCore2
      OsAlarmAction
        OsAlarmSetEvent: OsAlarmSetEventRef=Rte_Ev_Run_IoHwAb_IoHwAb_IoHwAbRunnable, OsAlarmSetEventTaskRef=OsTask_Bsw5ms_Core0
    6 x OsEvent:
      Rte_Ev_Cyclic2_OsTask_App10ms_Core2_0_5ms
      Rte_Ev_Cyclic2_OsTask_Bsw5ms_Core0_0_5ms
      Rte_Ev_RunS2_EcuM_EcuM_MainFunction
      Rte_Ev_Run_AppCtrl1_AppCtrl1_MainFuntion
      Rte_Ev_Run_AppCtrl2_AppCtrl2_MainFunction
      Rte_Ev_Run_IoHwAb_IoHwAb_IoHwAbRunnable
    3 x OsApplication, all with OsTrusted=true:
      SystemApplication_OsCore0: OsAppTaskRef=OsTask_App10ms_Core0, OsAppAlarmRef=Os/Rte_Al_TE_OsTask_App10ms_Core0_0_10ms, OsAppTaskRef=OsTask_App_Init_Task, OsAppTaskRef=OsTask_Bsw5ms_Core0, OsAppAlarmRef=Os/Rte_Al_TE2_OsTask_Bsw5ms_Core0_0_5ms, OsAppAlarmRef=Os/Rte_Al_TE_IoHwAb_IoHwAb_IoHwAbRunnable
      SystemApplication_OsCore1: OsAppTaskRef=OsTask_App10ms_Core1, OsAppAlarmRef=Os/Rte_Al_TE2_EcuM_EcuM_MainFunction, OsAppAlarmRef=Os/Rte_Al_TE_AppCtrl1_AppCtrl1_MainFuntion
      SystemApplication_OsCore2: OsAppTaskRef=OsTask_App10ms_Core2, OsAppAlarmRef=Os/Rte_Al_TE2_OsTask_App10ms_Core2_0_5ms, OsAppAlarmRef=Os/Rte_Al_TE_AppCtrl2_AppCtrl2_MainFunction
  module config EcuC
  ecuc value collection DaVinci_Project: ecuc-values=[Com, Rte, Os, EcuC, NvM]
