AUTOSAR XML (schema 00046)
package /COM/VECTOR/CFG/WORKFLOW/SYSDESC/SYNC
  flat map FLATMAP
    30 x flat instance descriptor:
      AppCtrl: upstream-reference=EcuSwComposition.AppCtrl, ecu-extract-reference=COMPOSITIONTYPE.AppCtrl
      AppComTx: upstream-reference=EcuSwComposition.AppComTx, ecu-extract-reference=COMPOSITIONTYPE.AppComTx
      AppComRx: upstream-reference=EcuSwComposition.AppComRx, ecu-extract-reference=COMPOSITIONTYPE.AppComRx
      AppWakeUpCtrl: upstream-reference=EcuSwComposition.AppWakeUpCtrl, ecu-extract-reference=COMPOSITIONTYPE.AppWakeUpCtrl
      AppButtonCtrl: upstream-reference=EcuSwComposition.AppButtonCtrl, ecu-extract-reference=COMPOSITIONTYPE.AppButtonCtrl
      AppLedCtrl: upstream-reference=EcuSwComposition.AppLedCtrl, ecu-extract-reference=COMPOSITIONTYPE.AppLedCtrl
      IoHwAb: upstream-reference=EcuSwComposition.IoHwAb, ecu-extract-reference=COMPOSITIONTYPE.IoHwAb
      AppCtrl2: upstream-reference=EcuSwComposition.AppCtrl2, ecu-extract-reference=COMPOSITIONTYPE.AppCtrl2
      AppCtrl1: upstream-reference=EcuSwComposition.AppCtrl1, ecu-extract-reference=COMPOSITIONTYPE.AppCtrl1
      IcuCdd: upstream-reference=EcuSwComposition.IcuCdd, ecu-extract-reference=COMPOSITIONTYPE.IcuCdd
      SG_Sig_Grp_0x210: upstream-reference=EcuSwComposition.SG_Sig_Grp_0x210.SG_Sig_Grp_0x210, ecu-extract-reference=COMPOSITIONTYPE.SG_Sig_Grp_0x210.SG_Sig_Grp_0x210
      SG_Sig_Grp_0x210_001: upstream-reference=EcuSwComposition.SG_Sig_Grp_0x210, ecu-extract-reference=COMPOSITIONTYPE.SG_Sig_Grp_0x210
      SG_Sig_Grp_0x211: upstream-reference=EcuSwComposition.SG_Sig_Grp_0x211.SG_Sig_Grp_0x211, ecu-extract-reference=COMPOSITIONTYPE.SG_Sig_Grp_0x211.SG_Sig_Grp_0x211
      SG_Sig_Grp_0x211_001: upstream-reference=EcuSwComposition.SG_Sig_Grp_0x211, ecu-extract-reference=COMPOSITIONTYPE.SG_Sig_Grp_0x211
      SG_Sig_Grp_0x212: upstream-reference=EcuSwComposition.SG_Sig_Grp_0x212.SG_Sig_Grp_0x212, ecu-extract-reference=COMPOSITIONTYPE.SG_Sig_Grp_0x212.SG_Sig_Grp_0x212
      SG_Sig_Grp_0x212_001: upstream-reference=EcuSwComposition.SG_Sig_Grp_0x212, ecu-extract-reference=COMPOSITIONTYPE.SG_Sig_Grp_0x212
      SG_Sig_Grp_0x213: upstream-reference=EcuSwComposition.SG_Sig_Grp_0x213.SG_Sig_Grp_0x213, ecu-extract-reference=COMPOSITIONTYPE.SG_Sig_Grp_0x213.SG_Sig_Grp_0x213
      SG_Sig_Grp_0x213_001: upstream-reference=EcuSwComposition.SG_Sig_Grp_0x213, ecu-extract-reference=COMPOSITIONTYPE.SG_Sig_Grp_0x213
      SG_Sig_Grp_0x214: upstream-reference=EcuSwComposition.SG_Sig_Grp_0x214.SG_Sig_Grp_0x214, ecu-extract-reference=COMPOSITIONTYPE.SG_Sig_Grp_0x214.SG_Sig_Grp_0x214
      SG_Sig_Grp_0x214_001: upstream-reference=EcuSwComposition.SG_Sig_Grp_0x214, ecu-extract-reference=COMPOSITIONTYPE.SG_Sig_Grp_0x214
      SG_Sig_Grp_0x216: upstream-reference=EcuSwComposition.SG_Sig_Grp_0x216.SG_Sig_Grp_0x216, ecu-extract-reference=COMPOSITIONTYPE.SG_Sig_Grp_0x216.SG_Sig_Grp_0x216
      SG_Sig_Grp_0x216_001: upstream-reference=EcuSwComposition.SG_Sig_Grp_0x216, ecu-extract-reference=COMPOSITIONTYPE.SG_Sig_Grp_0x216
      SG_Sig_Grp_0x300: upstream-reference=EcuSwComposition.SG_Sig_Grp_0x300.SG_Sig_Grp_0x300, ecu-extract-reference=COMPOSITIONTYPE.SG_Sig_Grp_0x300.SG_Sig_Grp_0x300
      SG_Sig_Grp_0x300_001: upstream-reference=EcuSwComposition.SG_Sig_Grp_0x300, ecu-extract-reference=COMPOSITIONTYPE.SG_Sig_Grp_0x300
      SG_Sig_Grp_0x301: upstream-reference=EcuSwComposition.SG_Sig_Grp_0x301.SG_Sig_Grp_0x301, ecu-extract-reference=COMPOSITIONTYPE.SG_Sig_Grp_0x301.SG_Sig_Grp_0x301
      SG_Sig_Grp_0x301_001: upstream-reference=EcuSwComposition.SG_Sig_Grp_0x301, ecu-extract-reference=COMPOSITIONTYPE.SG_Sig_Grp_0x301
      SG_Sig_Grp_0x302: upstream-reference=EcuSwComposition.SG_Sig_Grp_0x302.SG_Sig_Grp_0x302, ecu-extract-reference=COMPOSITIONTYPE.SG_Sig_Grp_0x302.SG_Sig_Grp_0x302
      SG_Sig_Grp_0x302_001: upstream-reference=EcuSwComposition.SG_Sig_Grp_0x302, ecu-extract-reference=COMPOSITIONTYPE.SG_Sig_Grp_0x302
      SG_Sig_Grp_0x304: upstream-reference=EcuSwComposition.SG_Sig_Grp_0x304.SG_Sig_Grp_0x304, ecu-extract-reference=COMPOSITIONTYPE.SG_Sig_Grp_0x304.SG_Sig_Grp_0x304
      SG_Sig_Grp_0x304_001: upstream-reference=EcuSwComposition.SG_Sig_Grp_0x304, ecu-extract-reference=COMPOSITIONTYPE.SG_Sig_Grp_0x304
