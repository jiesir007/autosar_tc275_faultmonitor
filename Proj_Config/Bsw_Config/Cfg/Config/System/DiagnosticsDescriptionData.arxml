AUTOSAR XML (schema 00046)
package /InitialEcuC
  ecuc value collection InitialEcuC: ecuc-values=[Dcm, Dem]
  module config Dcm: module-description=Dcm_Impl
    DcmConfigSet
      DcmGeneral
      DcmDsd
        DcmDsdServiceTable
          12 x DcmDsdService:
            DiagSessionControl: DcmDsdSidTabServiceId=16, DcmDsdSidTabSubfuncAvail=true
              3 x DcmDsdSubService:
                Default: DcmDsdSubServiceId=1
                Programming: DcmDsdSubServiceId=2, DcmDsdSubServiceSessionLevelRef=DcmDspSession/Programming, DcmDsdSubServiceSessionLevelRef=DcmDspSession/Extended
                Extended: DcmDsdSubServiceId=3
            EcuReset: DcmDsdSidTabServiceId=17, DcmDsdSidTabSubfuncAvail=true
              Hard (DcmDsdSubService): DcmDsdSubServiceId=1
              Soft (DcmDsdSubService): DcmDsdSubServiceId=3
            ClearDiagInfo: DcmDsdSidTabServiceId=20, DcmDsdSidTabSubfuncAvail=false
            ReadDtcInfo: DcmDsdSidTabServiceId=25, DcmDsdSidTabSubfuncAvail=true
              5 x DcmDsdSubService:
                RDTCBSM: DcmDsdSubServiceId=2
                RNODTCBSM: DcmDsdSubServiceId=1
                RDTCSSBDTC: DcmDsdSubServiceId=4
                RDTCEDRBDN: DcmDsdSubServiceId=6
                RSUPDTC: DcmDsdSubServiceId=10
            ReadDataById: DcmDsdSidTabServiceId=34, DcmDsdSidTabSubfuncAvail=false
            SecurityAccess: DcmDsdSidTabServiceId=39, DcmDsdSidTabSubfuncAvail=true, DcmDsdSidTabSessionLevelRef=DcmDspSession/Programming, DcmDsdSidTabSessionLevelRef=DcmDspSession/Extended
              SeedLevel1_Request (DcmDsdSubService): DcmDsdSubServiceId=1, DcmDsdSubServiceSessionLevelRef=DcmDspSession/Programming, DcmDsdSubServiceSessionLevelRef=DcmDspSession/Extended
              KeyLevel1_Send (DcmDsdSubService): DcmDsdSubServiceId=2, DcmDsdSubServiceSessionLevelRef=DcmDspSession/Programming, DcmDsdSubServiceSessionLevelRef=DcmDspSession/Extended
            CommunicationControl: DcmDsdSidTabServiceId=40, DcmDsdSidTabSubfuncAvail=true, DcmDsdSidTabSessionLevelRef=DcmDspSession/Programming, DcmDsdSidTabSessionLevelRef=DcmDspSession/Extended
              EnableRxAndTx (DcmDsdSubService): DcmDsdSubServiceId=0, DcmDsdSubServiceSessionLevelRef=DcmDspSession/Programming, DcmDsdSubServiceSessionLevelRef=DcmDspSession/Extended
              EnableRxAndDisableTx (DcmDsdSubService): DcmDsdSubServiceId=1, DcmDsdSubServiceSessionLevelRef=DcmDspSession/Programming, DcmDsdSubServiceSessionLevelRef=DcmDspSession/Extended
            WriteDataById: DcmDsdSidTabServiceId=46, DcmDsdSidTabSubfuncAvail=false
            IoControlById: DcmDsdSidTabServiceId=47, DcmDsdSidTabSubfuncAvail=false, DcmDsdSidTabSessionLevelRef=DcmDspSession/Programming, DcmDsdSidTabSessionLevelRef=DcmDspSession/Extended
            RoutineControl: DcmDsdSidTabServiceId=49, DcmDsdSidTabSubfuncAvail=true
            TesterPresent: DcmDsdSidTabServiceId=62, DcmDsdSidTabSubfuncAvail=true
              TesterPresent (DcmDsdSubService): DcmDsdSubServiceId=0
            ControlDtcSetting: DcmDsdSidTabServiceId=133, DcmDsdSidTabSubfuncAvail=true, DcmDsdSidTabSessionLevelRef=DcmDspSession/Programming, DcmDsdSidTabSessionLevelRef=DcmDspSession/Extended
              Enable (DcmDsdSubService): DcmDsdSubServiceId=1, DcmDsdSubServiceSessionLevelRef=DcmDspSession/Programming, DcmDsdSubServiceSessionLevelRef=DcmDspSession/Extended
              Disable (DcmDsdSubService): DcmDsdSubServiceId=2, DcmDsdSubServiceSessionLevelRef=DcmDspSession/Programming, DcmDsdSubServiceSessionLevelRef=DcmDspSession/Extended
      DcmDsp: DcmDspMaxDidToRead=1
        Braking_Brake_Pedal (DcmDspData): DcmDspDataSize=8, DcmDspDataType=UINT8, DcmDspDataInfoRef=DataInfo_Braking_Brake_Pedal
        DataInfo_Braking_Brake_Pedal (DcmDspDataInfo): DcmDspDataFixedLength=true
        Braking_Brake_Pressure (DcmDspData): DcmDspDataSize=8, DcmDspDataType=UINT8, DcmDspDataInfoRef=DataInfo_Braking_Brake_Pressure
        DataInfo_Braking_Brake_Pressure (DcmDspDataInfo): DcmDspDataFixedLength=true
        Braking_Status_Hydraulic_Pump (DcmDspData): DcmDspDataSize=8, DcmDspDataType=UINT8, DcmDspDataInfoRef=DataInfo_Braking_Status_Hydraulic_Pump
        DataInfo_Braking_Status_Hydraulic_Pump (DcmDspDataInfo): DcmDspDataFixedLength=true
        Braking_Valve_Status_FR (DcmDspData): DcmDspDataSize=8, DcmDspDataType=UINT8, DcmDspDataInfoRef=DataInfo_Braking_Valve_Status_FR
        DataInfo_Braking_Valve_Status_FR (DcmDspDataInfo): DcmDspDataFixedLength=true
        Braking_Valve_Status_FL (DcmDspData): DcmDspDataSize=8, DcmDspDataType=UINT8, DcmDspDataInfoRef=DataInfo_Braking_Valve_Status_FL
        DataInfo_Braking_Valve_Status_FL (DcmDspDataInfo): DcmDspDataFixedLength=true
        Braking_Valve_Status_RR (DcmDspData): DcmDspDataSize=8, DcmDspDataType=UINT8, DcmDspDataInfoRef=DataInfo_Braking_Valve_Status_RR
        DataInfo_Braking_Valve_Status_RR (DcmDspDataInfo): DcmDspDataFixedLength=true
        Braking_Valve_Status_RL (DcmDspData): DcmDspDataSize=8, DcmDspDataType=UINT8, DcmDspDataInfoRef=DataInfo_Braking_Valve_Status_RL
        DataInfo_Braking_Valve_Status_RL (DcmDspDataInfo): DcmDspDataFixedLength=true
        Supply_Voltage_ECU_Voltage_ECU (DcmDspData): DcmDspDataSize=8, DcmDspDataType=UINT8, DcmDspDataInfoRef=DataInfo_Supply_Voltage_ECU_Voltage_ECU
        DataInfo_Supply_Voltage_ECU_Voltage_ECU (DcmDspDataInfo): DcmDspDataFixedLength=true
        Wheel_Type_Wheel_type (DcmDspData): DcmDspDataSize=8, DcmDspDataType=UINT8, DcmDspDataInfoRef=DataInfo_Wheel_Type_Wheel_type
        DataInfo_Wheel_Type_Wheel_type (DcmDspDataInfo): DcmDspDataFixedLength=true
        Wheel_Speed_Wheel_Speed_FR (DcmDspData): DcmDspDataSize=8, DcmDspDataType=UINT8, DcmDspDataInfoRef=DataInfo_Wheel_Speed_Wheel_Speed_FR
        DataInfo_Wheel_Speed_Wheel_Speed_FR (DcmDspDataInfo): DcmDspDataFixedLength=true
        Wheel_Speed_Wheel_Speed_FL (DcmDspData): DcmDspDataSize=8, DcmDspDataType=UINT8, DcmDspDataInfoRef=DataInfo_Wheel_Speed_Wheel_Speed_FL
        DataInfo_Wheel_Speed_Wheel_Speed_FL (DcmDspDataInfo): DcmDspDataFixedLength=true
        Wheel_Speed_Wheel_Speed_RR (DcmDspData): DcmDspDataSize=8, DcmDspDataType=UINT8, DcmDspDataInfoRef=DataInfo_Wheel_Speed_Wheel_Speed_RR
        DataInfo_Wheel_Speed_Wheel_Speed_RR (DcmDspDataInfo): DcmDspDataFixedLength=true
        Wheel_Speed_Wheel_Speed_RL (DcmDspData): DcmDspDataSize=8, DcmDspDataType=UINT8, DcmDspDataInfoRef=DataInfo_Wheel_Speed_Wheel_Speed_RL
        DataInfo_Wheel_Speed_Wheel_Speed_RL (DcmDspDataInfo): DcmDspDataFixedLength=true
        Wheel_Speed_Wheel_Voltage_FR (DcmDspData): DcmDspDataSize=8, DcmDspDataType=UINT8, DcmDspDataInfoRef=DataInfo_Wheel_Speed_Wheel_Voltage_FR
        DataInfo_Wheel_Speed_Wheel_Voltage_FR (DcmDspDataInfo): DcmDspDataFixedLength=true
        Wheel_Speed_Wheel_Voltage_FL (DcmDspData): DcmDspDataSize=8, DcmDspDataType=UINT8, DcmDspDataInfoRef=DataInfo_Wheel_Speed_Wheel_Voltage_FL
        DataInfo_Wheel_Speed_Wheel_Voltage_FL (DcmDspDataInfo): DcmDspDataFixedLength=true
        Wheel_Speed_Wheel_Voltage_RR (DcmDspData): DcmDspDataSize=8, DcmDspDataType=UINT8, DcmDspDataInfoRef=DataInfo_Wheel_Speed_Wheel_Voltage_RR
        DataInfo_Wheel_Speed_Wheel_Voltage_RR (DcmDspDataInfo): DcmDspDataFixedLength=true
        Wheel_Speed_Wheel_Voltage_RL (DcmDspData): DcmDspDataSize=8, DcmDspDataType=UINT8, DcmDspDataInfoRef=DataInfo_Wheel_Speed_Wheel_Voltage_RL
        DataInfo_Wheel_Speed_Wheel_Voltage_RL (DcmDspDataInfo): DcmDspDataFixedLength=true
        Wheel_Speed_Direction_of_rotation (DcmDspData): DcmDspDataSize=8, DcmDspDataType=UINT8, DcmDspDataInfoRef=DataInfo_Wheel_Speed_Direction_of_rotation
        DataInfo_Wheel_Speed_Direction_of_rotation (DcmDspDataInfo): DcmDspDataFixedLength=true
        Acceleration_Sensor_Voltage (DcmDspData): DcmDspDataSize=8, DcmDspDataType=UINT8, DcmDspDataInfoRef=DataInfo_Acceleration_Sensor_Voltage
        DataInfo_Acceleration_Sensor_Voltage (DcmDspDataInfo): DcmDspDataFixedLength=true
        Acceleration_Sensor_Acceleration (DcmDspData): DcmDspDataSize=8, DcmDspDataType=UINT8, DcmDspDataInfoRef=DataInfo_Acceleration_Sensor_Acceleration
        DataInfo_Acceleration_Sensor_Acceleration (DcmDspDataInfo): DcmDspDataFixedLength=true
        Hydro_Unit_Valve_Voltage_FR (DcmDspData): DcmDspDataSize=8, DcmDspDataType=UINT8, DcmDspDataInfoRef=DataInfo_Hydro_Unit_Valve_Voltage_FR
        DataInfo_Hydro_Unit_Valve_Voltage_FR (DcmDspDataInfo): DcmDspDataFixedLength=true
        Hydro_Unit_Valve_Voltage_FL (DcmDspData): DcmDspDataSize=8, DcmDspDataType=UINT8, DcmDspDataInfoRef=DataInfo_Hydro_Unit_Valve_Voltage_FL
        DataInfo_Hydro_Unit_Valve_Voltage_FL (DcmDspDataInfo): DcmDspDataFixedLength=true
        Hydro_Unit_Valve_Voltage_RR (DcmDspData): DcmDspDataSize=8, DcmDspDataType=UINT8, DcmDspDataInfoRef=DataInfo_Hydro_Unit_Valve_Voltage_RR
        DataInfo_Hydro_Unit_Valve_Voltage_RR (DcmDspDataInfo): DcmDspDataFixedLength=true
        Hydro_Unit_Valve_Voltage_RL (DcmDspData): DcmDspDataSize=8, DcmDspDataType=UINT8, DcmDspDataInfoRef=DataInfo_Hydro_Unit_Valve_Voltage_RL
        DataInfo_Hydro_Unit_Valve_Voltage_RL (DcmDspDataInfo): DcmDspDataFixedLength=true
        Hydro_Unit_Valve_Status_FR (DcmDspData): DcmDspDataSize=8, DcmDspDataType=UINT8, DcmDspDataInfoRef=DataInfo_Hydro_Unit_Valve_Status_FR
        DataInfo_Hydro_Unit_Valve_Status_FR (DcmDspDataInfo): DcmDspDataFixedLength=true
        Hydro_Unit_Valve_Status_FL (DcmDspData): DcmDspDataSize=8, DcmDspDataType=UINT8, DcmDspDataInfoRef=DataInfo_Hydro_Unit_Valve_Status_FL
        DataInfo_Hydro_Unit_Valve_Status_FL (DcmDspDataInfo): DcmDspDataFixedLength=true
        Hydro_Unit_Valve_Status_RR (DcmDspData): DcmDspDataSize=8, DcmDspDataType=UINT8, DcmDspDataInfoRef=DataInfo_Hydro_Unit_Valve_Status_RR
        DataInfo_Hydro_Unit_Valve_Status_RR (DcmDspDataInfo): DcmDspDataFixedLength=true
        Hydro_Unit_Valve_Status_RL (DcmDspData): DcmDspDataSize=8, DcmDspDataType=UINT8, DcmDspDataInfoRef=DataInfo_Hydro_Unit_Valve_Status_RL
        DataInfo_Hydro_Unit_Valve_Status_RL (DcmDspDataInfo): DcmDspDataFixedLength=true
        Brake_Pedal_Valve_Voltage_FR (DcmDspData): DcmDspDataSize=8, DcmDspDataType=UINT8, DcmDspDataInfoRef=DataInfo_Brake_Pedal_Valve_Voltage_FR
        DataInfo_Brake_Pedal_Valve_Voltage_FR (DcmDspDataInfo): DcmDspDataFixedLength=true
        Brake_Pedal_Valve_Voltage_FL (DcmDspData): DcmDspDataSize=8, DcmDspDataType=UINT8, DcmDspDataInfoRef=DataInfo_Brake_Pedal_Valve_Voltage_FL
        DataInfo_Brake_Pedal_Valve_Voltage_FL (DcmDspDataInfo): DcmDspDataFixedLength=true
        Brake_Pedal_Valve_Voltage_RR (DcmDspData): DcmDspDataSize=8, DcmDspDataType=UINT8, DcmDspDataInfoRef=DataInfo_Brake_Pedal_Valve_Voltage_RR
        DataInfo_Brake_Pedal_Valve_Voltage_RR (DcmDspDataInfo): DcmDspDataFixedLength=true
        Brake_Pedal_Valve_Voltage_RL (DcmDspData): DcmDspDataSize=8, DcmDspDataType=UINT8, DcmDspDataInfoRef=DataInfo_Brake_Pedal_Valve_Voltage_RL
        DataInfo_Brake_Pedal_Valve_Voltage_RL (DcmDspDataInfo): DcmDspDataFixedLength=true
        Brake_Pedal_Valve_Status_FR (DcmDspData): DcmDspDataSize=8, DcmDspDataType=UINT8, DcmDspDataInfoRef=DataInfo_Brake_Pedal_Valve_Status_FR
        DataInfo_Brake_Pedal_Valve_Status_FR (DcmDspDataInfo): DcmDspDataFixedLength=true
        Brake_Pedal_Valve_Status_FL (DcmDspData): DcmDspDataSize=8, DcmDspDataType=UINT8, DcmDspDataInfoRef=DataInfo_Brake_Pedal_Valve_Status_FL
        DataInfo_Brake_Pedal_Valve_Status_FL (DcmDspDataInfo): DcmDspDataFixedLength=true
        Brake_Pedal_Valve_Status_RR (DcmDspData): DcmDspDataSize=8, DcmDspDataType=UINT8, DcmDspDataInfoRef=DataInfo_Brake_Pedal_Valve_Status_RR
        DataInfo_Brake_Pedal_Valve_Status_RR (DcmDspDataInfo): DcmDspDataFixedLength=true
        Brake_Pedal_Valve_Status_RL (DcmDspData): DcmDspDataSize=8, DcmDspDataType=UINT8, DcmDspDataInfoRef=DataInfo_Brake_Pedal_Valve_Status_RL
        DataInfo_Brake_Pedal_Valve_Status_RL (DcmDspDataInfo): DcmDspDataFixedLength=true
        Brake_Pressure_Brake_Pressure (DcmDspData): DcmDspDataSize=8, DcmDspDataType=UINT8, DcmDspDataInfoRef=DataInfo_Brake_Pressure_Brake_Pressure
        DataInfo_Brake_Pressure_Brake_Pressure (DcmDspDataInfo): DcmDspDataFixedLength=true
        Hydraulic_Pump_Hydraulic_Pump_Voltage (DcmDspData): DcmDspDataSize=8, DcmDspDataType=UINT8, DcmDspDataInfoRef=DataInfo_Hydraulic_Pump_Hydraulic_Pump_Voltage
        DataInfo_Hydraulic_Pump_Hydraulic_Pump_Voltage (DcmDspDataInfo): DcmDspDataFixedLength=true
        Hydraulic_Pump_Status_Hydraulic_Pump (DcmDspData): DcmDspDataSize=8, DcmDspDataType=UINT8, DcmDspDataInfoRef=DataInfo_Hydraulic_Pump_Status_Hydraulic_Pump
        DataInfo_Hydraulic_Pump_Status_Hydraulic_Pump (DcmDspDataInfo): DcmDspDataFixedLength=true
        Hydraulic_Pump_Hydraulic_Pump_Performance (DcmDspData): DcmDspDataSize=8, DcmDspDataType=UINT8, DcmDspDataInfoRef=DataInfo_Hydraulic_Pump_Hydraulic_Pump_Performance
        DataInfo_Hydraulic_Pump_Hydraulic_Pump_Performance (DcmDspDataInfo): DcmDspDataFixedLength=true
        Switches_Brake_Switch (DcmDspData): DcmDspDataConditionCheckReadFncUsed=false, DcmDspDataSize=8, DcmDspDataType=UINT8, DcmDspDataInfoRef=DataInfo_Switches_Brake_Switch
        DataInfo_Switches_Brake_Switch (DcmDspDataInfo): DcmDspDataFixedLength=true
        Switches_Parking_Brake_Switch (DcmDspData): DcmDspDataConditionCheckReadFncUsed=false, DcmDspDataSize=8, DcmDspDataType=UINT8, DcmDspDataInfoRef=DataInfo_Switches_Parking_Brake_Switch
        DataInfo_Switches_Parking_Brake_Switch (DcmDspDataInfo): DcmDspDataFixedLength=true
        Switches_Rear_Gear_Switch (DcmDspData): DcmDspDataConditionCheckReadFncUsed=false, DcmDspDataSize=8, DcmDspDataType=UINT8, DcmDspDataInfoRef=DataInfo_Switches_Rear_Gear_Switch
        DataInfo_Switches_Rear_Gear_Switch (DcmDspDataInfo): DcmDspDataFixedLength=true
        Inflation_Pressure_Inflation_Pressure_FR (DcmDspData): DcmDspDataSize=8, DcmDspDataType=UINT8, DcmDspDataInfoRef=DataInfo_Inflation_Pressure_Inflation_Pressure_FR
        DataInfo_Inflation_Pressure_Inflation_Pressure_FR (DcmDspDataInfo): DcmDspDataFixedLength=true
        Inflation_Pressure_Inflation_Pressure_FL (DcmDspData): DcmDspDataSize=8, DcmDspDataType=UINT8, DcmDspDataInfoRef=DataInfo_Inflation_Pressure_Inflation_Pressure_FL
        DataInfo_Inflation_Pressure_Inflation_Pressure_FL (DcmDspDataInfo): DcmDspDataFixedLength=true
        Inflation_Pressure_Inflation_Pressure_RR (DcmDspData): DcmDspDataSize=8, DcmDspDataType=UINT8, DcmDspDataInfoRef=DataInfo_Inflation_Pressure_Inflation_Pressure_RR
        DataInfo_Inflation_Pressure_Inflation_Pressure_RR (DcmDspDataInfo): DcmDspDataFixedLength=true
        Inflation_Pressure_Inflation_Pressure_RL (DcmDspData): DcmDspDataSize=8, DcmDspDataType=UINT8, DcmDspDataInfoRef=DataInfo_Inflation_Pressure_Inflation_Pressure_RL
        DataInfo_Inflation_Pressure_Inflation_Pressure_RL (DcmDspDataInfo): DcmDspDataFixedLength=true
        Service_Information_Remaining_Service_Brake_Fluid_Life (DcmDspData): DcmDspDataSize=8, DcmDspDataType=UINT8, DcmDspDataInfoRef=DataInfo_Service_Information_Remaining_Service_Brake_Fluid_Life
        DataInfo_Service_Information_Remaining_Service_Brake_Fluid_Life (DcmDspDataInfo): DcmDspDataFixedLength=true
        Service_Information_Remaining_Service_Time_Left (DcmDspData): DcmDspDataSize=16, DcmDspDataType=UINT16, DcmDspDataInfoRef=DataInfo_Service_Information_Remaining_Service_Time_Left
        DataInfo_Service_Information_Remaining_Service_Time_Left (DcmDspDataInfo): DcmDspDataFixedLength=true
        Software_Version_SoftwareVersion (DcmDspData): DcmDspDataSize=40, DcmDspDataType=UINT8_N, DcmDspDataInfoRef=DataInfo_Software_Version_SoftwareVersion
        DataInfo_Software_Version_SoftwareVersion (DcmDspDataInfo): DcmDspDataFixedLength=true
        Serial_Number_SerialNumber (DcmDspData): DcmDspDataSize=104, DcmDspDataType=UINT8_N, DcmDspDataInfoRef=DataInfo_Serial_Number_SerialNumber
        DataInfo_Serial_Number_SerialNumber (DcmDspDataInfo): DcmDspDataFixedLength=true
        VIN_VIN (DcmDspData): DcmDspDataSize=136, DcmDspDataType=UINT8_N, DcmDspDataInfoRef=DataInfo_VIN_VIN
        DataInfo_VIN_VIN (DcmDspDataInfo): DcmDspDataFixedLength=true
        Hardware_Part_Number_PartNumber (DcmDspData): DcmDspDataSize=104, DcmDspDataType=UINT8_N, DcmDspDataInfoRef=DataInfo_Hardware_Part_Number_PartNumber
        DataInfo_Hardware_Part_Number_PartNumber (DcmDspDataInfo): DcmDspDataFixedLength=true
        Hardware_Supplier_Identification_HardwareSupplier (DcmDspData): DcmDspDataSize=8, DcmDspDataType=UINT8, DcmDspDataInfoRef=DataInfo_Hardware_Supplier_Identification_HardwareSupplier
        DataInfo_Hardware_Supplier_Identification_HardwareSupplier (DcmDspDataInfo): DcmDspDataFixedLength=true
        Software_Supplier_Identification_SoftwareSupplier (DcmDspData): DcmDspDataSize=8, DcmDspDataType=UINT8, DcmDspDataInfoRef=DataInfo_Software_Supplier_Identification_SoftwareSupplier
        DataInfo_Software_Supplier_Identification_SoftwareSupplier (DcmDspDataInfo): DcmDspDataFixedLength=true
        Fingerprint_Serial_number_of_flash_tool (DcmDspData): DcmDspDataSize=64, DcmDspDataType=UINT8_N, DcmDspDataInfoRef=DataInfo_Fingerprint_Serial_number_of_flash_tool
        DataInfo_Fingerprint_Serial_number_of_flash_tool (DcmDspDataInfo): DcmDspDataFixedLength=true
        Fingerprint_Repair_Shop_Identification (DcmDspData): DcmDspDataSize=8, DcmDspDataType=UINT8, DcmDspDataInfoRef=DataInfo_Fingerprint_Repair_Shop_Identification
        DataInfo_Fingerprint_Repair_Shop_Identification (DcmDspDataInfo): DcmDspDataFixedLength=true
        Fingerprint_Programming_Date (DcmDspData): DcmDspDataSize=64, DcmDspDataType=UINT8_N, DcmDspDataInfoRef=DataInfo_Fingerprint_Programming_Date
        DataInfo_Fingerprint_Programming_Date (DcmDspDataInfo): DcmDspDataFixedLength=true
        19 x DcmDspDid:
          Braking: DcmDspDidIdentifier=256, DcmDspDidInfoRef=DidInfo_Braking
            7 x DcmDspDidSignal:
              Brake_Pedal: DcmDspDidDataPos=0, DcmDspDidDataRef=Braking_Brake_Pedal
              Brake_Pressure: DcmDspDidDataPos=8, DcmDspDidDataRef=Braking_Brake_Pressure
              Status_Hydraulic_Pump: DcmDspDidDataPos=16, DcmDspDidDataRef=Braking_Status_Hydraulic_Pump
              Valve_Status_FR: DcmDspDidDataPos=24, DcmDspDidDataRef=Braking_Valve_Status_FR
              Valve_Status_FL: DcmDspDidDataPos=32, DcmDspDidDataRef=Braking_Valve_Status_FL
              Valve_Status_RR: DcmDspDidDataPos=40, DcmDspDidDataRef=Braking_Valve_Status_RR
              Valve_Status_RL: DcmDspDidDataPos=48, DcmDspDidDataRef=Braking_Valve_Status_RL
          Supply_Voltage_ECU: DcmDspDidIdentifier=263, DcmDspDidInfoRef=DidInfo_Supply_Voltage_ECU
            Voltage_ECU (DcmDspDidSignal): DcmDspDidDataPos=0, DcmDspDidDataRef=Supply_Voltage_ECU_Voltage_ECU
          Wheel_Type: DcmDspDidIdentifier=265, DcmDspDidInfoRef=DidInfo_Wheel_Type
            Wheel_type (DcmDspDidSignal): DcmDspDidDataPos=0, DcmDspDidDataRef=Wheel_Type_Wheel_type
          Wheel_Speed: DcmDspDidIdentifier=266, DcmDspDidInfoRef=DidInfo_Wheel_Speed
            9 x DcmDspDidSignal:
              Wheel_Speed_FR: DcmDspDidDataPos=0, DcmDspDidDataRef=Wheel_Speed_Wheel_Speed_FR
              Wheel_Speed_FL: DcmDspDidDataPos=8, DcmDspDidDataRef=Wheel_Speed_Wheel_Speed_FL
              Wheel_Speed_RR: DcmDspDidDataPos=16, DcmDspDidDataRef=Wheel_Speed_Wheel_Speed_RR
              Wheel_Speed_RL: DcmDspDidDataPos=24, DcmDspDidDataRef=Wheel_Speed_Wheel_Speed_RL
              Wheel_Voltage_FR: DcmDspDidDataPos=32, DcmDspDidDataRef=Wheel_Speed_Wheel_Voltage_FR
              Wheel_Voltage_FL: DcmDspDidDataPos=40, DcmDspDidDataRef=Wheel_Speed_Wheel_Voltage_FL
              Wheel_Voltage_RR: DcmDspDidDataPos=48, DcmDspDidDataRef=Wheel_Speed_Wheel_Voltage_RR
              Wheel_Voltage_RL: DcmDspDidDataPos=56, DcmDspDidDataRef=Wheel_Speed_Wheel_Voltage_RL
              Direction_of_rotation: DcmDspDidDataPos=64, DcmDspDidDataRef=Wheel_Speed_Direction_of_rotation
          Acceleration_Sensor: DcmDspDidIdentifier=267, DcmDspDidInfoRef=DidInfo_Acceleration_Sensor
            Voltage (DcmDspDidSignal): DcmDspDidDataPos=0, DcmDspDidDataRef=Acceleration_Sensor_Voltage
            Acceleration (DcmDspDidSignal): DcmDspDidDataPos=8, DcmDspDidDataRef=Acceleration_Sensor_Acceleration
          Hydro_Unit: DcmDspDidIdentifier=268, DcmDspDidInfoRef=DidInfo_Hydro_Unit
            8 x DcmDspDidSignal:
              Valve_Voltage_FR: DcmDspDidDataPos=0, DcmDspDidDataRef=Hydro_Unit_Valve_Voltage_FR
              Valve_Voltage_FL: DcmDspDidDataPos=8, DcmDspDidDataRef=Hydro_Unit_Valve_Voltage_FL
              Valve_Voltage_RR: DcmDspDidDataPos=16, DcmDspDidDataRef=Hydro_Unit_Valve_Voltage_RR
              Valve_Voltage_RL: DcmDspDidDataPos=24, DcmDspDidDataRef=Hydro_Unit_Valve_Voltage_RL
              Valve_Status_FR: DcmDspDidDataPos=32, DcmDspDidDataRef=Hydro_Unit_Valve_Status_FR
              Valve_Status_FL: DcmDspDidDataPos=40, DcmDspDidDataRef=Hydro_Unit_Valve_Status_FL
              Valve_Status_RR: DcmDspDidDataPos=48, DcmDspDidDataRef=Hydro_Unit_Valve_Status_RR
              Valve_Status_RL: DcmDspDidDataPos=56, DcmDspDidDataRef=Hydro_Unit_Valve_Status_RL
          Brake_Pedal: DcmDspDidIdentifier=269, DcmDspDidInfoRef=DidInfo_Brake_Pedal
            8 x DcmDspDidSignal:
              Valve_Voltage_FR: DcmDspDidDataPos=0, DcmDspDidDataRef=Brake_Pedal_Valve_Voltage_FR
              Valve_Voltage_FL: DcmDspDidDataPos=8, DcmDspDidDataRef=Brake_Pedal_Valve_Voltage_FL
              Valve_Voltage_RR: DcmDspDidDataPos=16, DcmDspDidDataRef=Brake_Pedal_Valve_Voltage_RR
              Valve_Voltage_RL: DcmDspDidDataPos=24, DcmDspDidDataRef=Brake_Pedal_Valve_Voltage_RL
              Valve_Status_FR: DcmDspDidDataPos=32, DcmDspDidDataRef=Brake_Pedal_Valve_Status_FR
              Valve_Status_FL: DcmDspDidDataPos=40, DcmDspDidDataRef=Brake_Pedal_Valve_Status_FL
              Valve_Status_RR: DcmDspDidDataPos=48, DcmDspDidDataRef=Brake_Pedal_Valve_Status_RR
              Valve_Status_RL: DcmDspDidDataPos=56, DcmDspDidDataRef=Brake_Pedal_Valve_Status_RL
          Brake_Pressure: DcmDspDidIdentifier=270, DcmDspDidInfoRef=DidInfo_Brake_Pressure
            Brake_Pressure (DcmDspDidSignal): DcmDspDidDataPos=0, DcmDspDidDataRef=Brake_Pressure_Brake_Pressure
          Hydraulic_Pump: DcmDspDidIdentifier=271, DcmDspDidInfoRef=DidInfo_Hydraulic_Pump
            3 x DcmDspDidSignal:
              Hydraulic_Pump_Voltage: DcmDspDidDataPos=0, DcmDspDidDataRef=Hydraulic_Pump_Hydraulic_Pump_Voltage
              Status_Hydraulic_Pump: DcmDspDidDataPos=8, DcmDspDidDataRef=Hydraulic_Pump_Status_Hydraulic_Pump
              Hydraulic_Pump_Performance: DcmDspDidDataPos=16, DcmDspDidDataRef=Hydraulic_Pump_Hydraulic_Pump_Performance
          Switches: DcmDspDidIdentifier=272, DcmDspDidInfoRef=DidInfo_Switches
            3 x DcmDspDidSignal:
              Brake_Switch: DcmDspDidDataPos=0, DcmDspDidDataRef=Switches_Brake_Switch
              Parking_Brake_Switch: DcmDspDidDataPos=8, DcmDspDidDataRef=Switches_Parking_Brake_Switch
              Rear_Gear_Switch: DcmDspDidDataPos=16, DcmDspDidDataRef=Switches_Rear_Gear_Switch
          Inflation_Pressure: DcmDspDidIdentifier=273, DcmDspDidInfoRef=DidInfo_Inflation_Pressure
            4 x DcmDspDidSignal:
              Inflation_Pressure_FR: DcmDspDidDataPos=0, DcmDspDidDataRef=Inflation_Pressure_Inflation_Pressure_FR
              Inflation_Pressure_FL: DcmDspDidDataPos=8, DcmDspDidDataRef=Inflation_Pressure_Inflation_Pressure_FL
              Inflation_Pressure_RR: DcmDspDidDataPos=16, DcmDspDidDataRef=Inflation_Pressure_Inflation_Pressure_RR
              Inflation_Pressure_RL: DcmDspDidDataPos=24, DcmDspDidDataRef=Inflation_Pressure_Inflation_Pressure_RL
          Service_Information: DcmDspDidIdentifier=274, DcmDspDidInfoRef=DidInfo_Service_Information
            Remaining_Service_Brake_Fluid_Life (DcmDspDidSignal): DcmDspDidDataPos=0, DcmDspDidDataRef=Service_Information_Remaining_Service_Brake_Fluid_Life
            Remaining_Service_Time_Left (DcmDspDidSignal): DcmDspDidDataPos=8, DcmDspDidDataRef=Service_Information_Remaining_Service_Time_Left
          Software_Version: DcmDspDidIdentifier=61833, DcmDspDidInfoRef=DidInfo_Software_Version
            SoftwareVersion (DcmDspDidSignal): DcmDspDidDataPos=0, DcmDspDidDataRef=Software_Version_SoftwareVersion
          Serial_Number: DcmDspDidIdentifier=61836, DcmDspDidInfoRef=DidInfo_Serial_Number
            SerialNumber (DcmDspDidSignal): DcmDspDidDataPos=0, DcmDspDidDataRef=Serial_Number_SerialNumber
          VIN: DcmDspDidIdentifier=61840, DcmDspDidInfoRef=DidInfo_VIN
            VIN (DcmDspDidSignal): DcmDspDidDataPos=0, DcmDspDidDataRef=VIN_VIN
          Hardware_Part_Number: DcmDspDidIdentifier=61841, DcmDspDidInfoRef=DidInfo_Hardware_Part_Number
            PartNumber (DcmDspDidSignal): DcmDspDidDataPos=0, DcmDspDidDataRef=Hardware_Part_Number_PartNumber
          Hardware_Supplier_Identification: DcmDspDidIdentifier=61842, DcmDspDidInfoRef=DidInfo_Hardware_Supplier_Identification
            HardwareSupplier (DcmDspDidSignal): DcmDspDidDataPos=0, DcmDspDidDataRef=Hardware_Supplier_Identification_HardwareSupplier
          Software_Supplier_Identification: DcmDspDidIdentifier=61844, DcmDspDidInfoRef=DidInfo_Software_Supplier_Identification
            SoftwareSupplier (DcmDspDidSignal): DcmDspDidDataPos=0, DcmDspDidDataRef=Software_Supplier_Identification_SoftwareSupplier
          Fingerprint: DcmDspDidIdentifier=61848, DcmDspDidInfoRef=DidInfo_Fingerprint
            3 x DcmDspDidSignal:
              Serial_number_of_flash_tool: DcmDspDidDataPos=0, DcmDspDidDataRef=Fingerprint_Serial_number_of_flash_tool
              Repair_Shop_Identification: DcmDspDidDataPos=64, DcmDspDidDataRef=Fingerprint_Repair_Shop_Identification
              Programming_Date: DcmDspDidDataPos=72, DcmDspDidDataRef=Fingerprint_Programming_Date
        19 x DcmDspDidInfo:
          DidInfo_Braking
            DcmDspDidAccess
              DcmDspDidRead
          DidInfo_Supply_Voltage_ECU
            DcmDspDidAccess
              DcmDspDidRead
          DidInfo_Wheel_Type
            DcmDspDidAccess
              DcmDspDidRead
              DcmDspDidWrite
          DidInfo_Wheel_Speed
            DcmDspDidAccess
              DcmDspDidRead
          DidInfo_Acceleration_Sensor
            DcmDspDidAccess
              DcmDspDidRead
          DidInfo_Hydro_Unit
            DcmDspDidAccess
              DcmDspDidRead
          DidInfo_Brake_Pedal
            DcmDspDidAccess
              DcmDspDidRead
          DidInfo_Brake_Pressure
            DcmDspDidAccess
              DcmDspDidRead
          DidInfo_Hydraulic_Pump
            DcmDspDidAccess
              DcmDspDidRead
          DidInfo_Switches
            DcmDspDidAccess
              DcmDspDidControl:
                DcmDspDidFreezeCurrentState = false
                DcmDspDidResetToDefault = true
                DcmDspDidReturnControlToEcu = false
                DcmDspDidShortTermAdjustment = true
                DcmDspDidControlSessionRef = DcmDspSession/Programming
                DcmDspDidControlSessionRef = DcmDspSession/Extended
              DcmDspDidRead
          DidInfo_Inflation_Pressure
            DcmDspDidAccess
              DcmDspDidRead
          DidInfo_Service_Information
            DcmDspDidAccess
              DcmDspDidRead
              DcmDspDidWrite
          DidInfo_Software_Version
            DcmDspDidAccess
              DcmDspDidRead
              DcmDspDidWrite
          DidInfo_Serial_Number
            DcmDspDidAccess
              DcmDspDidRead
              DcmDspDidWrite
          DidInfo_VIN
            DcmDspDidAccess
              DcmDspDidRead
              DcmDspDidWrite
          DidInfo_Hardware_Part_Number
            DcmDspDidAccess
              DcmDspDidRead
              DcmDspDidWrite
          DidInfo_Hardware_Supplier_Identification
            DcmDspDidAccess
              DcmDspDidRead
              DcmDspDidWrite
          DidInfo_Software_Supplier_Identification
            DcmDspDidAccess
              DcmDspDidRead
              DcmDspDidWrite
          DidInfo_Fingerprint
            DcmDspDidAccess
              DcmDspDidRead
              DcmDspDidWrite
        ECU_Check (DcmDspRoutine):
          DcmDspRequestResultsRoutineSupported = true
          DcmDspStopRoutineSupported = false
          DcmDspRoutineIdentifier = 256
          DcmDspRoutineInfoRef = RoutineInfo_ECU_Check
        RoutineInfo_ECU_Check (DcmDspRoutineInfo)
          DcmDspRoutineAuthorization
          DcmDspStartRoutineIn
            In_Start_ECU_Check (DcmDspStartRoutineInSignal): DcmDspRoutineSignalLength=8, DcmDspRoutineSignalType=UINT8, DcmDspRoutineSignalPos=0
          DcmDspStartRoutineOut
            Out_ECU_Check_is_in_progress (DcmDspStartRoutineOutSignal): DcmDspRoutineSignalLength=8, DcmDspRoutineSignalType=UINT8, DcmDspRoutineSignalPos=0
          DcmDspRoutineRequestResOut
            Out_ECU_Check_status (DcmDspRoutineRequestResOutSignal): DcmDspRoutineSignalLength=8, DcmDspRoutineSignalType=UINT8, DcmDspRoutineSignalPos=0
        DcmDspSecurity
          UnlockedL1 (DcmDspSecurityRow): DcmDspSecurityKeySize=4, DcmDspSecurityLevel=1, DcmDspSecuritySeedSize=4
        DcmDspSession
          3 x DcmDspSessionRow, all with DcmDspSessionP2ServerMax=0.05, DcmDspSessionP2StarServerMax=5:
            Default: DcmDspSessionLevel=1, DcmDspSessionForBoot=DCM_NO_BOOT
            Programming: DcmDspSessionLevel=2
            Extended: DcmDspSessionLevel=3, DcmDspSessionForBoot=DCM_NO_BOOT
        ComControl (DcmDspComControl)
          DspComContolAllChannel (DcmDspComControlAllChannel)
  module config Dem: module-description=Dem_Impl
    DemConfigSet
      DTCClass_DTC_0x401001 (DemDTCClass): DemUdsDTC=4198401
      DTC_0x401001 (DemEventParameter):
        DemEventKind = DEM_EVENT_KIND_SWC
        DemMaxNumberFreezeFrameRecords = 2
        DemDTCClassRef = DTCClass_DTC_0x401001
        DemExtendedDataClassRef = ExtendedDataClass_bc718b7c
        DemFreezeFrameClassRef = FreezeFrameClass_226af9a2
        DemEventClass:
          DemEventDestination = DEM_DTC_ORIGIN_PRIMARY_MEMORY
          DemEventSignificance = DEM_EVENT_SIGNIFICANCE_FAULT
          DemAgingCycleRef = PowerCycle
          DemOperationCycleRef = PowerCycle
          DemDebounceAlgorithmClass
            DemDebounceMonitorInternal
              DemCallbackGetFDC
      DTCClass_DTC_0x401003 (DemDTCClass): DemUdsDTC=4198403
      DTC_0x401003 (DemEventParameter):
        DemEventKind = DEM_EVENT_KIND_SWC
        DemMaxNumberFreezeFrameRecords = 2
        DemDTCClassRef = DTCClass_DTC_0x401003
        DemExtendedDataClassRef = ExtendedDataClass_bc718b7c
        DemFreezeFrameClassRef = FreezeFrameClass_226af9a2
        DemEventClass:
          DemEventDestination = DEM_DTC_ORIGIN_PRIMARY_MEMORY
          DemEventSignificance = DEM_EVENT_SIGNIFICANCE_FAULT
          DemAgingCycleRef = PowerCycle
          DemOperationCycleRef = PowerCycle
          DemDebounceAlgorithmClass
            DemDebounceMonitorInternal
              DemCallbackGetFDC
      DTCClass_DTC_0x402001 (DemDTCClass): DemUdsDTC=4202497
      DTC_0x402001 (DemEventParameter):
        DemEventKind = DEM_EVENT_KIND_SWC
        DemMaxNumberFreezeFrameRecords = 2
        DemDTCClassRef = DTCClass_DTC_0x402001
        DemExtendedDataClassRef = ExtendedDataClass_bc718b7c
        DemFreezeFrameClassRef = FreezeFrameClass_226af9a2
        DemEventClass:
          DemEventDestination = DEM_DTC_ORIGIN_PRIMARY_MEMORY
          DemEventSignificance = DEM_EVENT_SIGNIFICANCE_FAULT
          DemAgingCycleRef = PowerCycle
          DemOperationCycleRef = PowerCycle
          DemDebounceAlgorithmClass
            DemDebounceMonitorInternal
              DemCallbackGetFDC
      DTCClass_DTC_0x402011 (DemDTCClass): DemUdsDTC=4202513
      DTC_0x402011 (DemEventParameter):
        DemEventKind = DEM_EVENT_KIND_SWC
        DemMaxNumberFreezeFrameRecords = 2
        DemDTCClassRef = DTCClass_DTC_0x402011
        DemExtendedDataClassRef = ExtendedDataClass_bc718b7c
        DemFreezeFrameClassRef = FreezeFrameClass_d4213761
        DemEventClass:
          DemEventDestination = DEM_DTC_ORIGIN_PRIMARY_MEMORY
          DemEventSignificance = DEM_EVENT_SIGNIFICANCE_FAULT
          DemAgingCycleRef = PowerCycle
          DemOperationCycleRef = PowerCycle
          DemDebounceAlgorithmClass
            DemDebounceMonitorInternal
              DemCallbackGetFDC
      DTCClass_DTC_0x402012 (DemDTCClass): DemUdsDTC=4202514
      DTC_0x402012 (DemEventParameter):
        DemEventKind = DEM_EVENT_KIND_SWC
        DemMaxNumberFreezeFrameRecords = 2
        DemDTCClassRef = DTCClass_DTC_0x402012
        DemExtendedDataClassRef = ExtendedDataClass_bc718b7c
        DemFreezeFrameClassRef = FreezeFrameClass_d4213761
        DemEventClass:
          DemEventDestination = DEM_DTC_ORIGIN_PRIMARY_MEMORY
          DemEventSignificance = DEM_EVENT_SIGNIFICANCE_FAULT
          DemAgingCycleRef = PowerCycle
          DemOperationCycleRef = PowerCycle
          DemDebounceAlgorithmClass
            DemDebounceMonitorInternal
              DemCallbackGetFDC
      DTCClass_DTC_0x402013 (DemDTCClass): DemUdsDTC=4202515
      DTC_0x402013 (DemEventParameter):
        DemEventKind = DEM_EVENT_KIND_SWC
        DemMaxNumberFreezeFrameRecords = 2
        DemDTCClassRef = DTCClass_DTC_0x402013
        DemExtendedDataClassRef = ExtendedDataClass_bc718b7c
        DemFreezeFrameClassRef = FreezeFrameClass_226af9a2
        DemEventClass:
          DemEventDestination = DEM_DTC_ORIGIN_PRIMARY_MEMORY
          DemEventSignificance = DEM_EVENT_SIGNIFICANCE_FAULT
          DemAgingCycleRef = PowerCycle
          DemOperationCycleRef = PowerCycle
          DemDebounceAlgorithmClass
            DemDebounceMonitorInternal
              DemCallbackGetFDC
      DTCClass_DTC_0x402025 (DemDTCClass): DemUdsDTC=4202533
      DTC_0x402025 (DemEventParameter):
        DemEventKind = DEM_EVENT_KIND_SWC
        DemMaxNumberFreezeFrameRecords = 2
        DemDTCClassRef = DTCClass_DTC_0x402025
        DemExtendedDataClassRef = ExtendedDataClass_bc718b7c
        DemFreezeFrameClassRef = FreezeFrameClass_226af9a2
        DemEventClass:
          DemEventDestination = DEM_DTC_ORIGIN_PRIMARY_MEMORY
          DemEventSignificance = DEM_EVENT_SIGNIFICANCE_FAULT
          DemAgingCycleRef = PowerCycle
          DemOperationCycleRef = PowerCycle
          DemDebounceAlgorithmClass
            DemDebounceMonitorInternal
              DemCallbackGetFDC
      DTCClass_DTC_0x403001 (DemDTCClass): DemUdsDTC=4206593
      DTC_0x403001 (DemEventParameter):
        DemEventKind = DEM_EVENT_KIND_SWC
        DemMaxNumberFreezeFrameRecords = 2
        DemDTCClassRef = DTCClass_DTC_0x403001
        DemExtendedDataClassRef = ExtendedDataClass_bc718b7c
        DemFreezeFrameClassRef = FreezeFrameClass_226af9a2
        DemEventClass:
          DemEventDestination = DEM_DTC_ORIGIN_PRIMARY_MEMORY
          DemEventSignificance = DEM_EVENT_SIGNIFICANCE_FAULT
          DemAgingCycleRef = PowerCycle
          DemOperationCycleRef = PowerCycle
          DemDebounceAlgorithmClass
            DemDebounceMonitorInternal
              DemCallbackGetFDC
      DTCClass_DTC_0x403113 (DemDTCClass): DemUdsDTC=4206867
      DTC_0x403113 (DemEventParameter):
        DemEventKind = DEM_EVENT_KIND_SWC
        DemMaxNumberFreezeFrameRecords = 2
        DemDTCClassRef = DTCClass_DTC_0x403113
        DemExtendedDataClassRef = ExtendedDataClass_bc718b7c
        DemFreezeFrameClassRef = FreezeFrameClass_226af9a2
        DemEventClass:
          DemEventDestination = DEM_DTC_ORIGIN_PRIMARY_MEMORY
          DemEventSignificance = DEM_EVENT_SIGNIFICANCE_FAULT
          DemAgingCycleRef = PowerCycle
          DemOperationCycleRef = PowerCycle
          DemDebounceAlgorithmClass
            DemDebounceMonitorInternal
              DemCallbackGetFDC
      DTCClass_DTC_0x403121 (DemDTCClass): DemUdsDTC=4206881
      DTC_0x403121 (DemEventParameter):
        DemEventKind = DEM_EVENT_KIND_SWC
        DemMaxNumberFreezeFrameRecords = 2
        DemDTCClassRef = DTCClass_DTC_0x403121
        DemExtendedDataClassRef = ExtendedDataClass_bc718b7c
        DemFreezeFrameClassRef = FreezeFrameClass_226af9a2
        DemEventClass:
          DemEventDestination = DEM_DTC_ORIGIN_PRIMARY_MEMORY
          DemEventSignificance = DEM_EVENT_SIGNIFICANCE_FAULT
          DemAgingCycleRef = PowerCycle
          DemOperationCycleRef = PowerCycle
          DemDebounceAlgorithmClass
            DemDebounceMonitorInternal
              DemCallbackGetFDC
      DTCClass_DTC_0x403122 (DemDTCClass): DemUdsDTC=4206882
      DTC_0x403122 (DemEventParameter):
        DemEventKind = DEM_EVENT_KIND_SWC
        DemMaxNumberFreezeFrameRecords = 2
        DemDTCClassRef = DTCClass_DTC_0x403122
        DemExtendedDataClassRef = ExtendedDataClass_bc718b7c
        DemFreezeFrameClassRef = FreezeFrameClass_226af9a2
        DemEventClass:
          DemEventDestination = DEM_DTC_ORIGIN_PRIMARY_MEMORY
          DemEventSignificance = DEM_EVENT_SIGNIFICANCE_FAULT
          DemAgingCycleRef = PowerCycle
          DemOperationCycleRef = PowerCycle
          DemDebounceAlgorithmClass
            DemDebounceMonitorInternal
              DemCallbackGetFDC
      DTCClass_DTC_0x403413 (DemDTCClass): DemUdsDTC=4207635
      DTC_0x403413 (DemEventParameter):
        DemEventKind = DEM_EVENT_KIND_SWC
        DemMaxNumberFreezeFrameRecords = 2
        DemDTCClassRef = DTCClass_DTC_0x403413
        DemExtendedDataClassRef = ExtendedDataClass_bc718b7c
        DemFreezeFrameClassRef = FreezeFrameClass_226af9a2
        DemEventClass:
          DemEventDestination = DEM_DTC_ORIGIN_PRIMARY_MEMORY
          DemEventSignificance = DEM_EVENT_SIGNIFICANCE_FAULT
          DemAgingCycleRef = PowerCycle
          DemOperationCycleRef = PowerCycle
          DemDebounceAlgorithmClass
            DemDebounceMonitorInternal
              DemCallbackGetFDC
      DTCClass_DTC_0x403421 (DemDTCClass): DemUdsDTC=4207649
      DTC_0x403421 (DemEventParameter):
        DemEventKind = DEM_EVENT_KIND_SWC
        DemMaxNumberFreezeFrameRecords = 2
        DemDTCClassRef = DTCClass_DTC_0x403421
        DemExtendedDataClassRef = ExtendedDataClass_bc718b7c
        DemFreezeFrameClassRef = FreezeFrameClass_226af9a2
        DemEventClass:
          DemEventDestination = DEM_DTC_ORIGIN_PRIMARY_MEMORY
          DemEventSignificance = DEM_EVENT_SIGNIFICANCE_FAULT
          DemAgingCycleRef = PowerCycle
          DemOperationCycleRef = PowerCycle
          DemDebounceAlgorithmClass
            DemDebounceMonitorInternal
              DemCallbackGetFDC
      DTCClass_DTC_0x403422 (DemDTCClass): DemUdsDTC=4207650
      DTC_0x403422 (DemEventParameter):
        DemEventKind = DEM_EVENT_KIND_SWC
        DemMaxNumberFreezeFrameRecords = 2
        DemDTCClassRef = DTCClass_DTC_0x403422
        DemExtendedDataClassRef = ExtendedDataClass_bc718b7c
        DemFreezeFrameClassRef = FreezeFrameClass_226af9a2
        DemEventClass:
          DemEventDestination = DEM_DTC_ORIGIN_PRIMARY_MEMORY
          DemEventSignificance = DEM_EVENT_SIGNIFICANCE_FAULT
          DemAgingCycleRef = PowerCycle
          DemOperationCycleRef = PowerCycle
          DemDebounceAlgorithmClass
            DemDebounceMonitorInternal
              DemCallbackGetFDC
      DTCClass_DTC_0x403713 (DemDTCClass): DemUdsDTC=4208403
      DTC_0x403713 (DemEventParameter):
        DemEventKind = DEM_EVENT_KIND_SWC
        DemMaxNumberFreezeFrameRecords = 2
        DemDTCClassRef = DTCClass_DTC_0x403713
        DemExtendedDataClassRef = ExtendedDataClass_bc718b7c
        DemFreezeFrameClassRef = FreezeFrameClass_226af9a2
        DemEventClass:
          DemEventDestination = DEM_DTC_ORIGIN_PRIMARY_MEMORY
          DemEventSignificance = DEM_EVENT_SIGNIFICANCE_FAULT
          DemAgingCycleRef = PowerCycle
          DemOperationCycleRef = PowerCycle
          DemDebounceAlgorithmClass
            DemDebounceMonitorInternal
              DemCallbackGetFDC
      DTCClass_DTC_0x403721 (DemDTCClass): DemUdsDTC=4208417
      DTC_0x403721 (DemEventParameter):
        DemEventKind = DEM_EVENT_KIND_SWC
        DemMaxNumberFreezeFrameRecords = 2
        DemDTCClassRef = DTCClass_DTC_0x403721
        DemExtendedDataClassRef = ExtendedDataClass_bc718b7c
        DemFreezeFrameClassRef = FreezeFrameClass_226af9a2
        DemEventClass:
          DemEventDestination = DEM_DTC_ORIGIN_PRIMARY_MEMORY
          DemEventSignificance = DEM_EVENT_SIGNIFICANCE_FAULT
          DemAgingCycleRef = PowerCycle
          DemOperationCycleRef = PowerCycle
          DemDebounceAlgorithmClass
            DemDebounceMonitorInternal
              DemCallbackGetFDC
      DTCClass_DTC_0x403722 (DemDTCClass): DemUdsDTC=4208418
      DTC_0x403722 (DemEventParameter):
        DemEventKind = DEM_EVENT_KIND_SWC
        DemMaxNumberFreezeFrameRecords = 2
        DemDTCClassRef = DTCClass_DTC_0x403722
        DemExtendedDataClassRef = ExtendedDataClass_bc718b7c
        DemFreezeFrameClassRef = FreezeFrameClass_226af9a2
        DemEventClass:
          DemEventDestination = DEM_DTC_ORIGIN_PRIMARY_MEMORY
          DemEventSignificance = DEM_EVENT_SIGNIFICANCE_FAULT
          DemAgingCycleRef = PowerCycle
          DemOperationCycleRef = PowerCycle
          DemDebounceAlgorithmClass
            DemDebounceMonitorInternal
              DemCallbackGetFDC
      DTCClass_DTC_0x403a13 (DemDTCClass): DemUdsDTC=4209171
      DTC_0x403a13 (DemEventParameter):
        DemEventKind = DEM_EVENT_KIND_SWC
        DemMaxNumberFreezeFrameRecords = 2
        DemDTCClassRef = DTCClass_DTC_0x403a13
        DemExtendedDataClassRef = ExtendedDataClass_bc718b7c
        DemFreezeFrameClassRef = FreezeFrameClass_226af9a2
        DemEventClass:
          DemEventDestination = DEM_DTC_ORIGIN_PRIMARY_MEMORY
          DemEventSignificance = DEM_EVENT_SIGNIFICANCE_FAULT
          DemAgingCycleRef = PowerCycle
          DemOperationCycleRef = PowerCycle
          DemDebounceAlgorithmClass
            DemDebounceMonitorInternal
              DemCallbackGetFDC
      DTCClass_DTC_0x403a21 (DemDTCClass): DemUdsDTC=4209185
      DTC_0x403a21 (DemEventParameter):
        DemEventKind = DEM_EVENT_KIND_SWC
        DemMaxNumberFreezeFrameRecords = 2
        DemDTCClassRef = DTCClass_DTC_0x403a21
        DemExtendedDataClassRef = ExtendedDataClass_bc718b7c
        DemFreezeFrameClassRef = FreezeFrameClass_226af9a2
        DemEventClass:
          DemEventDestination = DEM_DTC_ORIGIN_PRIMARY_MEMORY
          DemEventSignificance = DEM_EVENT_SIGNIFICANCE_FAULT
          DemAgingCycleRef = PowerCycle
          DemOperationCycleRef = PowerCycle
          DemDebounceAlgorithmClass
            DemDebounceMonitorInternal
              DemCallbackGetFDC
      DTCClass_DTC_0x403a22 (DemDTCClass): DemUdsDTC=4209186
      DTC_0x403a22 (DemEventParameter):
        DemEventKind = DEM_EVENT_KIND_SWC
        DemMaxNumberFreezeFrameRecords = 2
        DemDTCClassRef = DTCClass_DTC_0x403a22
        DemExtendedDataClassRef = ExtendedDataClass_bc718b7c
        DemFreezeFrameClassRef = FreezeFrameClass_226af9a2
        DemEventClass:
          DemEventDestination = DEM_DTC_ORIGIN_PRIMARY_MEMORY
          DemEventSignificance = DEM_EVENT_SIGNIFICANCE_FAULT
          DemAgingCycleRef = PowerCycle
          DemOperationCycleRef = PowerCycle
          DemDebounceAlgorithmClass
            DemDebounceMonitorInternal
              DemCallbackGetFDC
      DTCClass_DTC_0x404011 (DemDTCClass): DemUdsDTC=4210705
      DTC_0x404011 (DemEventParameter):
        DemEventKind = DEM_EVENT_KIND_SWC
        DemMaxNumberFreezeFrameRecords = 2
        DemDTCClassRef = DTCClass_DTC_0x404011
        DemExtendedDataClassRef = ExtendedDataClass_bc718b7c
        DemFreezeFrameClassRef = FreezeFrameClass_226af9a2
        DemEventClass:
          DemEventDestination = DEM_DTC_ORIGIN_PRIMARY_MEMORY
          DemEventSignificance = DEM_EVENT_SIGNIFICANCE_FAULT
          DemAgingCycleRef = PowerCycle
          DemOperationCycleRef = PowerCycle
          DemDebounceAlgorithmClass
            DemDebounceMonitorInternal
              DemCallbackGetFDC
      DTCClass_DTC_0x404012 (DemDTCClass): DemUdsDTC=4210706
      DTC_0x404012 (DemEventParameter):
        DemEventKind = DEM_EVENT_KIND_SWC
        DemMaxNumberFreezeFrameRecords = 2
        DemDTCClassRef = DTCClass_DTC_0x404012
        DemExtendedDataClassRef = ExtendedDataClass_bc718b7c
        DemFreezeFrameClassRef = FreezeFrameClass_226af9a2
        DemEventClass:
          DemEventDestination = DEM_DTC_ORIGIN_PRIMARY_MEMORY
          DemEventSignificance = DEM_EVENT_SIGNIFICANCE_FAULT
          DemAgingCycleRef = PowerCycle
          DemOperationCycleRef = PowerCycle
          DemDebounceAlgorithmClass
            DemDebounceMonitorInternal
              DemCallbackGetFDC
      DTCClass_DTC_0x404013 (DemDTCClass): DemUdsDTC=4210707
      DTC_0x404013 (DemEventParameter):
        DemEventKind = DEM_EVENT_KIND_SWC
        DemMaxNumberFreezeFrameRecords = 2
        DemDTCClassRef = DTCClass_DTC_0x404013
        DemExtendedDataClassRef = ExtendedDataClass_bc718b7c
        DemFreezeFrameClassRef = FreezeFrameClass_226af9a2
        DemEventClass:
          DemEventDestination = DEM_DTC_ORIGIN_PRIMARY_MEMORY
          DemEventSignificance = DEM_EVENT_SIGNIFICANCE_FAULT
          DemAgingCycleRef = PowerCycle
          DemOperationCycleRef = PowerCycle
          DemDebounceAlgorithmClass
            DemDebounceMonitorInternal
              DemCallbackGetFDC
      DTCClass_DTC_0x404211 (DemDTCClass): DemUdsDTC=4211217
      DTC_0x404211 (DemEventParameter):
        DemEventKind = DEM_EVENT_KIND_SWC
        DemMaxNumberFreezeFrameRecords = 2
        DemDTCClassRef = DTCClass_DTC_0x404211
        DemExtendedDataClassRef = ExtendedDataClass_bc718b7c
        DemFreezeFrameClassRef = FreezeFrameClass_226af9a2
        DemEventClass:
          DemEventDestination = DEM_DTC_ORIGIN_PRIMARY_MEMORY
          DemEventSignificance = DEM_EVENT_SIGNIFICANCE_FAULT
          DemAgingCycleRef = PowerCycle
          DemOperationCycleRef = PowerCycle
          DemDebounceAlgorithmClass
            DemDebounceMonitorInternal
              DemCallbackGetFDC
      DTCClass_DTC_0x404212 (DemDTCClass): DemUdsDTC=4211218
      DTC_0x404212 (DemEventParameter):
        DemEventKind = DEM_EVENT_KIND_SWC
        DemMaxNumberFreezeFrameRecords = 2
        DemDTCClassRef = DTCClass_DTC_0x404212
        DemExtendedDataClassRef = ExtendedDataClass_bc718b7c
        DemFreezeFrameClassRef = FreezeFrameClass_226af9a2
        DemEventClass:
          DemEventDestination = DEM_DTC_ORIGIN_PRIMARY_MEMORY
          DemEventSignificance = DEM_EVENT_SIGNIFICANCE_FAULT
          DemAgingCycleRef = PowerCycle
          DemOperationCycleRef = PowerCycle
          DemDebounceAlgorithmClass
            DemDebounceMonitorInternal
              DemCallbackGetFDC
      DTCClass_DTC_0x404213 (DemDTCClass): DemUdsDTC=4211219
      DTC_0x404213 (DemEventParameter):
        DemEventKind = DEM_EVENT_KIND_SWC
        DemMaxNumberFreezeFrameRecords = 2
        DemDTCClassRef = DTCClass_DTC_0x404213
        DemExtendedDataClassRef = ExtendedDataClass_bc718b7c
        DemFreezeFrameClassRef = FreezeFrameClass_226af9a2
        DemEventClass:
          DemEventDestination = DEM_DTC_ORIGIN_PRIMARY_MEMORY
          DemEventSignificance = DEM_EVENT_SIGNIFICANCE_FAULT
          DemAgingCycleRef = PowerCycle
          DemOperationCycleRef = PowerCycle
          DemDebounceAlgorithmClass
            DemDebounceMonitorInternal
              DemCallbackGetFDC
      DTCClass_DTC_0x404421 (DemDTCClass): DemUdsDTC=4211745
      DTC_0x404421 (DemEventParameter):
        DemEventKind = DEM_EVENT_KIND_SWC
        DemMaxNumberFreezeFrameRecords = 2
        DemDTCClassRef = DTCClass_DTC_0x404421
        DemExtendedDataClassRef = ExtendedDataClass_bc718b7c
        DemFreezeFrameClassRef = FreezeFrameClass_226af9a2
        DemEventClass:
          DemEventDestination = DEM_DTC_ORIGIN_PRIMARY_MEMORY
          DemEventSignificance = DEM_EVENT_SIGNIFICANCE_FAULT
          DemAgingCycleRef = PowerCycle
          DemOperationCycleRef = PowerCycle
          DemDebounceAlgorithmClass
            DemDebounceMonitorInternal
              DemCallbackGetFDC
      DTCClass_DTC_0x404422 (DemDTCClass): DemUdsDTC=4211746
      DTC_0x404422 (DemEventParameter):
        DemEventKind = DEM_EVENT_KIND_SWC
        DemMaxNumberFreezeFrameRecords = 2
        DemDTCClassRef = DTCClass_DTC_0x404422
        DemExtendedDataClassRef = ExtendedDataClass_bc718b7c
        DemFreezeFrameClassRef = FreezeFrameClass_226af9a2
        DemEventClass:
          DemEventDestination = DEM_DTC_ORIGIN_PRIMARY_MEMORY
          DemEventSignificance = DEM_EVENT_SIGNIFICANCE_FAULT
          DemAgingCycleRef = PowerCycle
          DemOperationCycleRef = PowerCycle
          DemDebounceAlgorithmClass
            DemDebounceMonitorInternal
              DemCallbackGetFDC
      DTCClass_DTC_0x404428 (DemDTCClass): DemUdsDTC=4211752
      DTC_0x404428 (DemEventParameter):
        DemEventKind = DEM_EVENT_KIND_SWC
        DemMaxNumberFreezeFrameRecords = 2
        DemDTCClassRef = DTCClass_DTC_0x404428
        DemExtendedDataClassRef = ExtendedDataClass_bc718b7c
        DemFreezeFrameClassRef = FreezeFrameClass_226af9a2
        DemEventClass:
          DemEventDestination = DEM_DTC_ORIGIN_PRIMARY_MEMORY
          DemEventSignificance = DEM_EVENT_SIGNIFICANCE_FAULT
          DemAgingCycleRef = PowerCycle
          DemOperationCycleRef = PowerCycle
          DemDebounceAlgorithmClass
            DemDebounceMonitorInternal
              DemCallbackGetFDC
      DTCClass_DTC_0x406221 (DemDTCClass): DemUdsDTC=4219425
      DTC_0x406221 (DemEventParameter):
        DemEventKind = DEM_EVENT_KIND_SWC
        DemMaxNumberFreezeFrameRecords = 2
        DemDTCClassRef = DTCClass_DTC_0x406221
        DemExtendedDataClassRef = ExtendedDataClass_bc718b7c
        DemFreezeFrameClassRef = FreezeFrameClass_226af9a2
        DemEventClass:
          DemEventDestination = DEM_DTC_ORIGIN_PRIMARY_MEMORY
          DemEventSignificance = DEM_EVENT_SIGNIFICANCE_FAULT
          DemAgingCycleRef = PowerCycle
          DemOperationCycleRef = PowerCycle
          DemDebounceAlgorithmClass
            DemDebounceMonitorInternal
              DemCallbackGetFDC
      DTCClass_DTC_0x406222 (DemDTCClass): DemUdsDTC=4219426
      DTC_0x406222 (DemEventParameter):
        DemEventKind = DEM_EVENT_KIND_SWC
        DemMaxNumberFreezeFrameRecords = 2
        DemDTCClassRef = DTCClass_DTC_0x406222
        DemExtendedDataClassRef = ExtendedDataClass_bc718b7c
        DemFreezeFrameClassRef = FreezeFrameClass_226af9a2
        DemEventClass:
          DemEventDestination = DEM_DTC_ORIGIN_PRIMARY_MEMORY
          DemEventSignificance = DEM_EVENT_SIGNIFICANCE_FAULT
          DemAgingCycleRef = PowerCycle
          DemOperationCycleRef = PowerCycle
          DemDebounceAlgorithmClass
            DemDebounceMonitorInternal
              DemCallbackGetFDC
      DTCClass_DTC_0x406225 (DemDTCClass): DemUdsDTC=4219429
      DTC_0x406225 (DemEventParameter):
        DemEventKind = DEM_EVENT_KIND_SWC
        DemMaxNumberFreezeFrameRecords = 2
        DemDTCClassRef = DTCClass_DTC_0x406225
        DemExtendedDataClassRef = ExtendedDataClass_bc718b7c
        DemFreezeFrameClassRef = FreezeFrameClass_226af9a2
        DemEventClass:
          DemEventDestination = DEM_DTC_ORIGIN_PRIMARY_MEMORY
          DemEventSignificance = DEM_EVENT_SIGNIFICANCE_FAULT
          DemAgingCycleRef = PowerCycle
          DemOperationCycleRef = PowerCycle
          DemDebounceAlgorithmClass
            DemDebounceMonitorInternal
              DemCallbackGetFDC
      DTCClass_DTC_0x406321 (DemDTCClass): DemUdsDTC=4219681
      DTC_0x406321 (DemEventParameter):
        DemEventKind = DEM_EVENT_KIND_SWC
        DemMaxNumberFreezeFrameRecords = 2
        DemDTCClassRef = DTCClass_DTC_0x406321
        DemExtendedDataClassRef = ExtendedDataClass_bc718b7c
        DemFreezeFrameClassRef = FreezeFrameClass_226af9a2
        DemEventClass:
          DemEventDestination = DEM_DTC_ORIGIN_PRIMARY_MEMORY
          DemEventSignificance = DEM_EVENT_SIGNIFICANCE_FAULT
          DemAgingCycleRef = PowerCycle
          DemOperationCycleRef = PowerCycle
          DemDebounceAlgorithmClass
            DemDebounceMonitorInternal
              DemCallbackGetFDC
      DTCClass_DTC_0x406322 (DemDTCClass): DemUdsDTC=4219682
      DTC_0x406322 (DemEventParameter):
        DemEventKind = DEM_EVENT_KIND_SWC
        DemMaxNumberFreezeFrameRecords = 2
        DemDTCClassRef = DTCClass_DTC_0x406322
        DemExtendedDataClassRef = ExtendedDataClass_bc718b7c
        DemFreezeFrameClassRef = FreezeFrameClass_226af9a2
        DemEventClass:
          DemEventDestination = DEM_DTC_ORIGIN_PRIMARY_MEMORY
          DemEventSignificance = DEM_EVENT_SIGNIFICANCE_FAULT
          DemAgingCycleRef = PowerCycle
          DemOperationCycleRef = PowerCycle
          DemDebounceAlgorithmClass
            DemDebounceMonitorInternal
              DemCallbackGetFDC
      DTCClass_DTC_0x406325 (DemDTCClass): DemUdsDTC=4219685
      DTC_0x406325 (DemEventParameter):
        DemEventKind = DEM_EVENT_KIND_SWC
        DemMaxNumberFreezeFrameRecords = 2
        DemDTCClassRef = DTCClass_DTC_0x406325
        DemExtendedDataClassRef = ExtendedDataClass_bc718b7c
        DemFreezeFrameClassRef = FreezeFrameClass_226af9a2
        DemEventClass:
          DemEventDestination = DEM_DTC_ORIGIN_PRIMARY_MEMORY
          DemEventSignificance = DEM_EVENT_SIGNIFICANCE_FAULT
          DemAgingCycleRef = PowerCycle
          DemOperationCycleRef = PowerCycle
          DemDebounceAlgorithmClass
            DemDebounceMonitorInternal
              DemCallbackGetFDC
    DemGeneral:
      DemAgingCycleCounterProcessing = DEM_PROCESS_AGINGCTR_INTERN
      DemDtcStatusAvailabilityMask = 9
      DemMaxNumberEventEntryMirror = 0
      DemPTOSupport = false
      DemTypeOfFreezeFrameRecordNumeration = DEM_FF_RECNUM_CALCULATED
      3 x DemDidClass:
        Supply_Voltage_ECU: DemDidIdentifier=263, DemDidDataClassRef=DID_0x107_Voltage_ECU
        Wheel_Speed: DemDidIdentifier=266, DemDidDataClassRef=DID_0x10a_Wheel_Speed_FR, DemDidDataClassRef=DID_0x10a_Wheel_Speed_FL, DemDidDataClassRef=DID_0x10a_Wheel_Speed_RR, DemDidDataClassRef=DID_0x10a_Wheel_Speed_RL, DemDidDataClassRef=DID_0x10a_Wheel_Voltage_FR, DemDidDataClassRef=DID_0x10a_Wheel_Voltage_FL, DemDidDataClassRef=DID_0x10a_Wheel_Voltage_RR, DemDidDataClassRef=DID_0x10a_Wheel_Voltage_RL, DemDidDataClassRef=DID_0x10a_Direction_of_rotation
        Brake_Pedal: DemDidIdentifier=269, DemDidDataClassRef=DID_0x10d_Valve_Voltage_FR, DemDidDataClassRef=DID_0x10d_Valve_Voltage_FL, DemDidDataClassRef=DID_0x10d_Valve_Voltage_RR, DemDidDataClassRef=DID_0x10d_Valve_Voltage_RL, DemDidDataClassRef=DID_0x10d_Valve_Status_FR, DemDidDataClassRef=DID_0x10d_Valve_Status_FL, DemDidDataClassRef=DID_0x10d_Valve_Status_RR, DemDidDataClassRef=DID_0x10d_Valve_Status_RL
      ExtendedDataClass_bc718b7c (DemExtendedDataClass):
        DemExtendedDataRecordClassRef = OccurrenceCounter
        DemExtendedDataRecordClassRef = DTCAgingCounter
        DemExtendedDataRecordClassRef = UncompletedTestCounters
      3 x DemExtendedDataRecordClass:
        OccurrenceCounter: DemExtendedDataRecordNumber=10, DemDataClassRef=OccurrenceCounter_Driving_Cycles_Since_Test_Failed
        DTCAgingCounter: DemExtendedDataRecordNumber=11, DemDataClassRef=DTCAgingCounter_Driving_Cycles_Since_Last_Failed
        UncompletedTestCounters: DemExtendedDataRecordNumber=12, DemDataClassRef=UncompletedTestCounters_Driving_Cycles_Since_Last_Completed
      FreezeFrameClass_226af9a2 (DemFreezeFrameClass): DemDidClassRef=DemGeneral/Wheel_Speed, DemDidClassRef=DemGeneral/Brake_Pedal
      FreezeFrameClass_d4213761 (DemFreezeFrameClass): DemDidClassRef=DemGeneral/Wheel_Speed, DemDidClassRef=DemGeneral/Brake_Pedal, DemDidClassRef=DemGeneral/Supply_Voltage_ECU
      PowerCycle (DemOperationCycle): DemOperationCycleType=DEM_OPCYC_POWER
      21 x DemDataClass, all with DemDataElementDataSize=1, DemDataElementDataType=UINT8, DemDataElementUsePort=USE_DATA_CLIENT_SERVER_PORT, DemDataElementStoreNonVolatile=true:
        DID_0x10a_Direction_of_rotation
        UncompletedTestCounters_Driving_Cycles_Since_Last_Completed
        DTCAgingCounter_Driving_Cycles_Since_Last_Failed
        OccurrenceCounter_Driving_Cycles_Since_Test_Failed
        DID_0x10d_Valve_Status_FL
        DID_0x10d_Valve_Status_FR
        DID_0x10d_Valve_Status_RL
        DID_0x10d_Valve_Status_RR
        DID_0x10d_Valve_Voltage_FL
        DID_0x10d_Valve_Voltage_FR
        DID_0x10d_Valve_Voltage_RL
        DID_0x10d_Valve_Voltage_RR
        DID_0x107_Voltage_ECU
        DID_0x10a_Wheel_Speed_FL
        DID_0x10a_Wheel_Speed_FR
        DID_0x10a_Wheel_Speed_RL
        DID_0x10a_Wheel_Speed_RR
        DID_0x10a_Wheel_Voltage_FL
        DID_0x10a_Wheel_Voltage_FR
        DID_0x10a_Wheel_Voltage_RL
        DID_0x10a_Wheel_Voltage_RR
