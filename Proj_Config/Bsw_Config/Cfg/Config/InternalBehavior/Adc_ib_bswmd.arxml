AUTOSAR XML (schema 00046)
package /AURIX/Adc_ib_bswmd/BswModuleDescriptions
  bsw module description Adc
    bsw internal behavior AdcBehavior
      12 x exclusive area:
        StartGroup
        StopGroup
        ReadGroup
        EnableHwTrig
        DisableHwTrig
        GetGrpStatus
        GetStreamLastPtr
        PopQueue
        PushQueue
        ScheduleNext
        ScheduleStart
        ScheduleStop
