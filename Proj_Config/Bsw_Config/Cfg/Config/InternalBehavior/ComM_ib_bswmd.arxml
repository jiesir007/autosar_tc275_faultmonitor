AUTOSAR XML (schema 00046)
package /MICROSAR
  bsw implementation ComM_Impl: programming-language=C, sw-version=11.00.00, used-code-generator=DaVinci Configurator, vendor-id=30, ar-release-version=4.00.03
package /MICROSAR/ComM_ib_bswmd/BswModuleDescriptions
  bsw module description ComM: provided-entrys=[ComM_MainFunction_0, ComM_MainFunction_1]
    bsw internal behavior ComMBehavior
      exclusive area COMM_EXCLUSIVE_AREA_0
      exclusive area COMM_EXCLUSIVE_AREA_1
      bsw schedulable entity ComM_MainFunction_0: implemented-entry=ComM_MainFunction_0
      bsw schedulable entity ComM_MainFunction_1: implemented-entry=ComM_MainFunction_1
      bsw timing event ComM_MainFunction_0TimingEvent0: starts-on-event=ComM_MainFunction_0, period=0.005
      bsw timing event ComM_MainFunction_1TimingEvent0: starts-on-event=ComM_MainFunction_1, period=0.005
  bsw module entry ComM_MainFunction_0: call-type=SCHEDULED, execution-context=TASK
  bsw module entry ComM_MainFunction_1: call-type=SCHEDULED, execution-context=TASK
