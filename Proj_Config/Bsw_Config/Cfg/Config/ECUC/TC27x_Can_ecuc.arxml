AUTOSAR XML (schema 00046)
package /ActiveEcuC
  module config Can: implementation-config-variant=VARIANT-PRE-COMPILE, module-description=Can_Impl
    CanConfigSet
      8 x CanHardwareObject, all with CanIdType=STANDARD, CanHwProcessing=false, CanMaxDataLen=8, CanFdPaddingValue=0, CanObjectMultiplexedTransmission=false, CanObjectHwFifo=false, CanControllerRef=CT_DBCNetWork_e3f9218e:
        CN_DBCNetWork_b9b38c08_Rx_Meg_FunDiag: CanHandleType=FULL, CanIdValue=2015, CanObjectType=RECEIVE, CanObjectId=3, CanObjectHwSize=1, CanObjectHwHandle=8
        CN_DBCNetWork_b9b38c08_Rx_SupD_Led_Control: CanHandleType=FULL, CanIdValue=768, CanObjectId=8, CanObjectType=RECEIVE, CanObjectHwSize=1, CanObjectHwHandle=13
        CN_DBCNetWork_b9b38c08_Rx_SupD_Led_CtrlMode: CanHandleType=FULL, CanIdValue=772, CanObjectId=5, CanObjectType=RECEIVE, CanObjectHwSize=1, CanObjectHwHandle=10
        CN_DBCNetWork_88abbb7f_Rx: CanHandleType=BASIC, CanIdValue=1536, CanObjectType=RECEIVE, CanObjectId=9, CanObjectHwSize=2, CanObjectHwHandle=14, CanFilterMaskRef=CT_DBCNetWork_e3f9218e/CanFilterMask
        CN_DBCNetWork_b9b38c08_Rx_SupC_Function_1: CanHandleType=FULL, CanIdValue=770, CanObjectId=6, CanObjectType=RECEIVE, CanObjectHwSize=1, CanObjectHwHandle=11
        CN_DBCNetWork_b9b38c08_Rx_SupD_Button_Control: CanHandleType=FULL, CanIdValue=769, CanObjectId=7, CanObjectType=RECEIVE, CanObjectHwSize=1, CanObjectHwHandle=12
        CN_DBCNetWork_b9b38c08_Rx_Meg_PhyDiag: CanHandleType=FULL, CanIdValue=1793, CanObjectId=4, CanObjectType=RECEIVE, CanObjectHwSize=1, CanObjectHwHandle=9
        CN_DBCNetWork_05d62413_Tx: CanHandleType=BASIC, CanIdValue=0, CanObjectType=TRANSMIT, CanObjectId=2, CanObjectHwSize=1, CanObjectHwHandle=7
      CT_DBCNetWork_e3f9218e (CanController):
        CanControllerActivation = true
        CanBusoffProcessing = INTERRUPT
        CanControllerBaseAddress = 4026630912
        CanControllerId = 1
        CanRxProcessing = INTERRUPT
        CanTxProcessing = INTERRUPT
        CanWakeupProcessing = INTERRUPT
        CanWakeupSupport = false
        CanWakeupSourceId = 0
        CanPhysicalNode = Node1
        CanIOPort = b_001
        CanInterruptPriority = 10
        CanSRC = 1
        CanChannelCanObjectStartIndex = 7
        CanNumberOfCANObj = 9
        CanSrcTos = CPU0
        CanInterruptGroupPriority = 0
        CanClockFrequency = 80000000
        CanControllerDefaultBaudrate = CT_DBCNetWork_e3f9218e/CanControllerBaudrateConfig
        CanControllerSystemRef = CT_DBCNetWork
        CanWakeupSourceRef = CN_DBCNetWork_05d62413
        CanCpuClockRef = McuClockReferencePoint
        CanControllerBaudrateConfig:
          CanControllerBaudRate = 500
          CanControllerBaudRateConfigID = 0
          CanControllerPropSeg = 11
          CanControllerSeg1 = 4
          CanControllerSeg2 = 4
          CanControllerSyncJumpWidth = 1
          CanBaudrateClock = 80000
          CanBaudratePrescaler = 8
          CanBaudrateDiv8 = false
        CanFilterMask: CanFilterMaskValue=1920, CanFilterCodeValue=1536, IsLocked=false
      CN_DBCNetWork_INTER1_9768a826_Tx (CanHardwareObject):
        CanHandleType = BASIC
        CanIdValue = 0
        CanObjectType = TRANSMIT
        CanIdType = STANDARD
        CanObjectId = 0
        CanHwProcessing = false
        CanObjectHwSize = 1
        CanObjectHwHandle = 0
        CanMaxDataLen = 8
        CanFdPaddingValue = 0
        CanObjectMultiplexedTransmission = false
        CanObjectHwFifo = false
        CanControllerRef = CT_DBCNetWork_INTER1_f93f8858
      CT_DBCNetWork_INTER1_f93f8858 (CanController):
        CanControllerActivation = true
        CanBusoffProcessing = INTERRUPT
        CanControllerBaseAddress = 4026630656
        CanControllerId = 0
        CanRxProcessing = INTERRUPT
        CanTxProcessing = INTERRUPT
        CanWakeupProcessing = INTERRUPT
        CanWakeupSupport = false
        CanWakeupSourceId = 0
        CanPhysicalNode = Node0
        CanIOPort = b_001
        CanInterruptPriority = 10
        CanSRC = 0
        CanChannelCanObjectStartIndex = 0
        CanNumberOfCANObj = 7
        CanSrcTos = CPU0
        CanInterruptGroupPriority = 0
        CanClockFrequency = 80000000
        CanControllerDefaultBaudrate = CT_DBCNetWork_INTER1_f93f8858/CanControllerBaudrateConfig
        CanControllerSystemRef = CT_DBCNetWork_INTER1
        CanWakeupSourceRef = CN_DBCNetWork_INTER1_9768a826
        CanCpuClockRef = McuClockReferencePoint
        CanControllerBaudrateConfig:
          CanControllerBaudRate = 500
          CanControllerBaudRateConfigID = 0
          CanControllerPropSeg = 11
          CanControllerSeg1 = 4
          CanControllerSeg2 = 4
          CanControllerSyncJumpWidth = 1
          CanBaudrateClock = 80000
          CanBaudratePrescaler = 8
          CanBaudrateDiv8 = false
        CanFilterMask: CanFilterMaskValue=0, CanFilterCodeValue=0, IsLocked=false
      CN_DBCNetWork_INTER1_c87d2dc2_Rx (CanHardwareObject):
        CanHandleType = BASIC
        CanIdType = STANDARD
        CanIdValue = 0
        CanObjectType = RECEIVE
        CanObjectId = 1
        CanHwProcessing = false
        CanObjectHwSize = 2
        CanObjectHwHandle = 1
        CanMaxDataLen = 8
        CanFdPaddingValue = 0
        CanObjectMultiplexedTransmission = false
        CanObjectHwFifo = false
        CanControllerRef = CT_DBCNetWork_INTER1_f93f8858
        CanFilterMaskRef = CT_DBCNetWork_INTER1_f93f8858/CanFilterMask
    CanGeneral:
      CanIndex = 0
      CanChangeBaudrateApi = false
      CanDevErrorDetection = true
      CanHardwareCancellation = false
      CanIdenticalIdCancellation = false
      CanMainFunctionBusoffPeriod = 0.005
      CanMainFunctionModePeriod = 0.005
      CanMainFunctionWakeupPeriod = 0.005
      CanMultiplexedTransmission = false
      CanSetBaudrateApi = false
      CanTimeoutDuration = 0.01
      CanVersionInfoApi = false
      CanGenericPrecopy = false
      CanHardwareLoopCheck = true
      CanRxFullCANSupport = true
      CanTxFullCANSupport = false
      CanRxBasicCANSupport = true
      CanUseNestedCANInterrupts = false
      CanHardwareCancelByAppl = false
      CanIndividualProcessing = false
      CanGenericConfirmation = false
      CanGenericConfirmationAPI2 = false
      CanRxQueue = false
      CanSupportMixedID = false
      CanRxQueueSize = 10
      CanMultipleBasicCANObjects = false
      CanMultipleBasicCANTxObjects = false
      CanHardwareHandleType = UINT8
      CanOptimizeOneController = false
      CanInterruptCategory = CATEGORY2
      CanGetStatus = false
      CanInterruptLock = DRIVER
      CanWakeupSupport = false
      CanRamCheck = None
      CanOverrunNotification = DET
      CanReinitStart = false
      CanGenericPreTransmit = false
      CanFdSupport = NONE
      CanRuntimeMeasurementSupport = false
      CanMaxRxDataLen = 8
      CanMaxTxDataLen = 8
      CanUsePeripheralAccessApi = false
      CanEnableMultipleCanDriver = false
      CanMaxNumberOfHwCANChannels = 4
      CanMaxNumberOfHwCANChannelsR = 0
      CanMaxNumberOfHwCANObj = 256
      CanMaxNumberOfHwCANObjR = 0
      CanClockDividerMode = NORMAL
      CanClockDivider = 1
      CanBaseAddress = 4026630144
      CanBaseAddressR = 0
      CanSrcAddress = 4026763520
      CanSrcAddressR = 0
      CanClockSourceSelection = Fclc
      CanFreezeDisable = false
      CanMirrorModeSupport = false
      CanUseOsInterruptControl = true
      CanRxHwFiFoFullNotification = false
      CanFdIsoSupport = false
      CanFdNiso = false
      CanFdPed = false
      CanSafeBswChecks = false
      CanSilentModeSupport = false
      CanHwTxFifoSupport = false
      CanCheckWakeupCanRetType = false
      CanFdHardwareBufferOptimization = false
      CanCounterRef = SystemTimer_Core0
      CanMainFunctionRWPeriods: CanMainFunctionReadPeriod=0.01, CanMainFunctionWritePeriod=0.01
