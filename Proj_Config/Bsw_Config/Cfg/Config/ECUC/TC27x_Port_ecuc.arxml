AUTOSAR XML (schema 00046)
package /Port
  module config Port: implementation-config-variant=VARIANT-POST-BUILD-LOADABLE, module-description=Port_Impl
    PortConfigSet_0 (PortConfigSet)
      14 x PortContainer:
        PortContainer_0: PortNumber=0, PortNumberOfPortPins=13
          13 x PortPin, all with PortPinAnalogInput=DISABLE, PortPinControllerSelect=DISABLE, PortPinDirectionChangeable=false, PortPinDriverStrength=PORT_CMOS_SPEED_GRADE1, PortPinInitialMode=PORT_PIN_MODE_GPIO, PortPinInputHysteresis=false, PortPinLevelValue=PORT_PIN_LEVEL_LOW, PortPinMode=PORT_PIN_MODE_ALL, PortPinModeChangeable=false, PortPinPadLevel=PORT_PDR_CMOS_AUTOMOTIVE_LEVEL:
            PortPin_0: PortPinDirection=PORT_PIN_IN, PortPinId=0, PortPinInputCharacteristic=PORT_PIN_IN_PULL_UP, PortPinSymbolicName=PORT_0_PIN_0
            PortPin_1: PortPinDirection=PORT_PIN_IN, PortPinId=1, PortPinInputCharacteristic=PORT_PIN_IN_PULL_UP, PortPinSymbolicName=PORT_0_PIN_1
            PortPin_{10..12}: PortPinDirection=PORT_PIN_IN, PortPinId={10..12}, PortPinInputCharacteristic=PORT_PIN_IN_PULL_UP, PortPinSymbolicName=PORT_0_PIN_{10..12}
            PortPin_{2..4}: PortPinDirection=PORT_PIN_IN, PortPinId={2..4}, PortPinInputCharacteristic=PORT_PIN_IN_PULL_UP, PortPinSymbolicName=PORT_0_PIN_{2..4}
            PortPin_5: PortPinDirection=PORT_PIN_OUT, PortPinId=5, PortPinOutputCharacteristic=PORT_PIN_OUT_PUSHPULL, PortPinSymbolicName=PORT_0_PIN_5
            PortPin_6: PortPinDirection=PORT_PIN_OUT, PortPinId=6, PortPinOutputCharacteristic=PORT_PIN_OUT_PUSHPULL, PortPinSymbolicName=PORT_0_PIN_6
            PortPin_{7..9}: PortPinDirection=PORT_PIN_IN, PortPinId={7..9}, PortPinInputCharacteristic=PORT_PIN_IN_PULL_UP, PortPinSymbolicName=PORT_0_PIN_{7..9}
        PortContainer_1: PortNumber=2, PortNumberOfPortPins=9
          9 x PortPin, all with PortPinAnalogInput=DISABLE, PortPinControllerSelect=DISABLE, PortPinDirection=PORT_PIN_IN, PortPinDirectionChangeable=false, PortPinDriverStrength=PORT_CMOS_SPEED_GRADE1, PortPinInitialMode=PORT_PIN_MODE_GPIO, PortPinInputCharacteristic=PORT_PIN_IN_PULL_UP, PortPinInputHysteresis=false, PortPinLevelValue=PORT_PIN_LEVEL_LOW, PortPinMode=PORT_PIN_MODE_ALL, PortPinModeChangeable=false, PortPinPadLevel=PORT_PDR_CMOS_AUTOMOTIVE_LEVEL:
            PortPin_0: PortPinId=32, PortPinSymbolicName=PORT_2_PIN_0
            PortPin_1: PortPinId=33, PortPinSymbolicName=PORT_2_PIN_1
            PortPin_2: PortPinId=34, PortPinSymbolicName=PORT_2_PIN_2
            PortPin_3: PortPinId=35, PortPinSymbolicName=PORT_2_PIN_3
            PortPin_4: PortPinId=36, PortPinSymbolicName=PORT_2_PIN_4
            PortPin_5: PortPinId=37, PortPinSymbolicName=PORT_2_PIN_5
            PortPin_6: PortPinId=38, PortPinSymbolicName=PORT_2_PIN_6
            PortPin_7: PortPinId=39, PortPinSymbolicName=PORT_2_PIN_7
            PortPin_8: PortPinId=40, PortPinSymbolicName=PORT_2_PIN_8
        PortContainer_10: PortNumber=23, PortNumberOfPortPins=6
          6 x PortPin, all with PortPinAnalogInput=DISABLE, PortPinControllerSelect=DISABLE, PortPinDirection=PORT_PIN_IN, PortPinDirectionChangeable=false, PortPinDriverStrength=PORT_CMOS_SPEED_GRADE1, PortPinInitialMode=PORT_PIN_MODE_GPIO, PortPinInputCharacteristic=PORT_PIN_IN_PULL_UP, PortPinInputHysteresis=false, PortPinLevelValue=PORT_PIN_LEVEL_LOW, PortPinMode=PORT_PIN_MODE_ALL, PortPinModeChangeable=false, PortPinPadLevel=PORT_PDR_CMOS_AUTOMOTIVE_LEVEL:
            PortPin_0: PortPinId=368, PortPinSymbolicName=PORT_23_PIN_0
            PortPin_1: PortPinId=369, PortPinSymbolicName=PORT_23_PIN_1
            PortPin_2: PortPinId=370, PortPinSymbolicName=PORT_23_PIN_2
            PortPin_3: PortPinId=371, PortPinSymbolicName=PORT_23_PIN_3
            PortPin_4: PortPinId=372, PortPinSymbolicName=PORT_23_PIN_4
            PortPin_5: PortPinId=373, PortPinSymbolicName=PORT_23_PIN_5
        PortContainer_11: PortNumber=32, PortNumberOfPortPins=4
          4 x PortPin, all with PortPinAnalogInput=DISABLE, PortPinControllerSelect=DISABLE, PortPinDirection=PORT_PIN_IN, PortPinDirectionChangeable=false, PortPinDriverStrength=PORT_CMOS_SPEED_GRADE1, PortPinInitialMode=PORT_PIN_MODE_GPIO, PortPinInputCharacteristic=PORT_PIN_IN_PULL_UP, PortPinInputHysteresis=false, PortPinLevelValue=PORT_PIN_LEVEL_LOW, PortPinMode=PORT_PIN_MODE_ALL, PortPinModeChangeable=false, PortPinPadLevel=PORT_PDR_CMOS_AUTOMOTIVE_LEVEL:
            PortPin_0: PortPinId=512, PortPinSymbolicName=PORT_32_PIN_0
            PortPin_1: PortPinId=514, PortPinSymbolicName=PORT_32_PIN_2
            PortPin_2: PortPinId=515, PortPinSymbolicName=PORT_32_PIN_3
            PortPin_3: PortPinId=516, PortPinSymbolicName=PORT_32_PIN_4
        PortContainer_12: PortNumber=33, PortNumberOfPortPins=14
          14 x PortPin, all with PortPinAnalogInput=DISABLE, PortPinControllerSelect=DISABLE, PortPinDirection=PORT_PIN_IN, PortPinDirectionChangeable=false, PortPinDriverStrength=PORT_CMOS_SPEED_GRADE1, PortPinInitialMode=PORT_PIN_MODE_GPIO, PortPinInputHysteresis=false, PortPinLevelValue=PORT_PIN_LEVEL_LOW, PortPinMode=PORT_PIN_MODE_ALL, PortPinModeChangeable=false, PortPinPadLevel=PORT_PDR_CMOS_AUTOMOTIVE_LEVEL:
            PortPin_0: PortPinId=528, PortPinInputCharacteristic=PORT_PIN_IN_PULL_DOWN, PortPinSymbolicName=PORT_33_PIN_0
            PortPin_1: PortPinId=529, PortPinInputCharacteristic=PORT_PIN_IN_PULL_UP, PortPinSymbolicName=PORT_33_PIN_1
            PortPin_10: PortPinId=538, PortPinInputCharacteristic=PORT_PIN_IN_PULL_UP, PortPinSymbolicName=PORT_33_PIN_10
            PortPin_11: PortPinId=539, PortPinInputCharacteristic=PORT_PIN_IN_PULL_UP, PortPinSymbolicName=PORT_33_PIN_11
            PortPin_12: PortPinId=540, PortPinInputCharacteristic=PORT_PIN_IN_PULL_UP, PortPinSymbolicName=PORT_33_PIN_12
            PortPin_13: PortPinId=541, PortPinInputCharacteristic=PORT_PIN_IN_PULL_UP, PortPinSymbolicName=PORT_33_PIN_13
            PortPin_2: PortPinId=530, PortPinInputCharacteristic=PORT_PIN_IN_PULL_UP, PortPinSymbolicName=PORT_33_PIN_2
            PortPin_3: PortPinId=531, PortPinInputCharacteristic=PORT_PIN_IN_PULL_UP, PortPinSymbolicName=PORT_33_PIN_3
            PortPin_4: PortPinId=532, PortPinInputCharacteristic=PORT_PIN_IN_PULL_UP, PortPinSymbolicName=PORT_33_PIN_4
            PortPin_5: PortPinId=533, PortPinInputCharacteristic=PORT_PIN_IN_PULL_UP, PortPinSymbolicName=PORT_33_PIN_5
            PortPin_6: PortPinId=534, PortPinInputCharacteristic=PORT_PIN_IN_PULL_UP, PortPinSymbolicName=PORT_33_PIN_6
            PortPin_7: PortPinId=535, PortPinInputCharacteristic=PORT_PIN_IN_PULL_UP, PortPinSymbolicName=PORT_33_PIN_7
            PortPin_8: PortPinId=536, PortPinInputCharacteristic=PORT_PIN_IN_PULL_UP, PortPinSymbolicName=PORT_33_PIN_8
            PortPin_9: PortPinId=537, PortPinInputCharacteristic=PORT_PIN_IN_PULL_UP, PortPinSymbolicName=PORT_33_PIN_9
        PortContainer_13: PortNumber=40, PortNumberOfPortPins=10
          10 x PortPin, all with PortPinAnalogInput=DISABLE, PortPinControllerSelect=DISABLE, PortPinDirection=PORT_PIN_IN, PortPinDirectionChangeable=false, PortPinDriverStrength=PORT_CMOS_SPEED_GRADE1, PortPinInitialMode=PORT_PIN_MODE_GPIO, PortPinInputCharacteristic=PORT_PIN_IN_PULL_UP, PortPinInputHysteresis=true, PortPinLevelValue=PORT_PIN_LEVEL_LOW, PortPinModeChangeable=false, PortPinPadLevel=PORT_PDR_CMOS_AUTOMOTIVE_LEVEL:
            PortPin_0: PortPinId=640, PortPinSymbolicName=PORT_40_PIN_0
            PortPin_1: PortPinId=641, PortPinSymbolicName=PORT_40_PIN_1
            PortPin_2: PortPinId=642, PortPinSymbolicName=PORT_40_PIN_2
            PortPin_3: PortPinId=643, PortPinSymbolicName=PORT_40_PIN_3
            PortPin_4: PortPinId=644, PortPinSymbolicName=PORT_40_PIN_4
            PortPin_5: PortPinId=645, PortPinSymbolicName=PORT_40_PIN_5
            PortPin_6: PortPinId=646, PortPinSymbolicName=PORT_40_PIN_6
            PortPin_7: PortPinId=647, PortPinSymbolicName=PORT_40_PIN_7
            PortPin_8: PortPinId=648, PortPinSymbolicName=PORT_40_PIN_8
            PortPin_9: PortPinId=649, PortPinSymbolicName=PORT_40_PIN_9
        PortContainer_2: PortNumber=10, PortNumberOfPortPins=9
          9 x PortPin, all with PortPinAnalogInput=DISABLE, PortPinControllerSelect=DISABLE, PortPinDirection=PORT_PIN_IN, PortPinDirectionChangeable=false, PortPinDriverStrength=PORT_CMOS_SPEED_GRADE1, PortPinInitialMode=PORT_PIN_MODE_GPIO, PortPinInputCharacteristic=PORT_PIN_IN_PULL_UP, PortPinInputHysteresis=false, PortPinLevelValue=PORT_PIN_LEVEL_LOW, PortPinMode=PORT_PIN_MODE_ALL, PortPinModeChangeable=false, PortPinPadLevel=PORT_PDR_CMOS_AUTOMOTIVE_LEVEL:
            PortPin_0: PortPinId=160, PortPinSymbolicName=PORT_10_PIN_0
            PortPin_1: PortPinId=161, PortPinSymbolicName=PORT_10_PIN_1
            PortPin_2: PortPinId=162, PortPinSymbolicName=PORT_10_PIN_2
            PortPin_3: PortPinId=163, PortPinSymbolicName=PORT_10_PIN_3
            PortPin_4: PortPinId=164, PortPinSymbolicName=PORT_10_PIN_4
            PortPin_5: PortPinId=165, PortPinSymbolicName=PORT_10_PIN_5
            PortPin_6: PortPinId=166, PortPinSymbolicName=PORT_10_PIN_6
            PortPin_7: PortPinId=167, PortPinSymbolicName=PORT_10_PIN_7
            PortPin_8: PortPinId=168, PortPinSymbolicName=PORT_10_PIN_8
        PortContainer_3: PortNumber=11, PortNumberOfPortPins=7
          7 x PortPin, all with PortPinAnalogInput=DISABLE, PortPinControllerSelect=DISABLE, PortPinDirection=PORT_PIN_IN, PortPinDirectionChangeable=false, PortPinDriverStrength=PORT_CMOS_SPEED_GRADE1, PortPinInitialMode=PORT_PIN_MODE_GPIO, PortPinInputCharacteristic=PORT_PIN_IN_PULL_UP, PortPinInputHysteresis=false, PortPinLevelValue=PORT_PIN_LEVEL_LOW, PortPinMode=PORT_PIN_MODE_ALL, PortPinModeChangeable=false, PortPinPadLevel=PORT_PDR_CMOS_AUTOMOTIVE_LEVEL:
            PortPin_0: PortPinId=178, PortPinSymbolicName=PORT_11_PIN_2
            PortPin_1: PortPinId=179, PortPinSymbolicName=PORT_11_PIN_3
            PortPin_2: PortPinId=182, PortPinSymbolicName=PORT_11_PIN_6
            PortPin_3: PortPinId=185, PortPinSymbolicName=PORT_11_PIN_9
            PortPin_4: PortPinId=186, PortPinSymbolicName=PORT_11_PIN_10
            PortPin_5: PortPinId=187, PortPinSymbolicName=PORT_11_PIN_11
            PortPin_6: PortPinId=188, PortPinSymbolicName=PORT_11_PIN_12
        PortContainer_4: PortNumber=13, PortNumberOfPortPins=4
          PortLVDSM_0 (PortLVDSM): PortLVDSMPinPair=Pin_0_Pin_1, PortPadSupplyVoltage=PAD_SUPPLY_5V
          PortLVDSM_1 (PortLVDSM): PortLVDSMPinPair=Pin_2_Pin_3, PortPadSupplyVoltage=PAD_SUPPLY_5V
          4 x PortPin, all with PortPinAnalogInput=DISABLE, PortPinControllerSelect=DISABLE, PortPinDirection=PORT_PIN_IN, PortPinDirectionChangeable=false, PortPinDriverStrength=PORT_CMOS_SPEED_GRADE1, PortPinInitialMode=PORT_PIN_MODE_GPIO, PortPinInputCharacteristic=PORT_PIN_IN_PULL_UP, PortPinInputHysteresis=false, PortPinLevelValue=PORT_PIN_LEVEL_LOW, PortPinMode=PORT_PIN_MODE_ALL, PortPinModeChangeable=false, PortPinPadLevel=PORT_PDR_CMOS_AUTOMOTIVE_LEVEL:
            PortPin_0: PortPinId=208, PortPinSymbolicName=PORT_13_PIN_0
            PortPin_1: PortPinId=209, PortPinSymbolicName=PORT_13_PIN_1
            PortPin_2: PortPinId=210, PortPinSymbolicName=PORT_13_PIN_2
            PortPin_3: PortPinId=211, PortPinSymbolicName=PORT_13_PIN_3
        PortContainer_5: PortNumber=14, PortNumberOfPortPins=11
          11 x PortPin, all with PortPinAnalogInput=DISABLE, PortPinControllerSelect=DISABLE, PortPinDirectionChangeable=false, PortPinDriverStrength=PORT_CMOS_SPEED_GRADE1, PortPinLevelValue=PORT_PIN_LEVEL_LOW, PortPinMode=PORT_PIN_MODE_ALL, PortPinModeChangeable=false, PortPinPadLevel=PORT_PDR_CMOS_AUTOMOTIVE_LEVEL:
            CAN1_TJA1043_RXD: PortPinDirection=PORT_PIN_IN, PortPinId=225, PortPinInitialMode=PORT_PIN_MODE_GPIO, PortPinInputCharacteristic=PORT_PIN_IN_NO_PULL, PortPinInputHysteresis=false, PortPinSymbolicName=PORT_14_PIN_1
            CAN1_TJA1043_TXD: PortPinDirection=PORT_PIN_OUT, PortPinId=224, PortPinInitialMode=PORT_PIN_MODE_ALT5, PortPinInputHysteresis=false, PortPinOutputCharacteristic=PORT_PIN_OUT_PUSHPULL, PortPinSymbolicName=PORT_14_PIN_0
            PortPin_10: PortPinDirection=PORT_PIN_IN, PortPinId=234, PortPinInitialMode=PORT_PIN_MODE_GPIO, PortPinInputCharacteristic=PORT_PIN_IN_PULL_UP, PortPinInputHysteresis=false, PortPinSymbolicName=PORT_14_PIN_10
            PortPin_2: PortPinDirection=PORT_PIN_IN, PortPinId=226, PortPinInitialMode=PORT_PIN_MODE_GPIO, PortPinInputCharacteristic=PORT_PIN_IN_PULL_UP, PortPinInputHysteresis=true, PortPinSymbolicName=PORT_14_PIN_2
            PortPin_3: PortPinDirection=PORT_PIN_IN, PortPinId=227, PortPinInitialMode=PORT_PIN_MODE_GPIO, PortPinInputCharacteristic=PORT_PIN_IN_PULL_UP, PortPinInputHysteresis=false, PortPinSymbolicName=PORT_14_PIN_3
            PortPin_4: PortPinDirection=PORT_PIN_IN, PortPinId=228, PortPinInitialMode=PORT_PIN_MODE_GPIO, PortPinInputCharacteristic=PORT_PIN_IN_PULL_UP, PortPinInputHysteresis=true, PortPinSymbolicName=PORT_14_PIN_4
            PortPin_5: PortPinDirection=PORT_PIN_IN, PortPinId=229, PortPinInitialMode=PORT_PIN_MODE_GPIO, PortPinInputCharacteristic=PORT_PIN_IN_PULL_UP, PortPinInputHysteresis=false, PortPinSymbolicName=PORT_14_PIN_5
            PortPin_6: PortPinDirection=PORT_PIN_IN, PortPinId=230, PortPinInitialMode=PORT_PIN_MODE_GPIO, PortPinInputCharacteristic=PORT_PIN_IN_PULL_UP, PortPinInputHysteresis=false, PortPinSymbolicName=PORT_14_PIN_6
            PortPin_7: PortPinDirection=PORT_PIN_IN, PortPinId=231, PortPinInitialMode=PORT_PIN_MODE_GPIO, PortPinInputCharacteristic=PORT_PIN_IN_PULL_UP, PortPinInputHysteresis=false, PortPinSymbolicName=PORT_14_PIN_7
            PortPin_8: PortPinDirection=PORT_PIN_IN, PortPinId=232, PortPinInitialMode=PORT_PIN_MODE_GPIO, PortPinInputCharacteristic=PORT_PIN_IN_PULL_UP, PortPinInputHysteresis=false, PortPinSymbolicName=PORT_14_PIN_8
            PortPin_9: PortPinDirection=PORT_PIN_IN, PortPinId=233, PortPinInitialMode=PORT_PIN_MODE_GPIO, PortPinInputCharacteristic=PORT_PIN_IN_PULL_UP, PortPinInputHysteresis=false, PortPinSymbolicName=PORT_14_PIN_9
        PortContainer_6: PortNumber=15, PortNumberOfPortPins=9
          9 x PortPin, all with PortPinAnalogInput=DISABLE, PortPinControllerSelect=DISABLE, PortPinDirectionChangeable=false, PortPinDriverStrength=PORT_CMOS_SPEED_GRADE1, PortPinInitialMode=PORT_PIN_MODE_GPIO, PortPinLevelValue=PORT_PIN_LEVEL_LOW, PortPinMode=PORT_PIN_MODE_ALL, PortPinModeChangeable=false, PortPinPadLevel=PORT_PDR_CMOS_AUTOMOTIVE_LEVEL:
            CAN1_TJA1043_EN: PortPinDirection=PORT_PIN_OUT, PortPinId=247, PortPinInputHysteresis=false, PortPinOutputCharacteristic=PORT_PIN_OUT_PUSHPULL, PortPinSymbolicName=PORT_15_PIN_7
            CAN1_TJA1043_ERR: PortPinDirection=PORT_PIN_IN, PortPinId=246, PortPinInputCharacteristic=PORT_PIN_IN_PULL_UP, PortPinInputHysteresis=false, PortPinSymbolicName=PORT_15_PIN_6
            CAN1_TJA1043_STB: PortPinDirection=PORT_PIN_OUT, PortPinId=248, PortPinInputHysteresis=false, PortPinOutputCharacteristic=PORT_PIN_OUT_PUSHPULL, PortPinSymbolicName=PORT_15_PIN_8
            PortPin_0: PortPinDirection=PORT_PIN_OUT, PortPinId=240, PortPinInputHysteresis=false, PortPinOutputCharacteristic=PORT_PIN_OUT_PUSHPULL, PortPinSymbolicName=PORT_15_PIN_0
            PortPin_1: PortPinDirection=PORT_PIN_OUT, PortPinId=241, PortPinInputHysteresis=true, PortPinOutputCharacteristic=PORT_PIN_OUT_PUSHPULL, PortPinSymbolicName=PORT_15_PIN_1
            PortPin_2: PortPinDirection=PORT_PIN_OUT, PortPinId=242, PortPinInputHysteresis=false, PortPinOutputCharacteristic=PORT_PIN_OUT_PUSHPULL, PortPinSymbolicName=PORT_15_PIN_2
            PortPin_3: PortPinDirection=PORT_PIN_OUT, PortPinId=243, PortPinInputHysteresis=false, PortPinOutputCharacteristic=PORT_PIN_OUT_PUSHPULL, PortPinSymbolicName=PORT_15_PIN_3
            PortPin_4: PortPinDirection=PORT_PIN_IN, PortPinId=244, PortPinInputCharacteristic=PORT_PIN_IN_PULL_UP, PortPinInputHysteresis=false, PortPinSymbolicName=PORT_15_PIN_4
            PortPin_5: PortPinDirection=PORT_PIN_IN, PortPinId=245, PortPinInputCharacteristic=PORT_PIN_IN_PULL_UP, PortPinInputHysteresis=false, PortPinSymbolicName=PORT_15_PIN_5
        PortContainer_7: PortNumber=20, PortNumberOfPortPins=13
          13 x PortPin, all with PortPinAnalogInput=DISABLE, PortPinControllerSelect=DISABLE, PortPinDirectionChangeable=false, PortPinDriverStrength=PORT_CMOS_SPEED_GRADE1, PortPinInputHysteresis=false, PortPinLevelValue=PORT_PIN_LEVEL_LOW, PortPinMode=PORT_PIN_MODE_ALL, PortPinModeChangeable=false, PortPinPadLevel=PORT_PDR_CMOS_AUTOMOTIVE_LEVEL:
            PortPin_0: PortPinDirection=PORT_PIN_IN, PortPinId=320, PortPinInitialMode=PORT_PIN_MODE_GPIO, PortPinInputCharacteristic=PORT_PIN_IN_PULL_UP, PortPinSymbolicName=PORT_20_PIN_0
            PortPin_1: PortPinDirection=PORT_PIN_IN, PortPinId=321, PortPinInitialMode=PORT_PIN_MODE_GPIO, PortPinInputCharacteristic=PORT_PIN_IN_PULL_UP, PortPinSymbolicName=PORT_20_PIN_1
            PortPin_10: PortPinDirection=PORT_PIN_IN, PortPinId=332, PortPinInitialMode=PORT_PIN_MODE_GPIO, PortPinInputCharacteristic=PORT_PIN_IN_PULL_UP, PortPinSymbolicName=PORT_20_PIN_12
            PortPin_11: PortPinDirection=PORT_PIN_IN, PortPinId=333, PortPinInitialMode=PORT_PIN_MODE_GPIO, PortPinInputCharacteristic=PORT_PIN_IN_PULL_UP, PortPinSymbolicName=PORT_20_PIN_13
            PortPin_12: PortPinDirection=PORT_PIN_IN, PortPinId=334, PortPinInitialMode=PORT_PIN_MODE_GPIO, PortPinInputCharacteristic=PORT_PIN_IN_PULL_UP, PortPinSymbolicName=PORT_20_PIN_14
            PortPin_2: PortPinDirection=PORT_PIN_IN, PortPinId=322, PortPinInitialMode=PORT_PIN_MODE_GPIO, PortPinInputCharacteristic=PORT_PIN_IN_PULL_UP, PortPinSymbolicName=PORT_20_PIN_2
            PortPin_3: PortPinDirection=PORT_PIN_IN, PortPinId=323, PortPinInitialMode=PORT_PIN_MODE_GPIO, PortPinInputCharacteristic=PORT_PIN_IN_PULL_UP, PortPinSymbolicName=PORT_20_PIN_3
            PortPin_4: PortPinDirection=PORT_PIN_OUT, PortPinId=326, PortPinInitialMode=PORT_PIN_MODE_GPIO, PortPinOutputCharacteristic=PORT_PIN_OUT_PUSHPULL, PortPinSymbolicName=PORT_20_PIN_6
            PortPin_5: PortPinDirection=PORT_PIN_IN, PortPinId=327, PortPinInitialMode=PORT_PIN_MODE_GPIO, PortPinInputCharacteristic=PORT_PIN_IN_NO_PULL, PortPinSymbolicName=PORT_20_PIN_7
            PortPin_6: PortPinDirection=PORT_PIN_OUT, PortPinId=328, PortPinInitialMode=PORT_PIN_MODE_ALT5, PortPinOutputCharacteristic=PORT_PIN_OUT_PUSHPULL, PortPinSymbolicName=PORT_20_PIN_8
            PortPin_7: PortPinDirection=PORT_PIN_IN, PortPinId=329, PortPinInitialMode=PORT_PIN_MODE_GPIO, PortPinInputCharacteristic=PORT_PIN_IN_PULL_UP, PortPinSymbolicName=PORT_20_PIN_9
            PortPin_8: PortPinDirection=PORT_PIN_IN, PortPinId=330, PortPinInitialMode=PORT_PIN_MODE_GPIO, PortPinInputCharacteristic=PORT_PIN_IN_PULL_UP, PortPinSymbolicName=PORT_20_PIN_10
            PortPin_9: PortPinDirection=PORT_PIN_IN, PortPinId=331, PortPinInitialMode=PORT_PIN_MODE_GPIO, PortPinInputCharacteristic=PORT_PIN_IN_PULL_UP, PortPinSymbolicName=PORT_20_PIN_11
        PortContainer_8: PortNumber=21, PortNumberOfPortPins=8
          PortLVDSH_0 (PortLVDSH):
            PortLVDSHPinPair = Pin_2_Pin_3
            PortLVDSRxDisable = DISABLE_LVDS
            PortLVDSRxDisableController = PORT_CONTROLLED
            PortLVDSRxTerminationMode = INTERNAL_TERMINATION
          PortLVDSH_1 (PortLVDSH):
            PortLVDSHPinPair = Pin_4_Pin_5
            PortLVDSPowerDown = PORT_LVDS_POWER_DOWN
            PortLVDSPowerDownPullDown = DISABLE
            PortLVDSTxDisable = DISABLE_LVDS
            PortLVDSTxDisableController = PORT_CONTROLLED
            PortLVDSTxSignallingMode = IEEE_GENERAL_PURPOSE_LINK
          8 x PortPin, all with PortPinAnalogInput=DISABLE, PortPinControllerSelect=DISABLE, PortPinDirection=PORT_PIN_IN, PortPinDirectionChangeable=false, PortPinDriverStrength=PORT_CMOS_SPEED_GRADE1, PortPinInitialMode=PORT_PIN_MODE_GPIO, PortPinInputCharacteristic=PORT_PIN_IN_PULL_UP, PortPinInputHysteresis=true, PortPinLevelValue=PORT_PIN_LEVEL_LOW, PortPinMode=PORT_PIN_MODE_ALL, PortPinModeChangeable=false, PortPinPadLevel=PORT_PDR_CMOS_AUTOMOTIVE_LEVEL:
            PortPin_0: PortPinId=336, PortPinSymbolicName=PORT_21_PIN_0
            PortPin_1: PortPinId=337, PortPinSymbolicName=PORT_21_PIN_1
            PortPin_2: PortPinId=338, PortPinSymbolicName=PORT_21_PIN_2
            PortPin_3: PortPinId=339, PortPinSymbolicName=PORT_21_PIN_3
            PortPin_4: PortPinId=340, PortPinSymbolicName=PORT_21_PIN_4
            PortPin_5: PortPinId=341, PortPinSymbolicName=PORT_21_PIN_5
            PortPin_6: PortPinId=342, PortPinSymbolicName=PORT_21_PIN_6
            PortPin_7: PortPinId=343, PortPinSymbolicName=PORT_21_PIN_7
        PortContainer_9: PortNumber=22, PortNumberOfPortPins=4
          PortLVDSM_0 (PortLVDSM): PortLVDSMPinPair=Pin_0_Pin_1, PortPadSupplyVoltage=PAD_SUPPLY_5V
          PortLVDSM_1 (PortLVDSM): PortLVDSMPinPair=Pin_2_Pin_3, PortPadSupplyVoltage=PAD_SUPPLY_5V
          4 x PortPin, all with PortPinAnalogInput=DISABLE, PortPinControllerSelect=DISABLE, PortPinDirection=PORT_PIN_IN, PortPinDirectionChangeable=false, PortPinDriverStrength=PORT_CMOS_SPEED_GRADE1, PortPinInitialMode=PORT_PIN_MODE_GPIO, PortPinInputCharacteristic=PORT_PIN_IN_PULL_UP, PortPinInputHysteresis=false, PortPinLevelValue=PORT_PIN_LEVEL_LOW, PortPinMode=PORT_PIN_MODE_ALL, PortPinModeChangeable=false, PortPinPadLevel=PORT_PDR_CMOS_AUTOMOTIVE_LEVEL:
            PortPin_0: PortPinId=352, PortPinSymbolicName=PORT_22_PIN_0
            PortPin_1: PortPinId=353, PortPinSymbolicName=PORT_22_PIN_1
            PortPin_2: PortPinId=354, PortPinSymbolicName=PORT_22_PIN_2
            PortPin_3: PortPinId=355, PortPinSymbolicName=PORT_22_PIN_3
    PortSafety: PortInitCheckApi=false, PortSafetyEnable=false
    PortGeneral:
      PortDevErrorDetect = false
      PortPBFixedAddress = false
      PortRunningInUser0Mode = false
      PortSetPinDirectionApi = false
      PortSetPinModeApi = false
      PortUserModeInitApiEnable = false
      PortUserModeRuntimeApiEnable = false
      PortVersionInfoApi = true
    CommonPublishedInformation:
      ArMajorVersion = 3
      ArMinorVersion = 2
      ArPatchVersion = 0
      ModuleId = 124
      Release = _TRICORE_TC275
      SwMajorVersion = 3
      SwMinorVersion = 1
      SwPatchVersion = 2
      VendorId = 17
