AUTOSAR XML (schema 00046)
package /ActiveEcuC
  module config Dem: implementation-config-variant=VARIANT-PRE-COMPILE, module-description=Dem_Impl
    DemConfigSet
      DTCClass_DTC_0x402011 (DemDTCClass): DemUdsDTC=4202513, DemImmediateNvStorage=false
      6 x DemEventParameter, all with DemEventKind=DEM_EVENT_KIND_SWC, DemMaxNumberFreezeFrameRecords=2, DemEventTimeSeries=DEM_TIMESERIES_SNAPSHOT_NONE, DemEventAvailable=true, DemEventAvailableInVariant=true, DemEventLatchTestFailed=false, DemEventCreateInfoPort=true, DemExtendedDataClassRef=ExtendedDataClass_bc718b7c:
        DTC_0x402011: DemEventId=1, DemDTCClassRef=DTCClass_DTC_0x402011, DemFreezeFrameClassRef=FreezeFrameClass_d4213761
          DemEventClass:
            DemEventDestination = DEM_DTC_ORIGIN_PRIMARY_MEMORY
            DemEventSignificance = DEM_EVENT_SIGNIFICANCE_FAULT
            DemAgingAllowed = false
            DemConsiderPtoStatus = false
            DemEventPriority = 2
            DemFFPrestorageSupported = false
            DemAgingCycleRef = PowerCycle
            DemOperationCycleRef = PowerCycle
            DemDebounceAlgorithmClass
              DemDebounceMonitorInternal
                DemCallbackGetFDC
        DTC_0x403413: DemEventId=11, DemDTCClassRef=DTCClass_DTC_0x403413, DemFreezeFrameClassRef=FreezeFrameClass_226af9a2
          DemEventClass:
            DemEventDestination = DEM_DTC_ORIGIN_PRIMARY_MEMORY
            DemEventSignificance = DEM_EVENT_SIGNIFICANCE_FAULT
            DemAgingAllowed = false
            DemConsiderPtoStatus = false
            DemEventPriority = 2
            DemFFPrestorageSupported = false
            DemAgingCycleRef = PowerCycle
            DemOperationCycleRef = PowerCycle
            DemDebounceAlgorithmClass
              DemDebounceMonitorInternal
                DemCallbackGetFDC
        DTC_0x404428: DemEventId=25, DemDTCClassRef=DTCClass_DTC_0x404428, DemFreezeFrameClassRef=FreezeFrameClass_226af9a2
          DemEventClass:
            DemEventDestination = DEM_DTC_ORIGIN_PRIMARY_MEMORY
            DemEventSignificance = DEM_EVENT_SIGNIFICANCE_FAULT
            DemAgingAllowed = false
            DemConsiderPtoStatus = false
            DemEventPriority = 2
            DemFFPrestorageSupported = false
            DemAgingCycleRef = PowerCycle
            DemOperationCycleRef = PowerCycle
            DemDebounceAlgorithmClass
              DemDebounceMonitorInternal
                DemCallbackGetFDC
        DTC_0x406321: DemEventId=29, DemDTCClassRef=DTCClass_DTC_0x406321, DemFreezeFrameClassRef=FreezeFrameClass_226af9a2
          DemEventClass:
            DemEventDestination = DEM_DTC_ORIGIN_PRIMARY_MEMORY
            DemEventSignificance = DEM_EVENT_SIGNIFICANCE_FAULT
            DemAgingAllowed = false
            DemConsiderPtoStatus = false
            DemEventPriority = 2
            DemFFPrestorageSupported = false
            DemAgingCycleRef = PowerCycle
            DemOperationCycleRef = PowerCycle
            DemDebounceAlgorithmClass
              DemDebounceMonitorInternal
                DemCallbackGetFDC
        DTC_0x406325: DemEventId=31, DemDTCClassRef=DTCClass_DTC_0x406325, DemFreezeFrameClassRef=FreezeFrameClass_226af9a2
          DemEventClass:
            DemEventDestination = DEM_DTC_ORIGIN_PRIMARY_MEMORY
            DemEventSignificance = DEM_EVENT_SIGNIFICANCE_FAULT
            DemAgingAllowed = false
            DemConsiderPtoStatus = false
            DemEventPriority = 2
            DemFFPrestorageSupported = false
            DemAgingCycleRef = PowerCycle
            DemOperationCycleRef = PowerCycle
            DemDebounceAlgorithmClass
              DemDebounceMonitorInternal
                DemCallbackGetFDC
        DTC_0x404421: DemEventId=23, DemDTCClassRef=DTCClass_DTC_0x404421, DemFreezeFrameClassRef=FreezeFrameClass_226af9a2
          DemEventClass:
            DemEventDestination = DEM_DTC_ORIGIN_PRIMARY_MEMORY
            DemEventSignificance = DEM_EVENT_SIGNIFICANCE_FAULT
            DemAgingAllowed = false
            DemConsiderPtoStatus = false
            DemEventPriority = 2
            DemFFPrestorageSupported = false
            DemAgingCycleRef = PowerCycle
            DemOperationCycleRef = PowerCycle
            DemDebounceAlgorithmClass
              DemDebounceMonitorInternal
                DemCallbackGetFDC
      DTCClass_DTC_0x402012 (DemDTCClass): DemUdsDTC=4202514, DemImmediateNvStorage=false
      DTC_0x404422 (DemEventParameter):
        DemEventKind = DEM_EVENT_KIND_SWC
        DemMaxNumberFreezeFrameRecords = 2
        DemEventTimeSeries = DEM_TIMESERIES_SNAPSHOT_NONE
        DemEventAvailable = true
        DemEventId = 24
        DemEventAvailableInVariant = true
        DemEventLatchTestFailed = false
        DemEventCreateInfoPort = true
        DemDTCClassRef = DTCClass_DTC_0x404422
        DemExtendedDataClassRef = ExtendedDataClass_bc718b7c
        DemFreezeFrameClassRef = FreezeFrameClass_226af9a2
        DemEventClass:
          DemEventDestination = DEM_DTC_ORIGIN_PRIMARY_MEMORY
          DemEventSignificance = DEM_EVENT_SIGNIFICANCE_FAULT
          DemAgingAllowed = false
          DemConsiderPtoStatus = false
          DemEventPriority = 2
          DemFFPrestorageSupported = false
          DemAgingCycleRef = PowerCycle
          DemOperationCycleRef = PowerCycle
          DemDebounceAlgorithmClass
            DemDebounceMonitorInternal
              DemCallbackGetFDC
      3 x DemDTCClass, all with DemImmediateNvStorage=false:
        DTCClass_DTC_0x403421: DemUdsDTC=4207649
        DTCClass_DTC_0x402013: DemUdsDTC=4202515
        DTCClass_DTC_0x403422: DemUdsDTC=4207650
      3 x DemEventParameter, all with DemEventKind=DEM_EVENT_KIND_SWC, DemMaxNumberFreezeFrameRecords=2, DemEventTimeSeries=DEM_TIMESERIES_SNAPSHOT_NONE, DemEventAvailable=true, DemEventAvailableInVariant=true, DemEventLatchTestFailed=false, DemEventCreateInfoPort=true, DemExtendedDataClassRef=ExtendedDataClass_bc718b7c, DemFreezeFrameClassRef=FreezeFrameClass_226af9a2:
        DTC_0x406322: DemEventId=30, DemDTCClassRef=DTCClass_DTC_0x406322
          DemEventClass:
            DemEventDestination = DEM_DTC_ORIGIN_PRIMARY_MEMORY
            DemEventSignificance = DEM_EVENT_SIGNIFICANCE_FAULT
            DemAgingAllowed = false
            DemConsiderPtoStatus = false
            DemEventPriority = 2
            DemFFPrestorageSupported = false
            DemAgingCycleRef = PowerCycle
            DemOperationCycleRef = PowerCycle
            DemDebounceAlgorithmClass
              DemDebounceMonitorInternal
                DemCallbackGetFDC
        DTC_0x403a21: DemEventId=3, DemDTCClassRef=DTCClass_DTC_0x403a21
          DemEventClass:
            DemEventDestination = DEM_DTC_ORIGIN_PRIMARY_MEMORY
            DemEventSignificance = DEM_EVENT_SIGNIFICANCE_FAULT
            DemAgingAllowed = false
            DemConsiderPtoStatus = false
            DemEventPriority = 2
            DemFFPrestorageSupported = false
            DemAgingCycleRef = PowerCycle
            DemOperationCycleRef = PowerCycle
            DemDebounceAlgorithmClass
              DemDebounceMonitorInternal
                DemCallbackGetFDC
        DTC_0x403a22: DemEventId=4, DemDTCClassRef=DTCClass_DTC_0x403a22
          DemEventClass:
            DemEventDestination = DEM_DTC_ORIGIN_PRIMARY_MEMORY
            DemEventSignificance = DEM_EVENT_SIGNIFICANCE_FAULT
            DemAgingAllowed = false
            DemConsiderPtoStatus = false
            DemEventPriority = 2
            DemFFPrestorageSupported = false
            DemAgingCycleRef = PowerCycle
            DemOperationCycleRef = PowerCycle
            DemDebounceAlgorithmClass
              DemDebounceMonitorInternal
                DemCallbackGetFDC
      DTCClass_DTC_0x406221 (DemDTCClass): DemUdsDTC=4219425, DemImmediateNvStorage=false
      DTC_0x403422 (DemEventParameter):
        DemEventKind = DEM_EVENT_KIND_SWC
        DemMaxNumberFreezeFrameRecords = 2
        DemEventTimeSeries = DEM_TIMESERIES_SNAPSHOT_NONE
        DemEventAvailable = true
        DemEventId = 13
        DemEventAvailableInVariant = true
        DemEventLatchTestFailed = false
        DemEventCreateInfoPort = true
        DemDTCClassRef = DTCClass_DTC_0x403422
        DemExtendedDataClassRef = ExtendedDataClass_bc718b7c
        DemFreezeFrameClassRef = FreezeFrameClass_226af9a2
        DemEventClass:
          DemEventDestination = DEM_DTC_ORIGIN_PRIMARY_MEMORY
          DemEventSignificance = DEM_EVENT_SIGNIFICANCE_FAULT
          DemAgingAllowed = false
          DemConsiderPtoStatus = false
          DemEventPriority = 2
          DemFFPrestorageSupported = false
          DemAgingCycleRef = PowerCycle
          DemOperationCycleRef = PowerCycle
          DemDebounceAlgorithmClass
            DemDebounceMonitorInternal
              DemCallbackGetFDC
      DTCClass_DTC_0x406222 (DemDTCClass): DemUdsDTC=4219426, DemImmediateNvStorage=false
      DTCClass_DTC_0x403713 (DemDTCClass): DemUdsDTC=4208403, DemImmediateNvStorage=false
      DTC_0x403421 (DemEventParameter):
        DemEventKind = DEM_EVENT_KIND_SWC
        DemMaxNumberFreezeFrameRecords = 2
        DemEventTimeSeries = DEM_TIMESERIES_SNAPSHOT_NONE
        DemEventAvailable = true
        DemEventId = 12
        DemEventAvailableInVariant = true
        DemEventLatchTestFailed = false
        DemEventCreateInfoPort = true
        DemDTCClassRef = DTCClass_DTC_0x403421
        DemExtendedDataClassRef = ExtendedDataClass_bc718b7c
        DemFreezeFrameClassRef = FreezeFrameClass_226af9a2
        DemEventClass:
          DemEventDestination = DEM_DTC_ORIGIN_PRIMARY_MEMORY
          DemEventSignificance = DEM_EVENT_SIGNIFICANCE_FAULT
          DemAgingAllowed = false
          DemConsiderPtoStatus = false
          DemEventPriority = 2
          DemFFPrestorageSupported = false
          DemAgingCycleRef = PowerCycle
          DemOperationCycleRef = PowerCycle
          DemDebounceAlgorithmClass
            DemDebounceMonitorInternal
              DemCallbackGetFDC
      3 x DemDTCClass, all with DemImmediateNvStorage=false:
        DTCClass_DTC_0x403113: DemUdsDTC=4206867
        DTCClass_DTC_0x406225: DemUdsDTC=4219429
        DTCClass_DTC_0x402025: DemUdsDTC=4202533
      DTC_0x402013 (DemEventParameter):
        DemEventKind = DEM_EVENT_KIND_SWC
        DemMaxNumberFreezeFrameRecords = 2
        DemEventTimeSeries = DEM_TIMESERIES_SNAPSHOT_NONE
        DemEventAvailable = true
        DemEventId = 6
        DemEventAvailableInVariant = true
        DemEventLatchTestFailed = false
        DemEventCreateInfoPort = true
        DemDTCClassRef = DTCClass_DTC_0x402013
        DemExtendedDataClassRef = ExtendedDataClass_bc718b7c
        DemFreezeFrameClassRef = FreezeFrameClass_226af9a2
        DemEventClass:
          DemEventDestination = DEM_DTC_ORIGIN_PRIMARY_MEMORY
          DemEventSignificance = DEM_EVENT_SIGNIFICANCE_FAULT
          DemAgingAllowed = false
          DemConsiderPtoStatus = false
          DemEventPriority = 2
          DemFFPrestorageSupported = false
          DemAgingCycleRef = PowerCycle
          DemOperationCycleRef = PowerCycle
          DemDebounceAlgorithmClass
            DemDebounceMonitorInternal
              DemCallbackGetFDC
      DTC_0x402012 (DemEventParameter):
        DemEventKind = DEM_EVENT_KIND_SWC
        DemMaxNumberFreezeFrameRecords = 2
        DemEventTimeSeries = DEM_TIMESERIES_SNAPSHOT_NONE
        DemEventAvailable = true
        DemEventId = 5
        DemEventAvailableInVariant = true
        DemEventLatchTestFailed = false
        DemEventCreateInfoPort = true
        DemDTCClassRef = DTCClass_DTC_0x402012
        DemExtendedDataClassRef = ExtendedDataClass_bc718b7c
        DemFreezeFrameClassRef = FreezeFrameClass_d4213761
        DemEventClass:
          DemEventDestination = DEM_DTC_ORIGIN_PRIMARY_MEMORY
          DemEventSignificance = DEM_EVENT_SIGNIFICANCE_FAULT
          DemAgingAllowed = false
          DemConsiderPtoStatus = false
          DemEventPriority = 2
          DemFFPrestorageSupported = false
          DemAgingCycleRef = PowerCycle
          DemOperationCycleRef = PowerCycle
          DemDebounceAlgorithmClass
            DemDebounceMonitorInternal
              DemCallbackGetFDC
      DTCClass_DTC_0x404011 (DemDTCClass): DemUdsDTC=4210705, DemImmediateNvStorage=false
      DTC_0x402025 (DemEventParameter):
        DemEventKind = DEM_EVENT_KIND_SWC
        DemMaxNumberFreezeFrameRecords = 2
        DemEventTimeSeries = DEM_TIMESERIES_SNAPSHOT_NONE
        DemEventAvailable = true
        DemEventId = 7
        DemEventAvailableInVariant = true
        DemEventLatchTestFailed = false
        DemEventCreateInfoPort = true
        DemDTCClassRef = DTCClass_DTC_0x402025
        DemExtendedDataClassRef = ExtendedDataClass_bc718b7c
        DemFreezeFrameClassRef = FreezeFrameClass_226af9a2
        DemEventClass:
          DemEventDestination = DEM_DTC_ORIGIN_PRIMARY_MEMORY
          DemEventSignificance = DEM_EVENT_SIGNIFICANCE_FAULT
          DemAgingAllowed = false
          DemConsiderPtoStatus = false
          DemEventPriority = 2
          DemFFPrestorageSupported = false
          DemAgingCycleRef = PowerCycle
          DemOperationCycleRef = PowerCycle
          DemDebounceAlgorithmClass
            DemDebounceMonitorInternal
              DemCallbackGetFDC
      5 x DemDTCClass, all with DemImmediateNvStorage=false:
        DTCClass_DTC_0x404211: DemUdsDTC=4211217
        DTCClass_DTC_0x404013: DemUdsDTC=4210707
        DTCClass_DTC_0x403121: DemUdsDTC=4206881
        DTCClass_DTC_0x404012: DemUdsDTC=4210706
        DTCClass_DTC_0x403122: DemUdsDTC=4206882
      DTC_0x403713 (DemEventParameter):
        DemEventKind = DEM_EVENT_KIND_SWC
        DemMaxNumberFreezeFrameRecords = 2
        DemEventTimeSeries = DEM_TIMESERIES_SNAPSHOT_NONE
        DemEventAvailable = true
        DemEventId = 14
        DemEventAvailableInVariant = true
        DemEventLatchTestFailed = false
        DemEventCreateInfoPort = true
        DemDTCClassRef = DTCClass_DTC_0x403713
        DemExtendedDataClassRef = ExtendedDataClass_bc718b7c
        DemFreezeFrameClassRef = FreezeFrameClass_226af9a2
        DemEventClass:
          DemEventDestination = DEM_DTC_ORIGIN_PRIMARY_MEMORY
          DemEventSignificance = DEM_EVENT_SIGNIFICANCE_FAULT
          DemAgingAllowed = false
          DemConsiderPtoStatus = false
          DemEventPriority = 2
          DemFFPrestorageSupported = false
          DemAgingCycleRef = PowerCycle
          DemOperationCycleRef = PowerCycle
          DemDebounceAlgorithmClass
            DemDebounceMonitorInternal
              DemCallbackGetFDC
      DTC_0x406222 (DemEventParameter):
        DemEventKind = DEM_EVENT_KIND_SWC
        DemMaxNumberFreezeFrameRecords = 2
        DemEventTimeSeries = DEM_TIMESERIES_SNAPSHOT_NONE
        DemEventAvailable = true
        DemEventId = 27
        DemEventAvailableInVariant = true
        DemEventLatchTestFailed = false
        DemEventCreateInfoPort = true
        DemDTCClassRef = DTCClass_DTC_0x406222
        DemExtendedDataClassRef = ExtendedDataClass_bc718b7c
        DemFreezeFrameClassRef = FreezeFrameClass_226af9a2
        DemEventClass:
          DemEventDestination = DEM_DTC_ORIGIN_PRIMARY_MEMORY
          DemEventSignificance = DEM_EVENT_SIGNIFICANCE_FAULT
          DemAgingAllowed = false
          DemConsiderPtoStatus = false
          DemEventPriority = 2
          DemFFPrestorageSupported = false
          DemAgingCycleRef = PowerCycle
          DemOperationCycleRef = PowerCycle
          DemDebounceAlgorithmClass
            DemDebounceMonitorInternal
              DemCallbackGetFDC
      DTCClass_DTC_0x403721 (DemDTCClass): DemUdsDTC=4208417, DemImmediateNvStorage=false
      DTC_0x406221 (DemEventParameter):
        DemEventKind = DEM_EVENT_KIND_SWC
        DemMaxNumberFreezeFrameRecords = 2
        DemEventTimeSeries = DEM_TIMESERIES_SNAPSHOT_NONE
        DemEventAvailable = true
        DemEventId = 26
        DemEventAvailableInVariant = true
        DemEventLatchTestFailed = false
        DemEventCreateInfoPort = true
        DemDTCClassRef = DTCClass_DTC_0x406221
        DemExtendedDataClassRef = ExtendedDataClass_bc718b7c
        DemFreezeFrameClassRef = FreezeFrameClass_226af9a2
        DemEventClass:
          DemEventDestination = DEM_DTC_ORIGIN_PRIMARY_MEMORY
          DemEventSignificance = DEM_EVENT_SIGNIFICANCE_FAULT
          DemAgingAllowed = false
          DemConsiderPtoStatus = false
          DemEventPriority = 2
          DemFFPrestorageSupported = false
          DemAgingCycleRef = PowerCycle
          DemOperationCycleRef = PowerCycle
          DemDebounceAlgorithmClass
            DemDebounceMonitorInternal
              DemCallbackGetFDC
      DTCClass_DTC_0x403722 (DemDTCClass): DemUdsDTC=4208418, DemImmediateNvStorage=false
      DTCClass_DTC_0x404213 (DemDTCClass): DemUdsDTC=4211219, DemImmediateNvStorage=false
      DTC_0x406225 (DemEventParameter):
        DemEventKind = DEM_EVENT_KIND_SWC
        DemMaxNumberFreezeFrameRecords = 2
        DemEventTimeSeries = DEM_TIMESERIES_SNAPSHOT_NONE
        DemEventAvailable = true
        DemEventId = 28
        DemEventAvailableInVariant = true
        DemEventLatchTestFailed = false
        DemEventCreateInfoPort = true
        DemDTCClassRef = DTCClass_DTC_0x406225
        DemExtendedDataClassRef = ExtendedDataClass_bc718b7c
        DemFreezeFrameClassRef = FreezeFrameClass_226af9a2
        DemEventClass:
          DemEventDestination = DEM_DTC_ORIGIN_PRIMARY_MEMORY
          DemEventSignificance = DEM_EVENT_SIGNIFICANCE_FAULT
          DemAgingAllowed = false
          DemConsiderPtoStatus = false
          DemEventPriority = 2
          DemFFPrestorageSupported = false
          DemAgingCycleRef = PowerCycle
          DemOperationCycleRef = PowerCycle
          DemDebounceAlgorithmClass
            DemDebounceMonitorInternal
              DemCallbackGetFDC
      DTCClass_DTC_0x404212 (DemDTCClass): DemUdsDTC=4211218, DemImmediateNvStorage=false
      DTC_0x403113 (DemEventParameter):
        DemEventKind = DEM_EVENT_KIND_SWC
        DemMaxNumberFreezeFrameRecords = 2
        DemEventTimeSeries = DEM_TIMESERIES_SNAPSHOT_NONE
        DemEventAvailable = true
        DemEventId = 8
        DemEventAvailableInVariant = true
        DemEventLatchTestFailed = false
        DemEventCreateInfoPort = true
        DemDTCClassRef = DTCClass_DTC_0x403113
        DemExtendedDataClassRef = ExtendedDataClass_bc718b7c
        DemFreezeFrameClassRef = FreezeFrameClass_226af9a2
        DemEventClass:
          DemEventDestination = DEM_DTC_ORIGIN_PRIMARY_MEMORY
          DemEventSignificance = DEM_EVENT_SIGNIFICANCE_FAULT
          DemAgingAllowed = false
          DemConsiderPtoStatus = false
          DemEventPriority = 2
          DemFFPrestorageSupported = false
          DemAgingCycleRef = PowerCycle
          DemOperationCycleRef = PowerCycle
          DemDebounceAlgorithmClass
            DemDebounceMonitorInternal
              DemCallbackGetFDC
      DTCClass_DTC_0x403a13 (DemDTCClass): DemUdsDTC=4209171, DemImmediateNvStorage=false
      DTCClass_DTC_0x406322 (DemDTCClass): DemUdsDTC=4219682, DemImmediateNvStorage=false
      DTC_0x403721 (DemEventParameter):
        DemEventKind = DEM_EVENT_KIND_SWC
        DemMaxNumberFreezeFrameRecords = 2
        DemEventTimeSeries = DEM_TIMESERIES_SNAPSHOT_NONE
        DemEventAvailable = true
        DemEventId = 15
        DemEventAvailableInVariant = true
        DemEventLatchTestFailed = false
        DemEventCreateInfoPort = true
        DemDTCClassRef = DTCClass_DTC_0x403721
        DemExtendedDataClassRef = ExtendedDataClass_bc718b7c
        DemFreezeFrameClassRef = FreezeFrameClass_226af9a2
        DemEventClass:
          DemEventDestination = DEM_DTC_ORIGIN_PRIMARY_MEMORY
          DemEventSignificance = DEM_EVENT_SIGNIFICANCE_FAULT
          DemAgingAllowed = false
          DemConsiderPtoStatus = false
          DemEventPriority = 2
          DemFFPrestorageSupported = false
          DemAgingCycleRef = PowerCycle
          DemOperationCycleRef = PowerCycle
          DemDebounceAlgorithmClass
            DemDebounceMonitorInternal
              DemCallbackGetFDC
      DTC_0x403722 (DemEventParameter):
        DemEventKind = DEM_EVENT_KIND_SWC
        DemMaxNumberFreezeFrameRecords = 2
        DemEventTimeSeries = DEM_TIMESERIES_SNAPSHOT_NONE
        DemEventAvailable = true
        DemEventId = 16
        DemEventAvailableInVariant = true
        DemEventLatchTestFailed = false
        DemEventCreateInfoPort = true
        DemDTCClassRef = DTCClass_DTC_0x403722
        DemExtendedDataClassRef = ExtendedDataClass_bc718b7c
        DemFreezeFrameClassRef = FreezeFrameClass_226af9a2
        DemEventClass:
          DemEventDestination = DEM_DTC_ORIGIN_PRIMARY_MEMORY
          DemEventSignificance = DEM_EVENT_SIGNIFICANCE_FAULT
          DemAgingAllowed = false
          DemConsiderPtoStatus = false
          DemEventPriority = 2
          DemFFPrestorageSupported = false
          DemAgingCycleRef = PowerCycle
          DemOperationCycleRef = PowerCycle
          DemDebounceAlgorithmClass
            DemDebounceMonitorInternal
              DemCallbackGetFDC
      DTCClass_DTC_0x406321 (DemDTCClass): DemUdsDTC=4219681, DemImmediateNvStorage=false
      DTCClass_DTC_0x403413 (DemDTCClass): DemUdsDTC=4207635, DemImmediateNvStorage=false
      DTC_0x404011 (DemEventParameter):
        DemEventKind = DEM_EVENT_KIND_SWC
        DemMaxNumberFreezeFrameRecords = 2
        DemEventTimeSeries = DEM_TIMESERIES_SNAPSHOT_NONE
        DemEventAvailable = true
        DemEventId = 17
        DemEventAvailableInVariant = true
        DemEventLatchTestFailed = false
        DemEventCreateInfoPort = true
        DemDTCClassRef = DTCClass_DTC_0x404011
        DemExtendedDataClassRef = ExtendedDataClass_bc718b7c
        DemFreezeFrameClassRef = FreezeFrameClass_226af9a2
        DemEventClass:
          DemEventDestination = DEM_DTC_ORIGIN_PRIMARY_MEMORY
          DemEventSignificance = DEM_EVENT_SIGNIFICANCE_FAULT
          DemAgingAllowed = false
          DemConsiderPtoStatus = false
          DemEventPriority = 2
          DemFFPrestorageSupported = false
          DemAgingCycleRef = PowerCycle
          DemOperationCycleRef = PowerCycle
          DemDebounceAlgorithmClass
            DemDebounceMonitorInternal
              DemCallbackGetFDC
      DTCClass_DTC_0x404428 (DemDTCClass): DemUdsDTC=4211752, DemImmediateNvStorage=false
      DTCClass_DTC_0x404422 (DemDTCClass): DemUdsDTC=4211746, DemImmediateNvStorage=false
      DTC_0x404212 (DemEventParameter):
        DemEventKind = DEM_EVENT_KIND_SWC
        DemMaxNumberFreezeFrameRecords = 2
        DemEventTimeSeries = DEM_TIMESERIES_SNAPSHOT_NONE
        DemEventAvailable = true
        DemEventId = 21
        DemEventAvailableInVariant = true
        DemEventLatchTestFailed = false
        DemEventCreateInfoPort = true
        DemDTCClassRef = DTCClass_DTC_0x404212
        DemExtendedDataClassRef = ExtendedDataClass_bc718b7c
        DemFreezeFrameClassRef = FreezeFrameClass_226af9a2
        DemEventClass:
          DemEventDestination = DEM_DTC_ORIGIN_PRIMARY_MEMORY
          DemEventSignificance = DEM_EVENT_SIGNIFICANCE_FAULT
          DemAgingAllowed = false
          DemConsiderPtoStatus = false
          DemEventPriority = 2
          DemFFPrestorageSupported = false
          DemAgingCycleRef = PowerCycle
          DemOperationCycleRef = PowerCycle
          DemDebounceAlgorithmClass
            DemDebounceMonitorInternal
              DemCallbackGetFDC
      DTCClass_DTC_0x404421 (DemDTCClass): DemUdsDTC=4211745, DemImmediateNvStorage=false
      3 x DemEventParameter, all with DemEventKind=DEM_EVENT_KIND_SWC, DemMaxNumberFreezeFrameRecords=2, DemEventTimeSeries=DEM_TIMESERIES_SNAPSHOT_NONE, DemEventAvailable=true, DemEventAvailableInVariant=true, DemEventLatchTestFailed=false, DemEventCreateInfoPort=true, DemExtendedDataClassRef=ExtendedDataClass_bc718b7c, DemFreezeFrameClassRef=FreezeFrameClass_226af9a2:
        DTC_0x404213: DemEventId=22, DemDTCClassRef=DTCClass_DTC_0x404213
          DemEventClass:
            DemEventDestination = DEM_DTC_ORIGIN_PRIMARY_MEMORY
            DemEventSignificance = DEM_EVENT_SIGNIFICANCE_FAULT
            DemAgingAllowed = false
            DemConsiderPtoStatus = false
            DemEventPriority = 2
            DemFFPrestorageSupported = false
            DemAgingCycleRef = PowerCycle
            DemOperationCycleRef = PowerCycle
            DemDebounceAlgorithmClass
              DemDebounceMonitorInternal
                DemCallbackGetFDC
        DTC_0x404012: DemEventId=18, DemDTCClassRef=DTCClass_DTC_0x404012
          DemEventClass:
            DemEventDestination = DEM_DTC_ORIGIN_PRIMARY_MEMORY
            DemEventSignificance = DEM_EVENT_SIGNIFICANCE_FAULT
            DemAgingAllowed = false
            DemConsiderPtoStatus = false
            DemEventPriority = 2
            DemFFPrestorageSupported = false
            DemAgingCycleRef = PowerCycle
            DemOperationCycleRef = PowerCycle
            DemDebounceAlgorithmClass
              DemDebounceMonitorInternal
                DemCallbackGetFDC
        DTC_0x403121: DemEventId=9, DemDTCClassRef=DTCClass_DTC_0x403121
          DemEventClass:
            DemEventDestination = DEM_DTC_ORIGIN_PRIMARY_MEMORY
            DemEventSignificance = DEM_EVENT_SIGNIFICANCE_FAULT
            DemAgingAllowed = false
            DemConsiderPtoStatus = false
            DemEventPriority = 2
            DemFFPrestorageSupported = false
            DemAgingCycleRef = PowerCycle
            DemOperationCycleRef = PowerCycle
            DemDebounceAlgorithmClass
              DemDebounceMonitorInternal
                DemCallbackGetFDC
      DTCClass_DTC_0x406325 (DemDTCClass): DemUdsDTC=4219685, DemImmediateNvStorage=false
      3 x DemEventParameter, all with DemEventKind=DEM_EVENT_KIND_SWC, DemMaxNumberFreezeFrameRecords=2, DemEventTimeSeries=DEM_TIMESERIES_SNAPSHOT_NONE, DemEventAvailable=true, DemEventAvailableInVariant=true, DemEventLatchTestFailed=false, DemEventCreateInfoPort=true, DemExtendedDataClassRef=ExtendedDataClass_bc718b7c, DemFreezeFrameClassRef=FreezeFrameClass_226af9a2:
        DTC_0x404211: DemEventId=20, DemDTCClassRef=DTCClass_DTC_0x404211
          DemEventClass:
            DemEventDestination = DEM_DTC_ORIGIN_PRIMARY_MEMORY
            DemEventSignificance = DEM_EVENT_SIGNIFICANCE_FAULT
            DemAgingAllowed = false
            DemConsiderPtoStatus = false
            DemEventPriority = 2
            DemFFPrestorageSupported = false
            DemAgingCycleRef = PowerCycle
            DemOperationCycleRef = PowerCycle
            DemDebounceAlgorithmClass
              DemDebounceMonitorInternal
                DemCallbackGetFDC
        DTC_0x404013: DemEventId=19, DemDTCClassRef=DTCClass_DTC_0x404013
          DemEventClass:
            DemEventDestination = DEM_DTC_ORIGIN_PRIMARY_MEMORY
            DemEventSignificance = DEM_EVENT_SIGNIFICANCE_FAULT
            DemAgingAllowed = false
            DemConsiderPtoStatus = false
            DemEventPriority = 2
            DemFFPrestorageSupported = false
            DemAgingCycleRef = PowerCycle
            DemOperationCycleRef = PowerCycle
            DemDebounceAlgorithmClass
              DemDebounceMonitorInternal
                DemCallbackGetFDC
        DTC_0x403122: DemEventId=10, DemDTCClassRef=DTCClass_DTC_0x403122
          DemEventClass:
            DemEventDestination = DEM_DTC_ORIGIN_PRIMARY_MEMORY
            DemEventSignificance = DEM_EVENT_SIGNIFICANCE_FAULT
            DemAgingAllowed = false
            DemConsiderPtoStatus = false
            DemEventPriority = 2
            DemFFPrestorageSupported = false
            DemAgingCycleRef = PowerCycle
            DemOperationCycleRef = PowerCycle
            DemDebounceAlgorithmClass
              DemDebounceMonitorInternal
                DemCallbackGetFDC
      DTCClass_DTC_0x403a22 (DemDTCClass): DemUdsDTC=4209186, DemImmediateNvStorage=false
      DTCClass_DTC_0x403a21 (DemDTCClass): DemUdsDTC=4209185, DemImmediateNvStorage=false
      DTC_0x403a13 (DemEventParameter):
        DemEventKind = DEM_EVENT_KIND_SWC
        DemMaxNumberFreezeFrameRecords = 2
        DemEventTimeSeries = DEM_TIMESERIES_SNAPSHOT_NONE
        DemEventAvailable = true
        DemEventId = 2
        DemEventAvailableInVariant = true
        DemEventLatchTestFailed = false
        DemEventCreateInfoPort = true
        DemDTCClassRef = DTCClass_DTC_0x403a13
        DemExtendedDataClassRef = ExtendedDataClass_bc718b7c
        DemFreezeFrameClassRef = FreezeFrameClass_226af9a2
        DemEventClass:
          DemEventDestination = DEM_DTC_ORIGIN_PRIMARY_MEMORY
          DemEventSignificance = DEM_EVENT_SIGNIFICANCE_FAULT
          DemAgingAllowed = false
          DemConsiderPtoStatus = false
          DemEventPriority = 2
          DemFFPrestorageSupported = false
          DemAgingCycleRef = PowerCycle
          DemOperationCycleRef = PowerCycle
          DemDebounceAlgorithmClass
            DemDebounceMonitorInternal
              DemCallbackGetFDC
      DTCClass_DTC_0x401003 (DemDTCClass): DemUdsDTC=4198403, DemImmediateNvStorage=false
      DTCClass_DTC_0x401001 (DemDTCClass): DemUdsDTC=4198401, DemImmediateNvStorage=false
      3 x DemEventParameter, all with DemEventKind=DEM_EVENT_KIND_SWC, DemMaxNumberFreezeFrameRecords=2, DemEventTimeSeries=DEM_TIMESERIES_SNAPSHOT_NONE, DemEventAvailable=true, DemEventAvailableInVariant=true, DemEventLatchTestFailed=false, DemEventCreateInfoPort=true, DemExtendedDataClassRef=ExtendedDataClass_bc718b7c, DemFreezeFrameClassRef=FreezeFrameClass_226af9a2:
        DTC_0x401003: DemEventId=33, DemDTCClassRef=DTCClass_DTC_0x401003
          DemEventClass:
            DemEventDestination = DEM_DTC_ORIGIN_PRIMARY_MEMORY
            DemEventSignificance = DEM_EVENT_SIGNIFICANCE_FAULT
            DemAgingAllowed = false
            DemConsiderPtoStatus = false
            DemEventPriority = 2
            DemFFPrestorageSupported = false
            DemAgingCycleRef = PowerCycle
            DemOperationCycleRef = PowerCycle
            DemDebounceAlgorithmClass
              DemDebounceMonitorInternal
                DemCallbackGetFDC
        DTC_0x401001: DemEventId=32, DemDTCClassRef=DTCClass_DTC_0x401001
          DemEventClass:
            DemEventDestination = DEM_DTC_ORIGIN_PRIMARY_MEMORY
            DemEventSignificance = DEM_EVENT_SIGNIFICANCE_FAULT
            DemAgingAllowed = false
            DemConsiderPtoStatus = false
            DemEventPriority = 2
            DemFFPrestorageSupported = false
            DemAgingCycleRef = PowerCycle
            DemOperationCycleRef = PowerCycle
            DemDebounceAlgorithmClass
              DemDebounceMonitorInternal
                DemCallbackGetFDC
        DTC_0x402001: DemEventId=34, DemDTCClassRef=DTCClass_DTC_0x402001
          DemEventClass:
            DemEventDestination = DEM_DTC_ORIGIN_PRIMARY_MEMORY
            DemEventSignificance = DEM_EVENT_SIGNIFICANCE_FAULT
            DemAgingAllowed = false
            DemConsiderPtoStatus = false
            DemEventPriority = 2
            DemFFPrestorageSupported = false
            DemAgingCycleRef = PowerCycle
            DemOperationCycleRef = PowerCycle
            DemDebounceAlgorithmClass
              DemDebounceMonitorInternal
                DemCallbackGetFDC
      DTCClass_DTC_0x403001 (DemDTCClass): DemUdsDTC=4206593, DemImmediateNvStorage=false
      DTCClass_DTC_0x402001 (DemDTCClass): DemUdsDTC=4202497, DemImmediateNvStorage=false
      DTC_0x403001 (DemEventParameter):
        DemEventKind = DEM_EVENT_KIND_SWC
        DemMaxNumberFreezeFrameRecords = 2
        DemEventTimeSeries = DEM_TIMESERIES_SNAPSHOT_NONE
        DemEventAvailable = true
        DemEventId = 35
        DemEventAvailableInVariant = true
        DemEventLatchTestFailed = false
        DemEventCreateInfoPort = true
        DemDTCClassRef = DTCClass_DTC_0x403001
        DemExtendedDataClassRef = ExtendedDataClass_bc718b7c
        DemFreezeFrameClassRef = FreezeFrameClass_226af9a2
        DemEventClass:
          DemEventDestination = DEM_DTC_ORIGIN_PRIMARY_MEMORY
          DemEventSignificance = DEM_EVENT_SIGNIFICANCE_FAULT
          DemAgingAllowed = false
          DemConsiderPtoStatus = false
          DemEventPriority = 2
          DemFFPrestorageSupported = false
          DemAgingCycleRef = PowerCycle
          DemOperationCycleRef = PowerCycle
          DemDebounceAlgorithmClass
            DemDebounceMonitorInternal
              DemCallbackGetFDC
    DemGeneral:
      DemAgingCycleCounterProcessing = DEM_PROCESS_AGINGCTR_INTERN
      DemDtcStatusAvailabilityMask = 9
      DemMaxNumberEventEntryMirror = 0
      DemPTOSupport = false
      DemTypeOfFreezeFrameRecordNumeration = DEM_FF_RECNUM_CALCULATED
      DemGeneralInterfaceSupport = false
      DemDataElementDefaultEndianness = LITTLE_ENDIAN
      DemAgingRequieresTestedCycle = false
      DemTriggerMonitorInitBeforeClearOk = true
      DemExtendedDataCapture = DEM_TRIGGER_EVENT_MEMORY_STORAGE
      DemFreezeFrameCapture = DEM_TRIGGER_EVENT_MEMORY_STORAGE
      DemOperationCycleProcessing = DEM_PROCESS_OPCYC_STATE
      DemMaxNumberTimeSeriesSnapshots = 0
      DemAvailabilitySupport = DEM_NO_AVAILABILITY
      DemAvailabilityStorage = false
      DemBswErrorBufferSize = 0
      DemClearDTCBehavior = DEM_CLRRESP_VOLATILE
      DemClearDTCLimitation = DEM_ALL_SUPPORTED_DTCS
      DemDebounceCounterBasedSupport = true
      DemDebounceTimeBasedSupport = false
      DemDevErrorDetect = false
      DemEnableConditionSupport = false
      DemEventCombinationSupport = DEM_EVCOMB_DISABLED
      DemEventDisplacementStrategy = DEM_DISPLACEMENT_LEGACY_403
      DemEventMemoryEntryStorageTrigger = DEM_STORAGE_ON_TEST_FAILED
      DemMaxNumberEventEntryOBDFreezeFrame = 0
      DemMaxNumberEventEntryPermanent = 0
      DemMaxNumberEventEntryPrimary = 8
      DemMaxNumberEventEntrySecondary = 0
      DemMaxNumberPrestoredFF = 0
      DemOBDSupport = DEM_OBD_NO_OBD_SUPPORT
      DemOccurrenceCounterProcessing = DEM_PROCESS_OCCCTR_TF
      DemOperationCycleStatusStorage = false
      DemResetConfirmedBitOnOverflow = true
      DemStatusBitHandlingTestFailedSinceLastClear = DEM_STATUS_BIT_NORMAL
      DemStatusBitStorageTestFailed = true
      DemStorageConditionSupport = false
      DemSuppressionSupport = DEM_NO_SUPPRESSION
      DemTaskTime = 0.005
      DemTriggerDcmReports = false
      DemTriggerDltReports = false
      DemTriggerFiMReports = false
      DemTriggerFiMReportsExtended = false
      DemTriggerMonitorInitForEnableConditions = false
      DemTypeOfDTCSupported = DEM_DTC_TRANSLATION_ISO14229_1
      DemVersionInfoApi = false
      DemBswApiVersion = DEM_BSW_API_4_XX_XX
      DemBswApiVersionNvM = DEM_BSW_API_4_XX_XX
      DemBswApiVersionFiM = DEM_BSW_API_4_XX_XX
      DemAgingAfterHealing = DEM_AGING_WHILE_HEALING
      DemAgingBehavior = DEM_AGING_TYPE_1
      DemAgingCounterBehavior = DEM_AGING_COUNT_ALWAYS
      DemAgingCounterReporting = DEM_AGING_NORMAL_REPORTING
      DemAgingRetainEnvironmentalData = false
      DemCompiledPostbuildCrc = 1215718489
      DemCompiledPostbuildCrcMode = DEM_POSTBUILD_CRC_AUTOMATIC
      DemEventDisplacementFallbackStrategy = DEM_FALLBACK_DISCARD_NEW_EVENT
      DemGeneralDiagnosticInfoSupport = true
      DemJ1939Support = false
      DemNvSynchronizeSupport = false
      DemPendingDtcProcessing = DEM_PROCESS_PDTC_STOREDONLY
      DemResetDebounceBehavior = DEM_RESET_DEBOUNCE_ON_DISABLE_ENABLE_CONDITIONS
      DemResetTestFailedOnOperationCycleStart = false
      DemRetryStorageSupport = false
      DemSafeBswChecks = false
      DemUseMemcopyMacros = false
      DemUseRte = true
      DemUserControlledWirBehavior = DEM_ENABLED_DURING_CONTROLDTCSETTING
      DemUserDefinedCompareAndSwap = false
      DemWarningIndicatorRequestedProcessing = DEM_PROCESS_WIR_STOREDONLY
      DemUseMultiPartitionFiM = false
      DemReportSuppressedDTCsInService19x0A = false
      DemSupportAgingForAllDTCs = false
      DemLatchTestFailedBehavior = DEM_LATCH_TF_CONFIRMED_AND_THIS_CYCLE
      DemImmediateNvStorageSupport = true
      DemUseNvm = false
      DemPostbuild: DemEventAvailableDefaultSupport=true, DemMaxSizeFreezeFrame=18, DemMaxNumberDtr=0, DemMaxSizeGlobalFreezeFrame=0
      PowerCycle (DemOperationCycle): DemOperationCycleType=DEM_OPCYC_POWER, DemOperationCycleAutomaticEnd=false, DemOperationCycleAutostart=false
      DemEventMemorySet
      DemClient: DemClientId=0
      UncompletedTestCounters_Driving_Cycles_Since_Last_Completed (DemDataClass): DemDataElementDataSize=1, DemDataElementDataType=UINT8, DemDataElementUsePort=USE_DATA_CLIENT_SERVER_PORT, DemDataElementStoreNonVolatile=true
      OccurrenceCounter (DemExtendedDataRecordClass): DemExtendedDataRecordNumber=10, DemDataClassRef=OccurrenceCounter_Driving_Cycles_Since_Test_Failed
      4 x DemDataClass, all with DemDataElementDataSize=1, DemDataElementDataType=UINT8, DemDataElementUsePort=USE_DATA_CLIENT_SERVER_PORT, DemDataElementStoreNonVolatile=true:
        DID_0x10d_Valve_Voltage_RL
        DID_0x10a_Wheel_Voltage_RL
        DID_0x107_Voltage_ECU
        DID_0x10d_Valve_Voltage_RR
      ExtendedDataClass_bc718b7c (DemExtendedDataClass):
        DemExtendedDataRecordClassRef = OccurrenceCounter
        DemExtendedDataRecordClassRef = DTCAgingCounter
        DemExtendedDataRecordClassRef = UncompletedTestCounters
      Supply_Voltage_ECU (DemDidClass): DemDidIdentifier=263, DemDidDataClassRef=DID_0x107_Voltage_ECU
      FreezeFrameClass_d4213761 (DemFreezeFrameClass): DemDidClassRef=Wheel_Speed, DemDidClassRef=Brake_Pedal, DemDidClassRef=Supply_Voltage_ECU
      5 x DemDataClass, all with DemDataElementDataSize=1, DemDataElementDataType=UINT8, DemDataElementUsePort=USE_DATA_CLIENT_SERVER_PORT, DemDataElementStoreNonVolatile=true:
        DTCAgingCounter_Driving_Cycles_Since_Last_Failed
        DID_0x10d_Valve_Status_FR
        DID_0x10a_Wheel_Voltage_RR
        DID_0x10a_Wheel_Voltage_FR
        DID_0x10a_Wheel_Voltage_FL
      Brake_Pedal (DemDidClass):
        DemDidIdentifier = 269
        DemDidDataClassRef = DID_0x10d_Valve_Voltage_FR
        DemDidDataClassRef = DID_0x10d_Valve_Voltage_FL
        DemDidDataClassRef = DID_0x10d_Valve_Voltage_RR
        DemDidDataClassRef = DID_0x10d_Valve_Voltage_RL
        DemDidDataClassRef = DID_0x10d_Valve_Status_FR
        DemDidDataClassRef = DID_0x10d_Valve_Status_FL
        DemDidDataClassRef = DID_0x10d_Valve_Status_RR
        DemDidDataClassRef = DID_0x10d_Valve_Status_RL
      UncompletedTestCounters (DemExtendedDataRecordClass): DemExtendedDataRecordNumber=12, DemDataClassRef=UncompletedTestCounters_Driving_Cycles_Since_Last_Completed
      3 x DemDataClass, all with DemDataElementDataSize=1, DemDataElementDataType=UINT8, DemDataElementUsePort=USE_DATA_CLIENT_SERVER_PORT, DemDataElementStoreNonVolatile=true:
        DID_0x10d_Valve_Status_RR
        DID_0x10a_Wheel_Speed_RL
        DID_0x10a_Wheel_Speed_RR
      DTCAgingCounter (DemExtendedDataRecordClass): DemExtendedDataRecordNumber=11, DemDataClassRef=DTCAgingCounter_Driving_Cycles_Since_Last_Failed
      5 x DemDataClass, all with DemDataElementDataSize=1, DemDataElementDataType=UINT8, DemDataElementUsePort=USE_DATA_CLIENT_SERVER_PORT, DemDataElementStoreNonVolatile=true:
        DID_0x10a_Wheel_Speed_FL
        DID_0x10d_Valve_Status_FL
        DID_0x10a_Direction_of_rotation
        DID_0x10d_Valve_Voltage_FL
        DID_0x10a_Wheel_Speed_FR
      FreezeFrameClass_226af9a2 (DemFreezeFrameClass): DemDidClassRef=Wheel_Speed, DemDidClassRef=Brake_Pedal
      DID_0x10d_Valve_Voltage_FR (DemDataClass): DemDataElementDataSize=1, DemDataElementDataType=UINT8, DemDataElementUsePort=USE_DATA_CLIENT_SERVER_PORT, DemDataElementStoreNonVolatile=true
      OccurrenceCounter_Driving_Cycles_Since_Test_Failed (DemDataClass): DemDataElementDataSize=1, DemDataElementDataType=UINT8, DemDataElementUsePort=USE_DATA_CLIENT_SERVER_PORT, DemDataElementStoreNonVolatile=true
      Wheel_Speed (DemDidClass):
        DemDidIdentifier = 266
        DemDidDataClassRef = DID_0x10a_Wheel_Speed_FR
        DemDidDataClassRef = DID_0x10a_Wheel_Speed_FL
        DemDidDataClassRef = DID_0x10a_Wheel_Speed_RR
        DemDidDataClassRef = DID_0x10a_Wheel_Speed_RL
        DemDidDataClassRef = DID_0x10a_Wheel_Voltage_FR
        DemDidDataClassRef = DID_0x10a_Wheel_Voltage_FL
        DemDidDataClassRef = DID_0x10a_Wheel_Voltage_RR
        DemDidDataClassRef = DID_0x10a_Wheel_Voltage_RL
        DemDidDataClassRef = DID_0x10a_Direction_of_rotation
      DID_0x10d_Valve_Status_RL (DemDataClass): DemDataElementDataSize=1, DemDataElementDataType=UINT8, DemDataElementUsePort=USE_DATA_CLIENT_SERVER_PORT, DemDataElementStoreNonVolatile=true
