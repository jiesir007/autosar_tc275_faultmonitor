AUTOSAR XML (schema 00046)
package /ActiveEcuC
  module config CanIf: implementation-config-variant=VARIANT-PRE-COMPILE, module-description=CanIf_Impl
    CanIfCtrlDrvCfg_7d254554 (CanIfCtrlDrvCfg): CanIfCtrlDrvTxCancellation=false, CanIfCtrlDrvInitHohConfigRef=CanIfInitHohCfg, CanIfCtrlDrvNameRef=CanGeneral
      CT_DBCNetWork_e3f9218e (CanIfCtrlCfg):
        CanIfCtrlId = 1
        CanIfCtrlWakeupSupport = false
        CanIfCtrlJ1939DynAddrSupport = DISABLED
        CanIfCtrlCanCtrlRef = CT_DBCNetWork_e3f9218e
        CanIfCtrlTrcvCfgRef = CanIfTrcvCfg
      CT_DBCNetWork_INTER1_f93f8858 (CanIfCtrlCfg): CanIfCtrlId=0, CanIfCtrlWakeupSupport=false, CanIfCtrlJ1939DynAddrSupport=DISABLED, CanIfCtrlCanCtrlRef=CT_DBCNetWork_INTER1_f93f8858
    CanIfDispatchCfg:
      CanIfDispatchUserCtrlBusOffName = CanSM_ControllerBusOff
      CanIfDispatchUserCtrlBusOffUL = CAN_SM
      CanIfDispatchUserCtrlModeIndicationName = CanSM_ControllerModeIndication
      CanIfDispatchUserCtrlModeIndicationUL = CAN_SM
      CanIfDispatchUserTrcvModeIndicationUL = CAN_SM
      CanIfDispatchUserTrcvModeIndicationName = CanSM_TransceiverModeIndication
      CanIfDispatchUserValidateWakeupEventName = EcuM_ValidateWakeupEvent
      CanIfDispatchUserValidateWakeupEventUL = ECUM
    CanIfInitCfg
      CanIfInitHohCfg: CanIfInitRefCfgSet=CanConfigSet
        6 x CanIfHrhCfg, all with CanIfHrhSoftwareFilter=true, CanIfHrhCanCtrlIdRef=CT_DBCNetWork_e3f9218e:
          CN_DBCNetWork_b9b38c08_Rx_Meg_FunDiag: CanIfHrhIdSymRef=CN_DBCNetWork_b9b38c08_Rx_Meg_FunDiag
          CN_DBCNetWork_b9b38c08_Rx_Meg_PhyDiag: CanIfHrhIdSymRef=CN_DBCNetWork_b9b38c08_Rx_Meg_PhyDiag
          CN_DBCNetWork_b9b38c08_Rx_SupC_Function_1: CanIfHrhIdSymRef=CN_DBCNetWork_b9b38c08_Rx_SupC_Function_1
          CN_DBCNetWork_b9b38c08_Rx_SupD_Led_CtrlMode: CanIfHrhIdSymRef=CN_DBCNetWork_b9b38c08_Rx_SupD_Led_CtrlMode
          CN_DBCNetWork_b9b38c08_Rx_SupD_Led_Control: CanIfHrhIdSymRef=CN_DBCNetWork_b9b38c08_Rx_SupD_Led_Control
          CN_DBCNetWork_b9b38c08_Rx_SupD_Button_Control: CanIfHrhIdSymRef=CN_DBCNetWork_b9b38c08_Rx_SupD_Button_Control
        CN_DBCNetWork_05d62413_Tx (CanIfHthCfg): CanIfHthCanCtrlIdRef=CT_DBCNetWork_e3f9218e, CanIfHthIdSymRef=CN_DBCNetWork_05d62413_Tx
        CN_DBCNetWork_88abbb7f_Rx (CanIfHrhCfg): CanIfHrhSoftwareFilter=true, CanIfHrhCanCtrlIdRef=CT_DBCNetWork_e3f9218e, CanIfHrhIdSymRef=CN_DBCNetWork_88abbb7f_Rx
        CN_DBCNetWork_INTER1_9768a826_Tx (CanIfHthCfg): CanIfHthCanCtrlIdRef=CT_DBCNetWork_INTER1_f93f8858, CanIfHthIdSymRef=CN_DBCNetWork_INTER1_9768a826_Tx
        CN_DBCNetWork_INTER1_c87d2dc2_Rx (CanIfHrhCfg): CanIfHrhSoftwareFilter=true, CanIfHrhCanCtrlIdRef=CT_DBCNetWork_INTER1_f93f8858, CanIfHrhIdSymRef=CN_DBCNetWork_INTER1_c87d2dc2_Rx
      Meg_FunDiag_Tp_oDBCNetWork_c3b25a60_Rx (CanIfRxPduCfg):
        CanIfRxPduCanId = 2015
        CanIfRxPduCanIdType = STANDARD_CAN
        CanIfRxPduDlc = 8
        CanIfRxPduUserRxIndicationName = CanTp_RxIndication
        CanIfRxPduUserRxIndicationType = PDUID_PDUINFOPTR
        CanIfRxPduUserRxIndicationUL = CAN_TP
        CanIfRxPduId = 2
        CanIfRxPduReadData = false
        CanIfRxPduReadNotifyStatus = false
        CanIfRxPduDlcCheck = true
        CanIfRxPduHrhIdRef = CN_DBCNetWork_b9b38c08_Rx_Meg_FunDiag
        CanIfRxPduRef = Meg_FunDiag_Tp_oDBCNetWork_1b821788_Rx
      Meg_PhyDiag_Tp_oDBCNetWork_a8746177_Rx (CanIfRxPduCfg):
        CanIfRxPduCanId = 1793
        CanIfRxPduCanIdType = STANDARD_CAN
        CanIfRxPduDlc = 8
        CanIfRxPduUserRxIndicationName = CanTp_RxIndication
        CanIfRxPduUserRxIndicationType = PDUID_PDUINFOPTR
        CanIfRxPduUserRxIndicationUL = CAN_TP
        CanIfRxPduId = 3
        CanIfRxPduReadData = false
        CanIfRxPduReadNotifyStatus = false
        CanIfRxPduDlcCheck = true
        CanIfRxPduHrhIdRef = CN_DBCNetWork_b9b38c08_Rx_Meg_PhyDiag
        CanIfRxPduRef = Meg_PhyDiag_Tp_oDBCNetWork_ff3be21a_Rx
      Meg_ResDiag_Tp_oDBCNetWork_d97dd71a_Tx (CanIfTxPduCfg):
        CanIfTxPduCanId = 1873
        CanIfTxPduCanIdType = STANDARD_CAN
        CanIfTxPduDlc = 8
        CanIfTxPduUserTxConfirmationName = CanTp_TxConfirmation
        CanIfTxPduUserTxConfirmationUL = CAN_TP
        CanIfTxPduId = 1
        CanIfTxPduReadNotifyStatus = false
        CanIfTxPduType = STATIC
        CanIfTxPduTruncation = true
        CanIfTxPduBufferRef = CHNL_50204034
        CanIfTxPduRef = Meg_ResDiag_Tp_oDBCNetWork_4a610c1c_Tx
      CHNL_50204034 (CanIfBufferCfg):
        CanIfBufferSize = 8
        CanIfTxBufferHandlingType = PRIO_BY_CANID
        CanIfTxBufferMappedTxPdus = 8
        CanIfTxBufferMaxPduLength = 8
        CanIfBufferHthRef = CN_DBCNetWork_05d62413_Tx
      Meg_NmTx_oDBCNetWork_c0e25960_Tx (CanIfTxPduCfg):
        CanIfTxPduCanId = 1537
        CanIfTxPduCanIdType = STANDARD_CAN
        CanIfTxPduDlc = 8
        CanIfTxPduUserTxConfirmationName = CanNm_TxConfirmation
        CanIfTxPduUserTxConfirmationUL = CAN_NM
        CanIfTxPduId = 2
        CanIfTxPduReadNotifyStatus = false
        CanIfTxPduType = STATIC
        CanIfTxPduTruncation = true
        CanIfTxPduBufferRef = CHNL_50204034
        CanIfTxPduRef = Meg_NmTx_oDBCNetWork_5d9e34f5_Tx
      SupD_Button_Control_oDBCNetWork_756613f9_Rx (CanIfRxPduCfg):
        CanIfRxPduCanId = 769
        CanIfRxPduCanIdType = STANDARD_CAN
        CanIfRxPduDataChecksumPdu = false
        CanIfRxPduDlc = 8
        CanIfRxPduUserRxIndicationName = PduR_CanIfRxIndication
        CanIfRxPduUserRxIndicationUL = PDUR
        CanIfRxPduId = 6
        CanIfRxPduReadData = false
        CanIfRxPduReadNotifyStatus = false
        CanIfRxPduDlcCheck = true
        CanIfRxPduHrhIdRef = CN_DBCNetWork_b9b38c08_Rx_SupD_Button_Control
        CanIfRxPduRef = SupD_Button_Control_oDBCNetWork_2fe6ff3f_Rx
      SupD_Led_Control_oDBCNetWork_060f240d_Rx (CanIfRxPduCfg):
        CanIfRxPduCanId = 768
        CanIfRxPduCanIdType = STANDARD_CAN
        CanIfRxPduDataChecksumPdu = false
        CanIfRxPduDlc = 8
        CanIfRxPduUserRxIndicationName = PduR_CanIfRxIndication
        CanIfRxPduUserRxIndicationUL = PDUR
        CanIfRxPduId = 7
        CanIfRxPduReadData = false
        CanIfRxPduReadNotifyStatus = false
        CanIfRxPduDlcCheck = true
        CanIfRxPduHrhIdRef = CN_DBCNetWork_b9b38c08_Rx_SupD_Led_Control
        CanIfRxPduRef = SupD_Led_Control_oDBCNetWork_36fcc7ec_Rx
      SupF_ComError_oDBCNetWork_bd5132c4_Tx (CanIfTxPduCfg):
        CanIfTxPduCanId = 534
        CanIfTxPduCanIdType = STANDARD_CAN
        CanIfTxPduDataChecksumPdu = false
        CanIfTxPduDlc = 8
        CanIfTxPduUserTxConfirmationName = NULL_PTR
        CanIfTxPduUserTxConfirmationUL = NONE
        CanIfTxPduId = 3
        CanIfTxPduReadNotifyStatus = false
        CanIfTxPduType = STATIC
        CanIfTxPduTruncation = true
        CanIfTxPduBufferRef = CHNL_50204034
        CanIfTxPduRef = SupF_ComError_oDBCNetWork_d2a44cd7_Tx
      XB_SUP_F_32c7cbd9_Rx (CanIfRxPduCfg):
        CanIfRxPduCanIdType = STANDARD_CAN
        CanIfRxPduDlc = 8
        CanIfRxPduUserRxIndicationName = CanNm_RxIndication
        CanIfRxPduUserRxIndicationUL = CAN_NM
        CanIfRxPduId = 1
        CanIfRxPduReadData = false
        CanIfRxPduReadNotifyStatus = false
        CanIfRxPduDlcCheck = true
        CanIfRxPduHrhIdRef = CN_DBCNetWork_88abbb7f_Rx
        CanIfRxPduRef = XB_SUP_F_7e0db49d_Rx
        CHNL_600db530 (CanIfRxPduCanIdRange): CanIfRxPduCanIdRangeLowerCanId=1536, CanIfRxPduCanIdRangeUpperCanId=1663
      SupF_Angle_oDBCNetWork_60dbbe7b_Tx (CanIfTxPduCfg):
        CanIfTxPduCanId = 531
        CanIfTxPduCanIdType = STANDARD_CAN
        CanIfTxPduDataChecksumPdu = false
        CanIfTxPduDlc = 8
        CanIfTxPduUserTxConfirmationName = NULL_PTR
        CanIfTxPduUserTxConfirmationUL = NONE
        CanIfTxPduId = 5
        CanIfTxPduReadNotifyStatus = false
        CanIfTxPduType = STATIC
        CanIfTxPduTruncation = true
        CanIfTxPduBufferRef = CHNL_50204034
        CanIfTxPduRef = SupF_Angle_oDBCNetWork_73452188_Tx
      SupE_Function_1_oDBCNetWork_3b86b9e4_Rx (CanIfRxPduCfg):
        CanIfRxPduCanId = 770
        CanIfRxPduCanIdType = STANDARD_CAN
        CanIfRxPduDataChecksumPdu = false
        CanIfRxPduDlc = 8
        CanIfRxPduUserRxIndicationName = PduR_CanIfRxIndication
        CanIfRxPduUserRxIndicationUL = PDUR
        CanIfRxPduId = 5
        CanIfRxPduReadData = false
        CanIfRxPduReadNotifyStatus = false
        CanIfRxPduDlcCheck = true
        CanIfRxPduHrhIdRef = CN_DBCNetWork_b9b38c08_Rx_SupC_Function_1
        CanIfRxPduRef = SupE_Function_1_oDBCNetWork_b8177f3a_Rx
      SupD_Led_CtrlMode_oDBCNetWork_fed16f5e_Rx (CanIfRxPduCfg):
        CanIfRxPduCanId = 772
        CanIfRxPduCanIdType = STANDARD_CAN
        CanIfRxPduDataChecksumPdu = false
        CanIfRxPduDlc = 8
        CanIfRxPduUserRxIndicationName = PduR_CanIfRxIndication
        CanIfRxPduUserRxIndicationUL = PDUR
        CanIfRxPduId = 4
        CanIfRxPduReadData = false
        CanIfRxPduReadNotifyStatus = false
        CanIfRxPduDlcCheck = true
        CanIfRxPduHrhIdRef = CN_DBCNetWork_b9b38c08_Rx_SupD_Led_CtrlMode
        CanIfRxPduRef = SupD_Led_CtrlMode_oDBCNetWork_8feda945_Rx
      4 x CanIfTxPduCfg, all with CanIfTxPduCanIdType=STANDARD_CAN, CanIfTxPduDataChecksumPdu=false, CanIfTxPduDlc=8, CanIfTxPduReadNotifyStatus=false, CanIfTxPduType=STATIC, CanIfTxPduTruncation=true, CanIfTxPduBufferRef=CHNL_50204034:
        SupF_PowerMode_oDBCNetWork_d7c50fc1_Tx: CanIfTxPduCanId=530, CanIfTxPduUserTxConfirmationName=NULL_PTR, CanIfTxPduUserTxConfirmationUL=NONE, CanIfTxPduId=6, CanIfTxPduRef=SupF_PowerMode_oDBCNetWork_9f0609f7_Tx
        SupF_Led_State_oDBCNetWork_fa0e29c4_Tx: CanIfTxPduCanId=528, CanIfTxPduUserTxConfirmationName=NULL_PTR, CanIfTxPduUserTxConfirmationUL=NONE, CanIfTxPduId=8, CanIfTxPduRef=SupF_Led_State_oDBCNetWork_e9fc4e73_Tx
        SupF_Button_State_oDBCNetWork_57b80545_Tx: CanIfTxPduCanId=529, CanIfTxPduUserTxConfirmationName=NULL_PTR, CanIfTxPduUserTxConfirmationUL=NONE, CanIfTxPduId=7, CanIfTxPduRef=SupF_Button_State_oDBCNetWork_4aab92e3_Tx
        SupF_Function_1_oDBCNetWork_e35ec372_Tx: CanIfTxPduCanId=532, CanIfTxPduUserTxConfirmationName=PduR_CanIfTxConfirmation, CanIfTxPduUserTxConfirmationUL=PDUR, CanIfTxPduId=4, CanIfTxPduRef=SupF_Function_1_oDBCNetWork_c66f379c_Tx
      CHNL_f7cbdede (CanIfBufferCfg):
        CanIfBufferSize = 0
        CanIfTxBufferHandlingType = NONE
        CanIfTxBufferMappedTxPdus = 1
        CanIfTxBufferMaxPduLength = 8
        CanIfBufferHthRef = CN_DBCNetWork_INTER1_9768a826_Tx
      INTER_RECEIVE_oDBCNetWork_INTER1_e9ebf6ca_Rx (CanIfRxPduCfg):
        CanIfRxPduCanId = 0
        CanIfRxPduCanIdType = STANDARD_CAN
        CanIfRxPduDlc = 8
        CanIfRxPduId = 0
        CanIfRxPduReadData = false
        CanIfRxPduReadNotifyStatus = false
        CanIfRxPduUserRxIndicationName = XB_INTER_CAN_RxIndication
        CanIfRxPduUserRxIndicationUL = CDD
        CanIfRxPduDlcCheck = true
        CanIfRxPduCanIdMask = 0
        CanIfRxPduHrhIdRef = CN_DBCNetWork_INTER1_c87d2dc2_Rx
        CanIfRxPduRef = INTER_RECEIVE_oDBCNetWork_INTER1_12d35b51_Rx
      INTER_SEND_oDBCNetWork_INTER1_c4764d88_Tx (CanIfTxPduCfg):
        CanIfTxPduCanId = 256
        CanIfTxPduCanIdType = STANDARD_CAN
        CanIfTxPduDlc = 8
        CanIfTxPduId = 0
        CanIfTxPduReadNotifyStatus = false
        CanIfTxPduType = STATIC
        CanIfTxPduUserTxConfirmationUL = CDD
        CanIfTxPduTruncation = true
        CanIfTxPduUserTxConfirmationName = XB_INTER_CAN_TxConfirm
        CanIfTxPduBufferRef = CHNL_f7cbdede
        CanIfTxPduRef = INTER_SEND_oDBCNetWork_INTER1_c9dc7871_Tx
    CanIfPrivateCfg:
      CanIfPrivateSoftwareFilterType = LINEAR
      CanIfPrivateDlcCheck = true
      CanIfSupportTTCAN = false
      CanIfTransceiverMapping = false
      CanIfTransceiverHandling = true
      CanIfSupportExtendedIds = false
      CanIfSupportNmOsek = false
      CanIfTxBufferType = BYTE_QUEUE
      CanIfOptimizeOneController = false
      CanIfWakeupSupport = true
      CanIfStaticFdTxBufferSupport = false
      CanIfRxSearchConsiderMsgType = false
      CanIfTxBufferFifoSupport = false
      CanIfSetPduReceptionModeSupport = false
      CanIfCheckWakeupCanRetType = false
      CanIfDataChecksumRxSupport = false
      CanIfDataChecksumTxSupport = false
      CanIfWakeupValidateAllRxMsgs = false
    CanIfPublicCfg:
      CanIfPublicPnSupport = false
      CanIfPublicCancelTransmitSupport = false
      CanIfPublicDevErrorDetect = true
      CanIfPublicHandleTypeEnum = UINT8
      CanIfPublicMultipleDrvSupport = false
      CanIfPublicNumberOfCanHwUnits = 1
      CanIfPublicReadRxPduDataApi = false
      CanIfPublicReadRxPduNotifyStatusApi = false
      CanIfPublicReadTxPduNotifyStatusApi = false
      CanIfPublicSetDynamicTxIdApi = false
      CanIfPublicTxBuffering = true
      CanIfPublicTxConfirmPollingSupport = false
      CanIfPublicVersionInfoApi = false
      CanIfPublicWakeupCheckValidSupport = true
      CanIfPnWakeupTxPduFilterSupport = false
      CanIfPnTrcvHandlingSupport = false
      CanIfJ1939DynAddrSupport = DISABLED
      CanIfSafeBswChecks = false
      CanIfBusMirroringSupport = false
      CanIfSetBaudrateApi = false
      CanIfPublicWakeupCheckValidByNM = true
      CanIfPublicCddHeaderFile = Cdd_Cbk.h
    CanIfTrcvDrvCfg
      CanIfTrcvCfg: CanIfTrcvId=0, CanIfTrcvWakeupSupport=true, CanIfTrcvCanTrcvRef=CanTrcvChannel
