AUTOSAR XML (schema 00046)
package /ActiveEcuC
  module config ComM: implementation-config-variant=VARIANT-PRE-COMPILE, module-description=ComM_Impl
    ComMGeneral:
      ComMPncIdCounting = COMM_PNC_ID_COUNT_FROM_NM_MESSAGE
      ComMPncSupport = false
      ComMDevErrorDetect = true
      ComMEcuGroupClassification = 3
      ComMModeLimitationEnabled = false
      ComMSynchronousWakeUp = false
      ComMTMinFullComModeDuration = 5
      ComMVersionInfoApi = false
      ComMWakeupInhibitionEnabled = false
      ComMSafeBswChecks = false
      ComMNmPassiveModeEnable = false
      ComMGeneration: ComMOutOfBoundsWriteSanitizer=false, ComMOutOfBoundsReadSanitizer=false
    ComMConfigSet: ComMPncEnabled=false
      CN_DBCNetWork_f94df0c8 (ComMUser): ComMUserIdentifier=0, ComMUserModeNotification=false
      CN_DBCNetWork_05d62413 (ComMChannel):
        ComMBusType = COMM_BUS_TYPE_CAN
        ComMChannelId = 0
        ComMFullCommRequestNotificationEnabled = false
        ComMMainFunctionPeriod = 0.005
        ComMNoCom = false
        ComMNoWakeup = false
        CN_DBCNetWork_ecd7f164 (ComMUserPerChannel): ComMUserChannel=CN_DBCNetWork_f94df0c8
        ComMNetworkManagement: ComMNmVariant=FULL, ComMPncNmRequest=false
      CN_DBCNetWork_INTER1_9768a826 (ComMChannel):
        ComMBusType = COMM_BUS_TYPE_CAN
        ComMChannelId = 1
        ComMFullCommRequestNotificationEnabled = false
        ComMMainFunctionPeriod = 0.005
        ComMNoCom = false
        ComMNoWakeup = false
        ComMNetworkManagement: ComMNmVariant=NONE, ComMPncNmRequest=false
        CN_DBCNetWork_INTER1_aa29c0bb (ComMUserPerChannel): ComMUserChannel=CN_DBCNetWork_INTER1_b99b6675
      CN_DBCNetWork_INTER1_b99b6675 (ComMUser): ComMUserIdentifier=1, ComMUserModeNotification=false
