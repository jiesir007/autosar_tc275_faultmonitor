AUTOSAR XML (schema 00046)
package /ActiveEcuC
  module config EcuC: implementation-config-variant=VARIANT-PRE-COMPILE, module-description=EcuC_Impl
    EcucPduCollection: PduIdTypeEnum=UINT8, PduLengthTypeEnum=UINT16
      33 x Pdu, all with J1939Requestable=false:
        Meg_ResDiag_oDBCNetWork_5467f8e5_Tx: PduLength=8
        Meg_FunDiag_oDBCNetWork_245e23dc_Rx: PduLength=7
        Meg_PhyDiag_oDBCNetWork_e94a8f4d_Rx: PduLength=8
        Meg_ResDiag_oDBCNetWork_1336e721_Tx: PduLength=8
        Meg_FunDiag_oDBCNetWork_8501a87a_Rx: PduLength=7
        Meg_PhyDiag_Tp_oDBCNetWork_ff3be21a_Rx: PduLength=8, SysTPduToFrameMappingRef=Meg_PhyDiag_Tp
        Meg_FunDiag_Tp_oDBCNetWork_1b821788_Rx: PduLength=8, SysTPduToFrameMappingRef=Meg_FunDiag_Tp
        Meg_NmTx_oDBCNetWork_5d9e34f5_Tx: PduLength=8, SysTPduToFrameMappingRef=Meg_NmTx
        Meg_ResDiag_Tp_oDBCNetWork_4a610c1c_Tx: PduLength=8, SysTPduToFrameMappingRef=Meg_ResDiag_Tp
        Meg_PhyDiag_oDBCNetWork_e154eea6_Rx: PduLength=8
        SupD_Button_Control_oDBCNetWork_2fe6ff3f_Rx: PduLength=8, SysTPduToFrameMappingRef=SupD_Button_Control
        SupF_PowerMode_oDBCNetWork_c1c74254_Tx: PduLength=8
        SupD_Button_Control_oDBCNetWork_09fc4743_Rx: PduLength=8
        SupD_Led_CtrlMode_oDBCNetWork_8feda945_Rx: PduLength=8, SysTPduToFrameMappingRef=SupD_Led_CtrlMode
        SupF_Function_1_oDBCNetWork_c66f379c_Tx: PduLength=8, SysTPduToFrameMappingRef=SupF_Function_1
        SupF_Function_1_oDBCNetWork_003f31ca_Tx: PduLength=8
        XB_SUP_F_7e0db49d_Rx: PduLength=8, SysTPduToFrameMappingRef=Meg_NmRx
        SupF_Led_State_oDBCNetWork_35eef7d2_Tx: PduLength=8
        SupD_Led_CtrlMode_oDBCNetWork_a6b9686f_Rx: PduLength=8
        SupF_ComError_oDBCNetWork_d2a44cd7_Tx: PduLength=8, SysTPduToFrameMappingRef=SupF_ComError
        SupF_ComError_oDBCNetWork_f4af97d3_Tx: PduLength=8
        SupD_Led_Control_oDBCNetWork_80cdf82b_Rx: PduLength=8
        SupF_Button_State_oDBCNetWork_e1c0e29d_Tx: PduLength=8
        SupF_Button_State_oDBCNetWork_4aab92e3_Tx: PduLength=8, SysTPduToFrameMappingRef=SupF_Button_State
        SupE_Function_1_oDBCNetWork_b8177f3a_Rx: PduLength=8, SysTPduToFrameMappingRef=SupE_Function_1
        SupF_Angle_oDBCNetWork_afae1504_Tx: PduLength=8
        SupD_Led_Control_oDBCNetWork_36fcc7ec_Rx: PduLength=8, SysTPduToFrameMappingRef=SupD_Led_Control
        SupE_Function_1_oDBCNetWork_582198e2_Rx: PduLength=8
        SupF_Angle_oDBCNetWork_73452188_Tx: PduLength=8, SysTPduToFrameMappingRef=SupF_Angle
        SupF_PowerMode_oDBCNetWork_9f0609f7_Tx: PduLength=8, SysTPduToFrameMappingRef=SupF_PowerMode
        SupF_Led_State_oDBCNetWork_e9fc4e73_Tx: PduLength=8, SysTPduToFrameMappingRef=SupF_Led_State
        INTER_SEND_oDBCNetWork_INTER1_c9dc7871_Tx: PduLength=8, SysTPduToFrameMappingRef=INTER_SEND
        INTER_RECEIVE_oDBCNetWork_INTER1_12d35b51_Rx: PduLength=8, SysTPduToFrameMappingRef=INTER_RECEIVE
    EcucGeneral:
      CPUType = CPU32Bit
      SizeOfInt = Size32Bit
      ByteOrder = LITTLE_ENDIAN
      BitOrder = LSB_to_MSB
      AtomicBitAccessInBitfield = false
      AtomicVariableAccess = Atomic32BitAccess
      SizeOfEnum = Size32Bit
      SizeOfROMPointer = Size32Bit
      SizeOfRAMPointer = Size32Bit
      BitFieldDataType = INT
      StructAlignment = Auto
      ArrayAlignment = Align8Bit
      StructInArrayAlignment = Auto
      DummyFunction = false
      EcuCSafeBswChecks = false
      DummyStatement = true
      DummyStatementKind = None
      ConditionalGenerating = true
      EcucBswImplementationCodeType = EcuCSourceCode
      EcuCUseStdReturnTypeForRte = false
      PostbuildLoadable: AlignmentFillPattern=255, PBROMStartAddress=0, PBRAMStartAddress=0, PBROMEndAddress=0, PBRAMEndAddress=0
      BswInitialization
        42 x InitFunction:
          BswM_InitMemory: Header=BswM.h, InitPhase=INIT_MEMORY, ModuleRef=BswM
          BswM_PreInit: Header=BswM.h, InitPhase=INIT_ONE, ConfigType=BswM_ConfigType, ConfigPtrName=BswM_Config_Ptr, ConfigPtrClass=BSWM_INIT_DATA, ModuleRef=BswM
          BswM_Init: Header=BswM.h, InitPhase=NO_INIT, ConfigType=BswM_ConfigType, ConfigPtrName=BswM_Config_Ptr, ConfigPtrClass=BSWM_INIT_DATA, ModuleRef=BswM
          CanIf_InitMemory: Header=CanIf.h, InitPhase=INIT_MEMORY, ModuleRef=CanIf
          CanIf_Init: Header=CanIf.h, InitPhase=INIT_TWO_IF, ConfigType=CanIf_ConfigType, ConfigPtrName=CanIf_Config_Ptr, ConfigPtrClass=CANIF_INIT_DATA, ModuleRef=CanIf
          CanNm_InitMemory: Header=CanNm.h, InitPhase=INIT_MEMORY, ModuleRef=CanNm
          CanNm_Init: Header=CanNm.h, InitPhase=INIT_TWO_NM, ConfigType=CanNm_ConfigType, ConfigPtrName=CanNm_Config_Ptr, ConfigPtrClass=CANNM_INIT_DATA, ModuleRef=CanNm
          CanSM_Init: Header=CanSM_EcuM.h, InitPhase=INIT_TWO_SM, ConfigType=CanSM_ConfigType, ConfigPtrName=CanSM_Config_Ptr, ConfigPtrClass=CANSM_INIT_DATA, ModuleRef=CanSM
          CanSM_InitMemory: Header=CanSM_EcuM.h, InitPhase=INIT_MEMORY, ModuleRef=CanSM
          Can_InitMemory: Header=Can.h, InitPhase=INIT_MEMORY, ModuleRef=Can
          Can_Init: Header=Can.h, InitPhase=INIT_TWO_DRV, ConfigType=Can_ConfigType, ConfigPtrName=Can_Config_Ptr, ConfigPtrClass=CAN_INIT_DATA, ModuleRef=Can
          ComM_Init: Header=ComM.h, InitPhase=INIT_TWO_POST_NVMREADALL, ModuleRef=ComM
          ComM_InitMemory: Header=ComM.h, InitPhase=INIT_MEMORY, ModuleRef=ComM
          Com_Init: Header=Com.h, InitPhase=INIT_TWO_COM, ConfigType=Com_ConfigType, ConfigPtrName=Com_Config_Ptr, ConfigPtrClass=COM_INIT_DATA, ModuleRef=Com
          Com_InitMemory: Header=Com.h, InitPhase=INIT_MEMORY, ModuleRef=Com
          Det_Init: Header=Det.h, InitPhase=INIT_ZERO, ConfigType=Det_ConfigType, ConfigPtrName=Det_Config_Ptr, ConfigPtrClass=DET_INIT_DATA, ModuleRef=Det
          Det_InitMemory: Header=Det.h, InitPhase=INIT_MEMORY, ModuleRef=Det
          EcuM_Init: Header=EcuM.h, InitPhase=NO_INIT, ConfigType=EcuM_PbConfigType, ConfigPtrName=EcuM_Config_Ptr, ConfigPtrClass=ECUM_INIT_DATA, ModuleRef=EcuM
          Nm_Init: Header=Nm.h, InitPhase=INIT_TWO_NM, ModuleRef=Nm
          Nm_InitMemory: Header=Nm.h, InitPhase=INIT_MEMORY, ModuleRef=Nm
          PduR_Init: Header=PduR.h, InitPhase=INIT_TWO_COM, ConfigType=PduR_PBConfigType, ConfigPtrName=PduR_Config_Ptr, ConfigPtrClass=PDUR_INIT_DATA, ModuleRef=PduR
          PduR_InitMemory: Header=PduR.h, InitPhase=INIT_MEMORY, ModuleRef=PduR
          Rte_InitMemory: Header=Rte_Main.h, InitPhase=INIT_MEMORY, ModuleRef=Rte
          Rte_Start: Header=Rte_Main.h, InitPhase=INIT_THREE, ModuleRef=Rte
          Rte_StartTiming: Header=Rte_Main.h, InitPhase=NO_INIT, ModuleRef=Rte
          SchM_Init: Header=Rte_Main.h, InitPhase=NO_INIT, ModuleRef=Rte
          Brs_Init: Header=, InitPhase=NO_INIT, ModuleRef=vBRS
          CanTp_Init: Header=CanTp.h, InitPhase=INIT_TWO_TP, ConfigType=CanTp_ConfigType, ConfigPtrName=CanTp_Config_Ptr, ConfigPtrClass=CANTP_INIT_DATA, ModuleRef=CanTp
          CanTp_InitMemory: Header=CanTp.h, InitPhase=INIT_MEMORY, ModuleRef=CanTp
          Dcm_Init: Header=Dcm.h, InitPhase=INIT_TWO_POST_NVMREADALL, ConfigType=Dcm_ConfigType, ConfigPtrName=NULL_PTR, ConfigPtrClass=DCM_CONST, ModuleRef=Dcm
          Dcm_InitMemory: Header=Dcm.h, InitPhase=INIT_MEMORY, ModuleRef=Dcm
          Dem_Init: Header=Dem.h, InitPhase=INIT_TWO_POST_NVMREADALL, ConfigType=Dem_ConfigType, ConfigPtrName=Dem_Config_Ptr, ConfigPtrClass=DEM_INIT_DATA, ModuleRef=Dem
          Dem_InitMemory: Header=Dem.h, InitPhase=INIT_MEMORY, ModuleRef=Dem
          Dem_PreInit: Header=Dem.h, InitPhase=INIT_ZERO, ConfigType=Dem_ConfigType, ConfigPtrName=Dem_Config_Ptr, ConfigPtrClass=DEM_INIT_DATA, ModuleRef=Dem
          CanTrcv_30_Tja1043_InitMemory: Header=CanTrcv_30_Tja1043.h, InitPhase=INIT_MEMORY, ModuleRef=CanTrcv
          CanTrcv_30_Tja1043_Init: Header=CanTrcv_30_Tja1043.h, InitPhase=INIT_TWO_TRCV, ConfigType=CanTrcv_30_Tja1043_ConfigType, ConfigPtrName=CanTrcv_30_Tja1043_Config_Ptr, ConfigPtrClass=CANTRCV_30_TJA1043_INIT_DATA, ModuleRef=CanTrcv
          IoHwAb_Init: Header=IoHwAb.h, InitPhase=INIT_TWO_POST_NVMREADALL, ModuleRef=IoHwAb
          Dio_Init: Header=Dio.h, InitPhase=INIT_ONE, ConfigType=Dio_ConfigType, ConfigPtrName=Dio_ConfigRoot, ConfigPtrClass=const, ModuleRef=Dio
          Icu_17_GtmCcu6_Init: Header=Icu_17_GtmCcu6.h, InitPhase=INIT_ONE_LATE, ConfigType=Icu_17_GtmCcu6_ConfigType, ConfigPtrName=Icu_ConfigRoot, ConfigPtrClass=const, ModuleRef=Icu
          Mcu_Init: Header=Mcu.h, InitPhase=INIT_ONE_EARLY, ConfigType=Mcu_ConfigType, ConfigPtrName=Mcu_ConfigRoot, ConfigPtrClass=const, AdditionalInitCode=Mcu_InitClock(0); while (MCU_PLL_LOCKED != Mcu_GetPllStatus()); Mcu_DistributePllClock();, ModuleRef=Mcu
          Port_Init: Header=Port.h, InitPhase=INIT_ONE_EARLY, ConfigType=Port_ConfigType, ConfigPtrName=Port_ConfigRoot, ConfigPtrClass=const, ModuleRef=Port
          Adc_Init: Header=Adc.h, InitPhase=INIT_ONE_LATE, ConfigType=Adc_ConfigType, ConfigPtrName=Adc_ConfigRoot, ConfigPtrClass=const, ModuleRef=Adc
    EcucHardware
      3 x EcucCoreDefinition:
        EcucCoreDefinition_Core{0..2}: EcucCoreId={0..2}
    EcucPartitionCollection
      3 x EcucPartition, all with EcucPartitionBswModuleExecution=false, PartitionCanBeRestarted=false:
        EcucPartition_ASILB_C1: ASIL=QM
        EcucPartition_ASILB_C0: ASIL=B
        EcucPartition_ASILB_C2: ASIL=B
