AUTOSAR XML (schema 00046)
package /ActiveEcuC
  module config Com: implementation-config-variant=VARIANT-PRE-COMPILE, module-description=Com_Impl
    ComGeneration:
      ComOutOfBoundsWriteProtectionStrategy = NONE
      ComOutOfBoundsWriteSanitizer = false
      ComOutOfBoundsReadSanitizer = false
      ComReduceConstantData2Define = false
      ComBoolDataInArrayOfStructStrategy = BOOLEAN
      ComDeduplicateIndirectedData = true
      ComDataDeduplicationStrategy = WITH_CAST
      ComReduceBoolDataByNegationThreshold = 2
      ComReduceBoolDataByNumericalComparisonThreshold = 2
      ComReduceBoolDataByNumericalRelationThreshold = 2
      ComReduceBoolDataByNumericalOperandStrategy = WITH_ANY_VALUE
      ComReduceNumericalDataByOffsetThreshold = 2
      ComReduceNumericalDataByArraySubtractionThreshold = 2
      ComReduceDataByStreaming = false
      ComShortSymbols = false
      ComInterfacesForDeactivatedData = false
      ComReferringKeysInComments = false
    ComOptimization:
      ComTxCyclicProcessingISRLockThreshold = 1
      ComTxDeadlineMonitoringISRLockThreshold = 1
      ComTxProcessingISRLockThreshold = 1
      ComRxDeadlineMonitoringISRLockThreshold = 1
      ComRxDeferredProcessingISRLockThreshold = 1
      ComGatewayProcessingISRLockThreshold = 1
      ComGatewayDescriptionProcessingISRLockThreshold = 1
      ComIPduGroupISRLockThreshold = 1
    ComConfig: ComConfigurationId=0, ComRxDeferredNotificationCacheSize=0, ComRxImmediateNotificationCacheSize=0
      ComTimeBase: ComRxTimeBase=0.005, ComTxTimeBase=0.005, ComGwTimeBase=0.005
      SG_Sig_Grp_0x304_oSupD_Led_CtrlMode_oDBCNetWork_663125ab_Rx (ComSignalGroup): ComTimeout=0, ComTransferProperty=PENDING, ComSignalGroupAccess=ACCESS_UNCLEAR, ComHandleId=3, ComSystemTemplateSignalGroupRef=SG_Sig_Grp_0x304
        6 x ComGroupSignal, all with ComSignalEndianness=BIG_ENDIAN, ComSignalInitValue=0, ComSignalType=UINT8, ComSignalAccess=ACCESS_UNCLEAR:
          D_Led1_CtrlMode_oSupD_Led_CtrlMode_oDBCNetWork_e2fdf3e9_Rx: ComBitPosition=11, ComBitSize=4, ComHandleId=13, ComSystemTemplateSystemSignalRef=D_Led1_CtrlMode
          D_Led2_CtrlMode_oSupD_Led_CtrlMode_oDBCNetWork_01b4444b_Rx: ComBitPosition=19, ComBitSize=4, ComHandleId=14, ComSystemTemplateSystemSignalRef=D_Led2_CtrlMode
          SupD_Counter_0x304_oSupD_Led_CtrlMode_oDBCNetWork_9ab89d28_Rx: ComBitPosition=59, ComBitSize=4, ComHandleId=18, ComSystemTemplateSystemSignalRef=SupD_Counter_0x304
          D_Led3_CtrlMode_oSupD_Led_CtrlMode_oDBCNetWork_e9a3d4ea_Rx: ComBitPosition=27, ComBitSize=4, ComHandleId=15, ComSystemTemplateSystemSignalRef=D_Led3_CtrlMode
          D_Led4_CtrlMode_oSupD_Led_CtrlMode_oDBCNetWork_1c562d4e_Rx: ComBitPosition=35, ComBitSize=4, ComHandleId=16, ComSystemTemplateSystemSignalRef=D_Led4_CtrlMode
          SupD_Checksum_0x304_oSupD_Led_CtrlMode_oDBCNetWork_984004db_Rx: ComBitPosition=7, ComBitSize=8, ComHandleId=17, ComSystemTemplateSystemSignalRef=SupD_Checksum_0x304
      SG_Sig_Grp_0x210_oSupF_Led_State_oDBCNetWork_ec44dd46_Tx (ComSignalGroup): ComTransferProperty=PENDING, ComSignalGroupAccess=ACCESS_UNCLEAR, ComHandleId=0, ComSystemTemplateSignalGroupRef=SG_Sig_Grp_0x210
        4 x ComGroupSignal, all with ComBitSize=2, ComSignalEndianness=BIG_ENDIAN, ComSignalInitValue=0, ComSignalType=UINT8, ComTransferProperty=PENDING, ComSignalAccess=ACCESS_UNCLEAR:
          F_Led1_State_oSupF_Led_State_oDBCNetWork_8a0569d2_Tx: ComBitPosition=1, ComHandleId=0, ComSystemTemplateSystemSignalRef=F_Led1_State
          F_Led3_State_oSupF_Led_State_oDBCNetWork_ce484003_Tx: ComBitPosition=17, ComHandleId=2, ComSystemTemplateSystemSignalRef=F_Led3_State
          F_Led4_State_oSupF_Led_State_oDBCNetWork_cd012db8_Tx: ComBitPosition=25, ComHandleId=3, ComSystemTemplateSystemSignalRef=F_Led4_State
          F_Led2_State_oSupF_Led_State_oDBCNetWork_01d657cb_Tx: ComBitPosition=9, ComHandleId=1, ComSystemTemplateSystemSignalRef=F_Led2_State
      SupD_Led_CtrlMode_oDBCNetWork_a6b9686f_Rx (ComIPdu):
        ComIPduDirection = RECEIVE
        ComIPduType = NORMAL
        ComIPduHandleId = 2
        ComIPduSignalProcessing = DEFERRED
        ComIPduCancellationSupport = false
        ComIPduGroupRef = XB_SUP_F_oDBCNetWork_Rx_2e39ec3a
        ComIPduSignalGroupRef = SG_Sig_Grp_0x304_oSupD_Led_CtrlMode_oDBCNetWork_663125ab_Rx
        ComPduIdRef = SupD_Led_CtrlMode_oDBCNetWork_a6b9686f_Rx
      SupD_Led_Control_oDBCNetWork_80cdf82b_Rx (ComIPdu):
        ComIPduDirection = RECEIVE
        ComIPduType = NORMAL
        ComIPduHandleId = 1
        ComIPduSignalProcessing = DEFERRED
        ComIPduCancellationSupport = false
        ComIPduGroupRef = XB_SUP_F_oDBCNetWork_Rx_2e39ec3a
        ComIPduSignalGroupRef = SG_Sig_Grp_0x300_oSupD_Led_Control_oDBCNetWork_89733210_Rx
        ComPduIdRef = SupD_Led_Control_oDBCNetWork_80cdf82b_Rx
      SG_Sig_Grp_0x213_oSupF_Angle_oDBCNetWork_3c68f302_Tx (ComSignalGroup): ComTransferProperty=PENDING, ComSignalGroupAccess=ACCESS_UNCLEAR, ComHandleId=3, ComSystemTemplateSignalGroupRef=SG_Sig_Grp_0x213
        F_AAA_Angle_oSupF_Angle_oDBCNetWork_d35fb591_Tx (ComGroupSignal):
          ComBitPosition = 7
          ComBitSize = 8
          ComSignalEndianness = BIG_ENDIAN
          ComSignalInitValue = 36
          ComSignalType = UINT8
          ComTransferProperty = PENDING
          ComSignalAccess = ACCESS_UNCLEAR
          ComHandleId = 11
          ComSystemTemplateSystemSignalRef = F_AAA_Angle
      SG_Sig_Grp_0x214_oSupF_Function_1_oDBCNetWork_0607409d_Tx (ComSignalGroup): ComTransferProperty=TRIGGERED, ComSignalGroupAccess=ACCESS_UNCLEAR, ComHandleId=4, ComSystemTemplateSignalGroupRef=SG_Sig_Grp_0x214
        4 x ComGroupSignal, all with ComBitSize=16, ComSignalEndianness=BIG_ENDIAN, ComSignalInitValue=0, ComSignalType=UINT16, ComTransferProperty=PENDING, ComSignalAccess=ACCESS_UNCLEAR:
          F_Sig_0x214_Used_3_oSupF_Function_1_oDBCNetWork_b325274e_Tx: ComBitPosition=39, ComHandleId=14, ComSystemTemplateSystemSignalRef=F_Sig_0x214_Used_3
          F_Sig_0x214_Used_1_oSupF_Function_1_oDBCNetWork_cbe4e15e_Tx: ComBitPosition=7, ComHandleId=12, ComSystemTemplateSystemSignalRef=F_Sig_0x214_Used_1
          F_Sig_0x214_Used_2_oSupF_Function_1_oDBCNetWork_8f45c446_Tx: ComBitPosition=23, ComHandleId=13, ComSystemTemplateSystemSignalRef=F_Sig_0x214_Used_2
          F_Sig_0x214_Used_5_oSupF_Function_1_oDBCNetWork_3a676d7e_Tx: ComBitPosition=55, ComHandleId=15, ComSystemTemplateSystemSignalRef=F_Sig_0x214_Used_5
      XB_SUP_F_oDBCNetWork_Tx_78634bbc (ComIPduGroup): ComIPduGroupHandleId=1
      SG_Sig_Grp_0x300_oSupD_Led_Control_oDBCNetWork_89733210_Rx (ComSignalGroup): ComTimeout=0, ComTransferProperty=PENDING, ComSignalGroupAccess=ACCESS_UNCLEAR, ComHandleId=0, ComSystemTemplateSignalGroupRef=SG_Sig_Grp_0x300
        6 x ComGroupSignal, all with ComSignalEndianness=BIG_ENDIAN, ComSignalType=UINT8, ComSignalAccess=ACCESS_UNCLEAR:
          D_Led3_Control_oSupD_Led_Control_oDBCNetWork_a9ae0ad1_Rx: ComBitPosition=13, ComBitSize=2, ComSignalInitValue=2, ComHandleId=2, ComSystemTemplateSystemSignalRef=D_Led3_Control
          D_Led4_Control_oSupD_Led_Control_oDBCNetWork_9b603ecf_Rx: ComBitPosition=15, ComBitSize=2, ComSignalInitValue=2, ComHandleId=3, ComSystemTemplateSystemSignalRef=D_Led4_Control
          D_Led2_Control_oSupD_Led_Control_oDBCNetWork_e7270178_Rx: ComBitPosition=11, ComBitSize=2, ComSignalInitValue=2, ComHandleId=1, ComSystemTemplateSystemSignalRef=D_Led2_Control
          SupD_Checksum_0x300_oSupD_Led_Control_oDBCNetWork_2c493488_Rx: ComBitPosition=7, ComBitSize=8, ComSignalInitValue=0, ComHandleId=4, ComSystemTemplateSystemSignalRef=SupD_Checksum_0x300
          D_Led1_Control_oSupD_Led_Control_oDBCNetWork_34bc1d83_Rx: ComBitPosition=9, ComBitSize=2, ComSignalInitValue=2, ComHandleId=0, ComSystemTemplateSystemSignalRef=D_Led1_Control
          SupD_Counter_0x300_oSupD_Led_Control_oDBCNetWork_b943cd4b_Rx: ComBitPosition=59, ComBitSize=4, ComSignalInitValue=0, ComHandleId=5, ComSystemTemplateSystemSignalRef=SupD_Counter_0x300
      SG_Sig_Grp_0x212_oSupF_PowerMode_oDBCNetWork_de62da88_Tx (ComSignalGroup): ComTransferProperty=PENDING, ComSignalGroupAccess=ACCESS_UNCLEAR, ComHandleId=2, ComSystemTemplateSignalGroupRef=SG_Sig_Grp_0x212
        3 x ComGroupSignal, all with ComSignalEndianness=BIG_ENDIAN, ComSignalInitValue=0, ComSignalType=UINT8, ComTransferProperty=PENDING, ComSignalAccess=ACCESS_UNCLEAR:
          SupF_Counter_0x212_oSupF_PowerMode_oDBCNetWork_35c7002c_Tx: ComBitPosition=59, ComBitSize=4, ComHandleId=10, ComSystemTemplateSystemSignalRef=SupF_Counter_0x212
          F_PowerMode_oSupF_PowerMode_oDBCNetWork_16d1a370_Tx: ComBitPosition=19, ComBitSize=4, ComHandleId=8, ComSystemTemplateSystemSignalRef=F_PowerMode
          SupF_Checksum_0x212_oSupF_PowerMode_oDBCNetWork_8c3e64a3_Tx: ComBitPosition=7, ComBitSize=8, ComHandleId=9, ComSystemTemplateSystemSignalRef=SupF_Checksum_0x212
      4 x ComIPdu, all with ComIPduDirection=SEND, ComIPduType=NORMAL, ComIPduSignalProcessing=DEFERRED, ComIPduCancellationSupport=false, ComIPduGroupRef=XB_SUP_F_oDBCNetWork_Tx_78634bbc:
        SupF_Angle_oDBCNetWork_afae1504_Tx: ComIPduHandleId=0, ComIPduSignalGroupRef=SG_Sig_Grp_0x213_oSupF_Angle_oDBCNetWork_3c68f302_Tx, ComPduIdRef=SupF_Angle_oDBCNetWork_afae1504_Tx
          ComTxIPdu: ComMinimumDelayTime=0, ComTxIPduUnusedAreasDefault=0
            ComTxModeTrue
              ComTxMode: ComTxModeMode=PERIODIC, ComTxModeTimeOffset=0, ComTxModeTimePeriod=0.01
            ComTxModeFalse
              ComTxMode: ComTxModeMode=PERIODIC, ComTxModeTimeOffset=0, ComTxModeTimePeriod=0.01
        SupF_ComError_oDBCNetWork_f4af97d3_Tx: ComIPduHandleId=2, ComIPduSignalGroupRef=SG_Sig_Grp_0x216_oSupF_ComError_oDBCNetWork_8d63d174_Tx, ComPduIdRef=SupF_ComError_oDBCNetWork_f4af97d3_Tx
          ComTxIPdu: ComMinimumDelayTime=0, ComTxIPduUnusedAreasDefault=0
            ComTxModeTrue
              ComTxMode: ComTxModeMode=PERIODIC, ComTxModeTimeOffset=0, ComTxModeTimePeriod=0.01
            ComTxModeFalse
              ComTxMode: ComTxModeMode=PERIODIC, ComTxModeTimeOffset=0, ComTxModeTimePeriod=0.01
        SupF_Function_1_oDBCNetWork_003f31ca_Tx: ComIPduHandleId=3, ComIPduSignalGroupRef=SG_Sig_Grp_0x214_oSupF_Function_1_oDBCNetWork_0607409d_Tx, ComPduIdRef=SupF_Function_1_oDBCNetWork_003f31ca_Tx
          ComTxIPdu: ComMinimumDelayTime=0, ComTxIPduUnusedAreasDefault=0
            ComTxModeTrue
              ComTxMode: ComTxModeMode=DIRECT, ComTxModeTimeOffset=0, ComTxModeTimePeriod=0.02, ComTxModeNumberOfRepetitions=2, ComTxModeRepetitionPeriod=0.02
            ComTxModeFalse
              ComTxMode: ComTxModeMode=PERIODIC, ComTxModeTimeOffset=0, ComTxModeTimePeriod=0.02
        SupF_Led_State_oDBCNetWork_35eef7d2_Tx: ComIPduHandleId=4, ComIPduSignalGroupRef=SG_Sig_Grp_0x210_oSupF_Led_State_oDBCNetWork_ec44dd46_Tx, ComPduIdRef=SupF_Led_State_oDBCNetWork_35eef7d2_Tx
          ComTxIPdu: ComMinimumDelayTime=0, ComTxIPduUnusedAreasDefault=0
            ComTxModeTrue
              ComTxMode: ComTxModeMode=PERIODIC, ComTxModeTimeOffset=0, ComTxModeTimePeriod=0.1
            ComTxModeFalse
              ComTxMode: ComTxModeMode=PERIODIC, ComTxModeTimeOffset=0, ComTxModeTimePeriod=0.1
      SG_Sig_Grp_0x302_oSupE_Function_1_oDBCNetWork_28664efe_Rx (ComSignalGroup): ComTimeout=0, ComTransferProperty=PENDING, ComSignalGroupAccess=ACCESS_UNCLEAR, ComHandleId=2, ComSystemTemplateSignalGroupRef=SG_Sig_Grp_0x302
        3 x ComGroupSignal, all with ComSignalEndianness=BIG_ENDIAN, ComSignalInitValue=0, ComSignalAccess=ACCESS_UNCLEAR:
          E_Sig_0x302_Used_2_oSupE_Function_1_oDBCNetWork_1b13f84a_Rx: ComBitPosition=23, ComBitSize=8, ComSignalType=UINT8, ComHandleId=11, ComSystemTemplateSystemSignalRef=E_Sig_0x302_Used_2
          E_Sig_0x302_Used_3_oSupE_Function_1_oDBCNetWork_27731b42_Rx: ComBitPosition=31, ComBitSize=8, ComSignalType=UINT8, ComHandleId=12, ComSystemTemplateSystemSignalRef=E_Sig_0x302_Used_3
          E_Sig_0x302_Used_1_oSupE_Function_1_oDBCNetWork_5fb2dd52_Rx: ComBitPosition=7, ComBitSize=16, ComSignalType=UINT16, ComHandleId=10, ComSystemTemplateSystemSignalRef=E_Sig_0x302_Used_1
      SupD_Button_Control_oDBCNetWork_09fc4743_Rx (ComIPdu):
        ComIPduDirection = RECEIVE
        ComIPduType = NORMAL
        ComIPduHandleId = 0
        ComIPduSignalProcessing = DEFERRED
        ComIPduCancellationSupport = false
        ComIPduGroupRef = XB_SUP_F_oDBCNetWork_Rx_2e39ec3a
        ComIPduSignalGroupRef = SG_Sig_Grp_0x301_oSupD_Button_Control_oDBCNetWork_188cbd42_Rx
        ComPduIdRef = SupD_Button_Control_oDBCNetWork_09fc4743_Rx
      SupE_Function_1_oDBCNetWork_582198e2_Rx (ComIPdu):
        ComIPduDirection = RECEIVE
        ComIPduType = NORMAL
        ComIPduHandleId = 3
        ComIPduSignalProcessing = DEFERRED
        ComIPduCancellationSupport = false
        ComIPduGroupRef = XB_SUP_F_oDBCNetWork_Rx_2e39ec3a
        ComIPduSignalGroupRef = SG_Sig_Grp_0x302_oSupE_Function_1_oDBCNetWork_28664efe_Rx
        ComPduIdRef = SupE_Function_1_oDBCNetWork_582198e2_Rx
      XB_SUP_F_oDBCNetWork_Rx_2e39ec3a (ComIPduGroup): ComIPduGroupHandleId=0
      SG_Sig_Grp_0x216_oSupF_ComError_oDBCNetWork_8d63d174_Tx (ComSignalGroup): ComTransferProperty=PENDING, ComSignalGroupAccess=ACCESS_UNCLEAR, ComHandleId=5, ComSystemTemplateSignalGroupRef=SG_Sig_Grp_0x216
        F_Meg_E2E_Error_oSupF_ComError_oDBCNetWork_edc11637_Tx (ComGroupSignal):
          ComBitPosition = 15
          ComBitSize = 8
          ComSignalEndianness = BIG_ENDIAN
          ComSignalInitValue = 0
          ComSignalType = UINT8
          ComTransferProperty = PENDING
          ComSignalAccess = ACCESS_UNCLEAR
          ComHandleId = 16
          ComSystemTemplateSystemSignalRef = F_Meg_E2E_Error
        F_Mes_Lost_Error_oSupF_ComError_oDBCNetWork_72d68791_Tx (ComGroupSignal):
          ComBitPosition = 7
          ComBitSize = 8
          ComSignalEndianness = BIG_ENDIAN
          ComSignalInitValue = 0
          ComSignalType = UINT8
          ComTransferProperty = PENDING
          ComSignalAccess = ACCESS_UNCLEAR
          ComHandleId = 17
          ComSystemTemplateSystemSignalRef = F_Mes_Lost_Error
      SG_Sig_Grp_0x301_oSupD_Button_Control_oDBCNetWork_188cbd42_Rx (ComSignalGroup): ComTimeout=0, ComTransferProperty=PENDING, ComSignalGroupAccess=ACCESS_UNCLEAR, ComHandleId=1, ComSystemTemplateSignalGroupRef=SG_Sig_Grp_0x301
        4 x ComGroupSignal, all with ComBitSize=2, ComSignalEndianness=BIG_ENDIAN, ComSignalInitValue=0, ComSignalType=UINT8, ComSignalAccess=ACCESS_UNCLEAR:
          D_Button3_Control_oSupD_Button_Control_oDBCNetWork_651cf15f_Rx: ComBitPosition=17, ComHandleId=8, ComSystemTemplateSystemSignalRef=D_Button3_Control
          D_Button2_Control_oSupD_Button_Control_oDBCNetWork_c42575b1_Rx: ComBitPosition=9, ComHandleId=7, ComSystemTemplateSystemSignalRef=D_Button2_Control
          D_Button1_Control_oSupD_Button_Control_oDBCNetWork_fc1efec2_Rx: ComBitPosition=1, ComHandleId=6, ComSystemTemplateSystemSignalRef=D_Button1_Control
          D_Button4_Control_oSupD_Button_Control_oDBCNetWork_b4526357_Rx: ComBitPosition=25, ComHandleId=9, ComSystemTemplateSystemSignalRef=D_Button4_Control
      SupF_Button_State_oDBCNetWork_e1c0e29d_Tx (ComIPdu):
        ComIPduDirection = SEND
        ComIPduType = NORMAL
        ComIPduHandleId = 1
        ComIPduSignalProcessing = DEFERRED
        ComIPduCancellationSupport = false
        ComIPduGroupRef = XB_SUP_F_oDBCNetWork_Tx_78634bbc
        ComIPduSignalGroupRef = SG_Sig_Grp_0x211_oSupF_Button_State_oDBCNetWork_b368711c_Tx
        ComPduIdRef = SupF_Button_State_oDBCNetWork_e1c0e29d_Tx
        ComTxIPdu: ComMinimumDelayTime=0, ComTxIPduUnusedAreasDefault=0
          ComTxModeTrue
            ComTxMode: ComTxModeMode=PERIODIC, ComTxModeTimeOffset=0, ComTxModeTimePeriod=0.05
          ComTxModeFalse
            ComTxMode: ComTxModeMode=PERIODIC, ComTxModeTimeOffset=0, ComTxModeTimePeriod=0.05
      SG_Sig_Grp_0x211_oSupF_Button_State_oDBCNetWork_b368711c_Tx (ComSignalGroup): ComTransferProperty=PENDING, ComSignalGroupAccess=ACCESS_UNCLEAR, ComHandleId=1, ComSystemTemplateSignalGroupRef=SG_Sig_Grp_0x211
        4 x ComGroupSignal, all with ComBitSize=3, ComSignalEndianness=BIG_ENDIAN, ComSignalInitValue=0, ComSignalType=UINT8, ComTransferProperty=PENDING, ComSignalAccess=ACCESS_UNCLEAR:
          F_Button4_State_oSupF_Button_State_oDBCNetWork_7d23a980_Tx: ComBitPosition=21, ComHandleId=7, ComSystemTemplateSystemSignalRef=F_Button4_State
          F_Button2_State_oSupF_Button_State_oDBCNetWork_e6f3a94e_Tx: ComBitPosition=5, ComHandleId=5, ComSystemTemplateSystemSignalRef=F_Button2_State
          F_Button1_State_oSupF_Button_State_oDBCNetWork_ab1ba929_Tx: ComBitPosition=2, ComHandleId=4, ComSystemTemplateSystemSignalRef=F_Button1_State
          F_Button3_State_oSupF_Button_State_oDBCNetWork_6b7b54ac_Tx: ComBitPosition=13, ComHandleId=6, ComSystemTemplateSystemSignalRef=F_Button3_State
      SupF_PowerMode_oDBCNetWork_c1c74254_Tx (ComIPdu):
        ComIPduDirection = SEND
        ComIPduType = NORMAL
        ComIPduHandleId = 5
        ComIPduSignalProcessing = DEFERRED
        ComIPduCancellationSupport = false
        ComIPduGroupRef = XB_SUP_F_oDBCNetWork_Tx_78634bbc
        ComIPduSignalGroupRef = SG_Sig_Grp_0x212_oSupF_PowerMode_oDBCNetWork_de62da88_Tx
        ComPduIdRef = SupF_PowerMode_oDBCNetWork_c1c74254_Tx
        ComTxIPdu: ComMinimumDelayTime=0, ComTxIPduUnusedAreasDefault=0
          ComTxModeTrue
            ComTxMode: ComTxModeMode=PERIODIC, ComTxModeTimeOffset=0, ComTxModeTimePeriod=0.1
          ComTxModeFalse
            ComTxMode: ComTxModeMode=PERIODIC, ComTxModeTimeOffset=0, ComTxModeTimePeriod=0.1
    ComGeneral:
      ComConfigurationUseDet = true
      ComSafeBswChecks = false
      ComEnableSignalGroupArrayApi = false
      ComRetryFailedTransmitRequests = false
      ComSupportedIPduGroups = 2
      ComVersionInfoApi = false
      ComAdvancedIPduCallouts = true
      ComOptimizedIPduGroupHandling = false
      ComMetaDataSupport = false
      ComReceiveSignalMacroAPI = false
      ComDeferredEventCacheSupport = false
      ComMainfunctionTimingDomainSupport = false
      ComSignalGateway = false
      ComDescriptionGateway = false
      ComDescriptionRoutingCodeGeneration = false
