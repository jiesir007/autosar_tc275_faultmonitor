AUTOSAR XML (schema 00046)
package /ActiveEcuC
  module config PduR: implementation-config-variant=VARIANT-PRE-COMPILE, module-description=PduR_Impl
    PduRGeneral:
      PduRDevErrorDetect = true
      PduRVersionInfoApi = false
      PduRMetaDataSupport = false
      PduRPduCallback = false
      PduRSwitching = false
      PduRSafeBswChecks = false
      PduREnableDeferredTransmission = false
      PduREnableDeferredReception = false
      PduRSupportMulticore = false
      PduRRoutingTypeGateway = false
      PduRGeneration:
        PduROutOfBoundsWriteProtectionStrategy = NONE
        PduROutOfBoundsWriteSanitizer = false
        PduROutOfBoundsReadSanitizer = false
        PduRNumericalDataTypeMinimizationStrategy = WITH_CAST
        PduRReduceConstantData2Define = false
        PduRBoolDataInArrayOfStructStrategy = BITMASKING
        PduRDeduplicateIndirectedData = true
        PduRDataDeduplicationStrategy = WITH_CAST
        PduRReduceBoolDataByNegationThreshold = 2
        PduRReduceBoolDataByNumericalComparisonThreshold = 2
        PduRReduceBoolDataByNumericalRelationThreshold = 2
        PduRReduceBoolDataByNumericalOperandStrategy = WITH_ANY_VALUE
        PduRReduceNumericalDataByOffsetThreshold = 2
        PduRReduceNumericalDataByArraySubtractionThreshold = 2
        PduRReduceDataByStreaming = false
        PduRShortSymbols = false
        PduRInterfacesForDeactivatedData = false
        PduRReferringKeysInComments = false
    PduRRoutingTables: PduRConfigurationId=0
      PduRRoutingTable
        13 x PduRRoutingPath, all with PduRMulticoreRoutingPath=false, PduRLockRef=PduRLock_PduRExclusiveArea:
          Meg_ResDiag_oDBCNetWork_5467f8e5_Tx: PduRRoutingPathCommunicationType=TRANSPORT_PROTOCOL
            Meg_ResDiag_oDBCNetWork_1336e721_Tx (PduRDestPdu):
              PduRDestPduHandleId = 0
              PduRDestPduDirection = TRANSMIT
              PduRDestPduRoutingType = API_FORWARDING
              PduRDestPduDataProcessing = IMMEDIATE
              PduRPduLengthHandlingStrategy = UNUSED
              PduRDestPduRef = Meg_ResDiag_oDBCNetWork_1336e721_Tx
              PduRDestPduPduRBswModulesRef = CanTp
            PduRSrcPdu_9c32056b (PduRSrcPdu): PduRSourcePduHandleId=0, PduRSrcPduDirection=TRANSMIT, PduRSrcPduRef=Meg_ResDiag_oDBCNetWork_5467f8e5_Tx, PduRSrcPduPduRBswModulesRef=Dcm
          Meg_FunDiag_oDBCNetWork_245e23dc_Rx: PduRRoutingPathCommunicationType=TRANSPORT_PROTOCOL
            Meg_FunDiag_oDBCNetWork_245e23dc_Rx_1af6dabd_Rx (PduRDestPdu):
              PduRDestPduHandleId = 0
              PduRDestPduDirection = RECEIVE
              PduRDestPduRoutingType = API_FORWARDING
              PduRDestPduDataProcessing = IMMEDIATE
              PduRPduLengthHandlingStrategy = UNUSED
              PduRDestPduRef = Meg_FunDiag_oDBCNetWork_8501a87a_Rx
              PduRDestPduPduRBswModulesRef = Dcm
            PduRSrcPdu_1af6dabd (PduRSrcPdu): PduRSourcePduHandleId=0, PduRSrcPduDirection=RECEIVE, PduRSrcPduRef=Meg_FunDiag_oDBCNetWork_245e23dc_Rx, PduRSrcPduPduRBswModulesRef=CanTp
          Meg_PhyDiag_oDBCNetWork_e94a8f4d_Rx: PduRRoutingPathCommunicationType=TRANSPORT_PROTOCOL
            Meg_PhyDiag_oDBCNetWork_e94a8f4d_Rx_49b2840e_Rx (PduRDestPdu):
              PduRDestPduHandleId = 1
              PduRDestPduDirection = RECEIVE
              PduRDestPduRoutingType = API_FORWARDING
              PduRDestPduDataProcessing = IMMEDIATE
              PduRPduLengthHandlingStrategy = UNUSED
              PduRDestPduRef = Meg_PhyDiag_oDBCNetWork_e154eea6_Rx
              PduRDestPduPduRBswModulesRef = Dcm
            PduRSrcPdu_49b2840e (PduRSrcPdu): PduRSourcePduHandleId=1, PduRSrcPduDirection=RECEIVE, PduRSrcPduRef=Meg_PhyDiag_oDBCNetWork_e94a8f4d_Rx, PduRSrcPduPduRBswModulesRef=CanTp
          SupF_Angle_oDBCNetWork_afae1504_Tx: PduRRoutingPathCommunicationType=COMMUNICATION_INTERFACE
            SupF_Angle_oDBCNetWork_73452188_Tx (PduRDestPdu):
              PduRDestPduHandleId = 0
              PduRDestPduDirection = TRANSMIT
              PduRDestPduRoutingType = API_FORWARDING
              PduRDestPduDataProcessing = IMMEDIATE
              PduRPduLengthHandlingStrategy = UNUSED
              PduRTransmissionConfirmation = false
              PduRDestPduDataProvision = PDUR_DIRECT
              PduRDestPduRef = SupF_Angle_oDBCNetWork_73452188_Tx
              PduRDestPduPduRBswModulesRef = CanIf
            PduRSrcPdu_735ccce2 (PduRSrcPdu): PduRSourcePduHandleId=1, PduRSrcPduDirection=TRANSMIT, PduRSrcPduRef=SupF_Angle_oDBCNetWork_afae1504_Tx, PduRSrcPduPduRBswModulesRef=Com
          SupF_PowerMode_oDBCNetWork_c1c74254_Tx: PduRRoutingPathCommunicationType=COMMUNICATION_INTERFACE
            PduRSrcPdu_7cf5c8f1 (PduRSrcPdu): PduRSourcePduHandleId=6, PduRSrcPduDirection=TRANSMIT, PduRSrcPduRef=SupF_PowerMode_oDBCNetWork_c1c74254_Tx, PduRSrcPduPduRBswModulesRef=Com
            SupF_PowerMode_oDBCNetWork_9f0609f7_Tx (PduRDestPdu):
              PduRDestPduHandleId = 5
              PduRDestPduDirection = TRANSMIT
              PduRDestPduRoutingType = API_FORWARDING
              PduRDestPduDataProcessing = IMMEDIATE
              PduRPduLengthHandlingStrategy = UNUSED
              PduRTransmissionConfirmation = false
              PduRDestPduDataProvision = PDUR_DIRECT
              PduRDestPduRef = SupF_PowerMode_oDBCNetWork_9f0609f7_Tx
              PduRDestPduPduRBswModulesRef = CanIf
          SupD_Led_CtrlMode_oDBCNetWork_8feda945_Rx: PduRRoutingPathCommunicationType=COMMUNICATION_INTERFACE
            PduRSrcPdu_dde6d85a (PduRSrcPdu): PduRSourcePduHandleId=2, PduRSrcPduDirection=RECEIVE, PduRSrcPduRef=SupD_Led_CtrlMode_oDBCNetWork_8feda945_Rx, PduRSrcPduPduRBswModulesRef=CanIf
            SupD_Led_CtrlMode_oDBCNetWork_8feda945_Rx_dde6d85a_Rx (PduRDestPdu):
              PduRDestPduHandleId = 2
              PduRDestPduDirection = RECEIVE
              PduRDestPduRoutingType = API_FORWARDING
              PduRDestPduDataProcessing = IMMEDIATE
              PduRPduLengthHandlingStrategy = UNUSED
              PduRTransmissionConfirmation = false
              PduRDestPduRef = SupD_Led_CtrlMode_oDBCNetWork_a6b9686f_Rx
              PduRDestPduPduRBswModulesRef = Com
          SupF_Function_1_oDBCNetWork_003f31ca_Tx: PduRRoutingPathCommunicationType=COMMUNICATION_INTERFACE
            SupF_Function_1_oDBCNetWork_c66f379c_Tx (PduRDestPdu):
              PduRDestPduHandleId = 3
              PduRDestPduDirection = TRANSMIT
              PduRDestPduRoutingType = API_FORWARDING
              PduRDestPduDataProcessing = IMMEDIATE
              PduRPduLengthHandlingStrategy = UNUSED
              PduRDestPduDataProvision = PDUR_DIRECT
              PduRTransmissionConfirmation = true
              PduRDestPduRef = SupF_Function_1_oDBCNetWork_c66f379c_Tx
              PduRDestPduPduRBswModulesRef = CanIf
            PduRSrcPdu_866e7b89 (PduRSrcPdu): PduRSourcePduHandleId=4, PduRSrcPduDirection=TRANSMIT, PduRSrcPduRef=SupF_Function_1_oDBCNetWork_003f31ca_Tx, PduRSrcPduPduRBswModulesRef=Com
          SupF_Led_State_oDBCNetWork_35eef7d2_Tx: PduRRoutingPathCommunicationType=COMMUNICATION_INTERFACE
            SupF_Led_State_oDBCNetWork_e9fc4e73_Tx (PduRDestPdu):
              PduRDestPduHandleId = 4
              PduRDestPduDirection = TRANSMIT
              PduRDestPduRoutingType = API_FORWARDING
              PduRDestPduDataProcessing = IMMEDIATE
              PduRPduLengthHandlingStrategy = UNUSED
              PduRTransmissionConfirmation = false
              PduRDestPduDataProvision = PDUR_DIRECT
              PduRDestPduRef = SupF_Led_State_oDBCNetWork_e9fc4e73_Tx
              PduRDestPduPduRBswModulesRef = CanIf
            PduRSrcPdu_74524a59 (PduRSrcPdu): PduRSourcePduHandleId=5, PduRSrcPduDirection=TRANSMIT, PduRSrcPduRef=SupF_Led_State_oDBCNetWork_35eef7d2_Tx, PduRSrcPduPduRBswModulesRef=Com
          SupF_Button_State_oDBCNetWork_e1c0e29d_Tx: PduRRoutingPathCommunicationType=COMMUNICATION_INTERFACE
            PduRSrcPdu_59d653d2 (PduRSrcPdu): PduRSourcePduHandleId=2, PduRSrcPduDirection=TRANSMIT, PduRSrcPduRef=SupF_Button_State_oDBCNetWork_e1c0e29d_Tx, PduRSrcPduPduRBswModulesRef=Com
            SupF_Button_State_oDBCNetWork_4aab92e3_Tx (PduRDestPdu):
              PduRDestPduHandleId = 1
              PduRDestPduDirection = TRANSMIT
              PduRDestPduRoutingType = API_FORWARDING
              PduRDestPduDataProcessing = IMMEDIATE
              PduRPduLengthHandlingStrategy = UNUSED
              PduRTransmissionConfirmation = false
              PduRDestPduDataProvision = PDUR_DIRECT
              PduRDestPduRef = SupF_Button_State_oDBCNetWork_4aab92e3_Tx
              PduRDestPduPduRBswModulesRef = CanIf
          SupF_ComError_oDBCNetWork_f4af97d3_Tx: PduRRoutingPathCommunicationType=COMMUNICATION_INTERFACE
            PduRSrcPdu_eb554e6b (PduRSrcPdu): PduRSourcePduHandleId=3, PduRSrcPduDirection=TRANSMIT, PduRSrcPduRef=SupF_ComError_oDBCNetWork_f4af97d3_Tx, PduRSrcPduPduRBswModulesRef=Com
            SupF_ComError_oDBCNetWork_d2a44cd7_Tx (PduRDestPdu):
              PduRDestPduHandleId = 2
              PduRDestPduDirection = TRANSMIT
              PduRDestPduRoutingType = API_FORWARDING
              PduRDestPduDataProcessing = IMMEDIATE
              PduRPduLengthHandlingStrategy = UNUSED
              PduRTransmissionConfirmation = false
              PduRDestPduDataProvision = PDUR_DIRECT
              PduRDestPduRef = SupF_ComError_oDBCNetWork_d2a44cd7_Tx
              PduRDestPduPduRBswModulesRef = CanIf
          SupE_Function_1_oDBCNetWork_b8177f3a_Rx: PduRRoutingPathCommunicationType=COMMUNICATION_INTERFACE
            SupE_Function_1_oDBCNetWork_b8177f3a_Rx_ed7c8ba9_Rx (PduRDestPdu):
              PduRDestPduHandleId = 3
              PduRDestPduDirection = RECEIVE
              PduRDestPduRoutingType = API_FORWARDING
              PduRDestPduDataProcessing = IMMEDIATE
              PduRPduLengthHandlingStrategy = UNUSED
              PduRTransmissionConfirmation = false
              PduRDestPduRef = SupE_Function_1_oDBCNetWork_582198e2_Rx
              PduRDestPduPduRBswModulesRef = Com
            PduRSrcPdu_ed7c8ba9 (PduRSrcPdu): PduRSourcePduHandleId=3, PduRSrcPduDirection=RECEIVE, PduRSrcPduRef=SupE_Function_1_oDBCNetWork_b8177f3a_Rx, PduRSrcPduPduRBswModulesRef=CanIf
          SupD_Led_Control_oDBCNetWork_36fcc7ec_Rx: PduRRoutingPathCommunicationType=COMMUNICATION_INTERFACE
            SupD_Led_Control_oDBCNetWork_36fcc7ec_Rx_9f4997ea_Rx (PduRDestPdu):
              PduRDestPduHandleId = 1
              PduRDestPduDirection = RECEIVE
              PduRDestPduRoutingType = API_FORWARDING
              PduRDestPduDataProcessing = IMMEDIATE
              PduRPduLengthHandlingStrategy = UNUSED
              PduRTransmissionConfirmation = false
              PduRDestPduRef = SupD_Led_Control_oDBCNetWork_80cdf82b_Rx
              PduRDestPduPduRBswModulesRef = Com
            PduRSrcPdu_9f4997ea (PduRSrcPdu): PduRSourcePduHandleId=1, PduRSrcPduDirection=RECEIVE, PduRSrcPduRef=SupD_Led_Control_oDBCNetWork_36fcc7ec_Rx, PduRSrcPduPduRBswModulesRef=CanIf
          SupD_Button_Control_oDBCNetWork_2fe6ff3f_Rx: PduRRoutingPathCommunicationType=COMMUNICATION_INTERFACE
            PduRSrcPdu_c1d3fa7d (PduRSrcPdu): PduRSourcePduHandleId=0, PduRSrcPduDirection=RECEIVE, PduRSrcPduRef=SupD_Button_Control_oDBCNetWork_2fe6ff3f_Rx, PduRSrcPduPduRBswModulesRef=CanIf
            SupD_Button_Control_oDBCNetWork_2fe6ff3f_Rx_c1d3fa7d_Rx (PduRDestPdu):
              PduRDestPduHandleId = 0
              PduRDestPduDirection = RECEIVE
              PduRDestPduRoutingType = API_FORWARDING
              PduRDestPduDataProcessing = IMMEDIATE
              PduRPduLengthHandlingStrategy = UNUSED
              PduRTransmissionConfirmation = false
              PduRDestPduRef = SupD_Button_Control_oDBCNetWork_09fc4743_Rx
              PduRDestPduPduRBswModulesRef = Com
      PduRLock_PduRExclusiveArea (PduRLock)
        PduRExclusiveArea: PduRExclusiveAreaId=0
    4 x PduRBswModules, all with PduRCancelReceive=false, PduRCancelTransmit=false, PduRChangeParameterRequestApi=false, PduRTriggertransmit=false:
      CanIf: PduRCommunicationInterface=true, PduRLowerModule=true, PduRTransportProtocol=false, PduRTxConfirmation=true, PduRUpperModule=false, PduRUseTag=false, PduRBswModuleRef=CanIf
      CanTp: PduRCommunicationInterface=false, PduRLowerModule=true, PduRTransportProtocol=true, PduRTxConfirmation=false, PduRUpperModule=false, PduRUseTag=false, PduRBswModuleRef=CanTp
      Com: PduRCommunicationInterface=true, PduRLowerModule=false, PduRTransportProtocol=false, PduRTxConfirmation=true, PduRUpperModule=true, PduRUseTag=false, PduRBswModuleRef=Com
      Dcm: PduRCommunicationInterface=false, PduRLowerModule=false, PduRTransportProtocol=true, PduRTxConfirmation=false, PduRUpperModule=true, PduRUseTag=true, PduRBswModuleRef=Dcm
