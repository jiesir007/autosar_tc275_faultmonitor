AUTOSAR XML (schema 00046)
package /ActiveEcuC
  module config Os: implementation-config-variant=VARIANT-PRE-COMPILE, module-description=Os_Impl
    OsPublishedInformation: OsKernelVersion=7, OsPlatformName=TriCoreAurix
      TC27x (OsDerivativeInformation):
        OsMpuAlignment = 8
        OsMpuMemoryGapSize = 16
        OsMpuEndAddressAccessible = false
        OsStackAlignment = 8
        OsExceptionVectorTableAlignment = 32
        OsInterruptVectorTableAlignment = 32
        OsHardwareManuals = User Manual: tc27xD_um_v2.2_UserManual_rev2v2_2014-12.pdf V2.2 Errata Sheet: TC27x_BC_Errata_Sheet_rev1v5_2015_09_16.pdf V1.5 Safety Manual: AURIX Safety Manual_3.pdf V1.3 2015-09
        3 x OsHardwareTimer, all with OsHardwareTimerSize=32, OsHardwareTimerUnit=FRT, OsHardwareTimerType=STM:
          STM0: OsHardwareTimerBaseAddress=4026531840, OsHardwareTimerId=0
            STM0_Ch0 (OsHardwareTimerChannel): OsHardwareTimerChannelIntSource=1168, OsHardwareTimerChannelOffset=0, OsHardwareTimerChannelId=0
            STM0_Ch1 (OsHardwareTimerChannel): OsHardwareTimerChannelIntSource=1172, OsHardwareTimerChannelOffset=1, OsHardwareTimerChannelId=1
          STM2: OsHardwareTimerBaseAddress=4026532352, OsHardwareTimerId=2
            STM2_Ch0 (OsHardwareTimerChannel): OsHardwareTimerChannelIntSource=1184, OsHardwareTimerChannelOffset=0, OsHardwareTimerChannelId=0
            STM2_Ch1 (OsHardwareTimerChannel): OsHardwareTimerChannelIntSource=1188, OsHardwareTimerChannelOffset=1, OsHardwareTimerChannelId=1
          STM1: OsHardwareTimerBaseAddress=4026532096, OsHardwareTimerId=1
            STM1_Ch0 (OsHardwareTimerChannel): OsHardwareTimerChannelIntSource=1176, OsHardwareTimerChannelOffset=0, OsHardwareTimerChannelId=0
            STM1_Ch1 (OsHardwareTimerChannel): OsHardwareTimerChannelIntSource=1180, OsHardwareTimerChannelOffset=1, OsHardwareTimerChannelId=1
        OsMemoryRegionDefault_AppNT (OsMemoryRegionDefaults): OsMemoryRegionDefType=APPLICATION_NONTRUSTED, OsMemoryRegionDefIdentifier=1, OsMemoryRegionDefAccessRights=PS1_W
        DMA (OsInterruptSupportedType): OsInterruptSupportedTypeSeparateSources=false, OsInterruptSupportedTypeSeparatePriority=true
        DEFAULT (OsInterruptSupportedType): OsInterruptSupportedTypeSeparateSources=false, OsInterruptSupportedTypeSeparatePriority=false
        GPT (OsHardwareTimer): OsHardwareTimerSize=16, OsHardwareTimerUnit=PIT, OsHardwareTimerBaseAddress=4026543616, OsHardwareTimerId=0, OsHardwareTimerType=PIT
          GPT_Ch0 (OsHardwareTimerChannel): OsHardwareTimerChannelIntSource=1128, OsHardwareTimerChannelOffset=0, OsHardwareTimerChannelId=0
          GPT_Ch1 (OsHardwareTimerChannel): OsHardwareTimerChannelIntSource=1140, OsHardwareTimerChannelOffset=1, OsHardwareTimerChannelId=1
        Core0 (OsPhysicalCore):
          OsPhysicalCoreId = 0
          OsPhysicalCoreDefaultEntrySymbol = _start_tc0
          OsPhysicalCoreType = TC1.6.1E
          OsPhysicalCoreExceptionSources = 8
          OsPhysicalCoreMasterStartAllowed = true
          OsPhysicalCorePrivelegedHwAccess = true
          OsPhysicalCoreIsAutostart = true
          OsPhysicalCoreStackProtectionUnit = OsPhysicalCore0DataMpu
          OsPhysicalCore0DataMpu (OsPhysicalCoreMpu): OsPhysicalCoreMpuId=0, OsPhysicalCoreMpuMaxRegions=16, OsPhysicalCoreMpuType=DATA
          OsPhysicalCore0CodeMpu (OsPhysicalCoreMpu): OsPhysicalCoreMpuId=1, OsPhysicalCoreMpuMaxRegions=8, OsPhysicalCoreMpuType=CODE
        AURIXTC2XX_IR (OsSystemIntCtrl): OsSystemIntCtrlMaxPrios=255, OsSystemIntCtrlPrioOrder=ASC, OsSystemIntCtrlMaxSources=8192, OsSystemIntCtrlBaseAddress=4026757120
        Core1 (OsPhysicalCore):
          OsPhysicalCoreId = 1
          OsPhysicalCoreDefaultEntrySymbol = _start_tc1
          OsPhysicalCoreType = TC1.6.1P
          OsPhysicalCoreExceptionSources = 8
          OsPhysicalCoreMasterStartAllowed = false
          OsPhysicalCorePrivelegedHwAccess = true
          OsPhysicalCoreIsAutostart = false
          OsPhysicalCoreStackProtectionUnit = OsPhysicalCore1DataMpu
          OsPhysicalCore1DataMpu (OsPhysicalCoreMpu): OsPhysicalCoreMpuId=0, OsPhysicalCoreMpuMaxRegions=16, OsPhysicalCoreMpuType=DATA
          OsPhysicalCore1CodeMpu (OsPhysicalCoreMpu): OsPhysicalCoreMpuId=1, OsPhysicalCoreMpuMaxRegions=8, OsPhysicalCoreMpuType=CODE
        OsMemoryRegionDefault_AppT (OsMemoryRegionDefaults): OsMemoryRegionDefType=APPLICATION_TRUSTED, OsMemoryRegionDefIdentifier=0, OsMemoryRegionDefAccessRights=PS0_W
        Core2 (OsPhysicalCore):
          OsPhysicalCoreId = 2
          OsPhysicalCoreDefaultEntrySymbol = _start_tc2
          OsPhysicalCoreType = TC1.6.1P
          OsPhysicalCoreExceptionSources = 8
          OsPhysicalCoreMasterStartAllowed = false
          OsPhysicalCorePrivelegedHwAccess = true
          OsPhysicalCoreIsAutostart = false
          OsPhysicalCoreStackProtectionUnit = OsPhysicalCore2DataMpu
          OsPhysicalCore2DataMpu (OsPhysicalCoreMpu): OsPhysicalCoreMpuId=0, OsPhysicalCoreMpuMaxRegions=16, OsPhysicalCoreMpuType=DATA
          OsPhysicalCore2CodeMpu (OsPhysicalCoreMpu): OsPhysicalCoreMpuId=1, OsPhysicalCoreMpuMaxRegions=8, OsPhysicalCoreMpuType=CODE
        OsMemoryRegionSpecifics
          12 x OsMemoryRegionAccess:
            PS2_R: OsMemoryRegionAccessRights=R, OsMemoryRegionAccessType=PROTECTION_SET2
            PS3_R: OsMemoryRegionAccessRights=R, OsMemoryRegionAccessType=PROTECTION_SET3
            PS0_W: OsMemoryRegionAccessRights=W, OsMemoryRegionAccessType=PROTECTION_SET0
            PS0_R: OsMemoryRegionAccessRights=R, OsMemoryRegionAccessType=PROTECTION_SET0
            PS1_R: OsMemoryRegionAccessRights=R, OsMemoryRegionAccessType=PROTECTION_SET1
            PS0_X: OsMemoryRegionAccessRights=X, OsMemoryRegionAccessType=PROTECTION_SET0
            PS1_W: OsMemoryRegionAccessRights=W, OsMemoryRegionAccessType=PROTECTION_SET1
            PS1_X: OsMemoryRegionAccessRights=X, OsMemoryRegionAccessType=PROTECTION_SET1
            PS2_W: OsMemoryRegionAccessRights=W, OsMemoryRegionAccessType=PROTECTION_SET2
            PS2_X: OsMemoryRegionAccessRights=X, OsMemoryRegionAccessType=PROTECTION_SET2
            PS3_W: OsMemoryRegionAccessRights=W, OsMemoryRegionAccessType=PROTECTION_SET3
            PS3_X: OsMemoryRegionAccessRights=X, OsMemoryRegionAccessType=PROTECTION_SET3
    OS_APPMODE_ANY (OsAppMode)
    OSDEFAULTAPPMODE (OsAppMode)
    OsOS:
      OsStackMonitoring = true
      OsStatus = EXTENDED
      OsUseGetServiceId = false
      OsUseParameterAccess = false
      OsUseResScheduler = false
      OsForcibleTermination = false
      OsGenerateCalloutStubs = true
      OsGenerateMemMap = COMPLETE
      OsGenerateMemMapForNearAddressing = true
      OsGenerateMemMapForThreads = false
      OsServiceProtection = false
      OsStackUsageMeasurement = false
      OsUseXSignalAsyncApiCalls = false
      OsFpuUsage = NONE
      OsScalabilityClass = SC1
      OsNumberOfCores = 3
      OsMasterCore = OsCore0
      OsSystemTimer = SystemTimer_Core0
      OsStackSummary
        23 x OsStack, all with OsStackSize=1024:
          OsCore0_Error: OsStackType=CORE_ERROR_STACK, OsStackCore=OsCore0, OsStackUser=OsCore0
          OsCore0_Init: OsStackType=CORE_INIT_STACK, OsStackCore=OsCore0, OsStackUser=OsCore0
          OsCore0_Kernel: OsStackType=CORE_KERNEL_STACK, OsStackCore=OsCore0, OsStackUser=OsCore0
          OsCore0_Isr_Core: OsStackType=ISR_SHARED_CORE_STACK, OsStackCore=OsCore0, OsStackUser=CounterIsr_SystemTimer_Core0, OsStackUser=XSignalIsr_OsCore0, OsStackUser=CanIsr_1, OsStackUser=GTMTIM2SR7_ISR, OsStackUser=ADC0SR1_ISR
          OsCore0_Task_Prio4294967295: OsStackType=TASK_SHARED_PRIORITY_STACK, OsStackCore=OsCore0, OsStackUser=IdleTask_OsCore0
          OsCore1_Task_Prio4294967295: OsStackType=TASK_SHARED_PRIORITY_STACK, OsStackCore=OsCore1, OsStackUser=IdleTask_OsCore1
          OsCore1_Error: OsStackType=CORE_ERROR_STACK, OsStackCore=OsCore1, OsStackUser=OsCore1
          OsCore1_Init: OsStackType=CORE_INIT_STACK, OsStackCore=OsCore1, OsStackUser=OsCore1
          OsCore1_Kernel: OsStackType=CORE_KERNEL_STACK, OsStackCore=OsCore1, OsStackUser=OsCore1
          OsCore1_Isr_Core: OsStackType=ISR_SHARED_CORE_STACK, OsStackCore=OsCore1, OsStackUser=XSignalIsr_OsCore1, OsStackUser=CounterIsr_SystemTimer_Core1, OsStackUser=CanIsr_0
          OsCore2_Error: OsStackType=CORE_ERROR_STACK, OsStackCore=OsCore2, OsStackUser=OsCore2
          OsCore2_Init: OsStackType=CORE_INIT_STACK, OsStackCore=OsCore2, OsStackUser=OsCore2
          OsCore2_Kernel: OsStackType=CORE_KERNEL_STACK, OsStackCore=OsCore2, OsStackUser=OsCore2
          OsCore2_Task_Prio4294967295: OsStackType=TASK_SHARED_PRIORITY_STACK, OsStackCore=OsCore2, OsStackUser=IdleTask_OsCore2
          OsCore2_Isr_Core: OsStackType=ISR_SHARED_CORE_STACK, OsStackCore=OsCore2, OsStackUser=XSignalIsr_OsCore2, OsStackUser=CounterIsr_SystemTimer_Core2
          OsTask_App10ms_Core1: OsStackType=TASK_EXTENDED_STACK, OsStackCore=OsCore1, OsStackUser=Os/OsTask_App10ms_Core1
          OsTask_App10ms_Core2: OsStackType=TASK_EXTENDED_STACK, OsStackCore=OsCore2, OsStackUser=Os/OsTask_App10ms_Core2
          OsCore1_Task_Prio50: OsStackType=TASK_SHARED_PRIORITY_STACK, OsStackCore=OsCore1, OsStackUser=Default_Init_Task_Core1
          OsCore2_Task_Prio50: OsStackType=TASK_SHARED_PRIORITY_STACK, OsStackCore=OsCore2, OsStackUser=Default_Init_Task_Core2
          OsCore0_Task_Prio30: OsStackType=TASK_SHARED_PRIORITY_STACK, OsStackCore=OsCore0, OsStackUser=Default_Init_Task
          OsCore0_Task_Prio50: OsStackType=TASK_SHARED_PRIORITY_STACK, OsStackCore=OsCore0, OsStackUser=OsTask_App_Init_Task
          OsTask_Bsw5ms_Core0: OsStackType=TASK_EXTENDED_STACK, OsStackCore=OsCore0, OsStackUser=Os/OsTask_Bsw5ms_Core0
          OsCore0_Task_Prio34: OsStackType=TASK_SHARED_PRIORITY_STACK, OsStackCore=OsCore0, OsStackUser=OsTask_App10ms_Core0
      OsHooks: OsErrorHook=true, OsPostTaskHook=false, OsPreTaskHook=false, OsShutdownHook=false, OsStartupHook=false
    SystemTimer_Core0 (OsCounter):
      OsCounterMaxAllowedValue = 1073741823
      OsCounterMinCycle = 1
      OsCounterType = HARDWARE
      OsSecondsPerTick = 0.001
      OsCounterTicksPerBase = 80000
      OsCounterAccessingApplication = SystemApplication_OsCore{0..2}
      OsDriver: OsDriverHighResolution=false, OsDriverHardwareTimerChannelRef=STM0_Ch0, OsDriverIsrRef=CounterIsr_SystemTimer_Core0
    OsCore0 (OsCore):
      OsCoreIsAutostart = true
      OsCoreIsAutosar = true
      OsCoreEntrySymbol = _start_tc0
      OsCorePhysicalCoreRef = Core0
      OsCoreIdleTask = IdleTask_OsCore0
      OsCoreSystemApplication = SystemApplication_OsCore0
      OsCoreEcucCoreRef = EcucCoreDefinition_Core0
      OsCoreStacks:
        OsCoreKernelStackSize = 1024
        OsCoreStartupStackSize = 1024
        OsCoreShutdownStackSize = 1024
        OsCoreErrorStackSize = 1024
        OsCoreProtectionStackSize = 1024
        OsCoreInitStackSize = 1024
      XSignalChl_OsCore1 (OsCoreXSignalChannel): OsCoreXSignalChannelSize=1, OsCoreXSignalChannelReceiverIsr=XSignalIsr_OsCore1
      XSignalChl_OsCore2 (OsCoreXSignalChannel): OsCoreXSignalChannelSize=1, OsCoreXSignalChannelReceiverIsr=XSignalIsr_OsCore2
    IdleTask_OsCore0 (OsTask):
      OsTaskActivation = 1
      OsTaskPriority = 4294967295
      OsTaskSchedule = FULL
      OsTaskStackSharing = false
      OsTaskStackSize = 1024
      OsTaskType = AUTO
      OsTaskUsesFpu = false
      OsTaskAccessingApplication = SystemApplication_OsCore{0..2}
      OsTaskAutostart: OsTaskAppModeRef=OS_APPMODE_ANY
    SystemApplication_OsCore0 (OsApplication):
      OsTrusted = true
      OsTrustedApplicationDelayTimingViolationCall = false
      OsTrustedApplicationWithProtection = false
      OsApplicationIsPrivileged = true
      OsAppUseTrustedFunctionStubs = false
      OsAppCounterRef = SystemTimer_Core0
      OsAppTaskRef = IdleTask_OsCore0
      OsAppIsrRef = CounterIsr_SystemTimer_Core0
      OsApplicationCoreRef = EcucCoreDefinition_Core0
      OsAppIsrRef = XSignalIsr_OsCore0
      OsAppTaskRef = OsTask_App10ms_Core0
      OsAppEcucPartitionRef = EcucPartition_ASILB_C0
      OsAppTaskRef = Default_Init_Task
      OsAppIsrRef = CanIsr_1
      OsAppTaskRef = OsTask_App_Init_Task
      OsAppIsrRef = GTMTIM2SR7_ISR
      OsAppTaskRef = Os/OsTask_Bsw5ms_Core0
      OsAppAlarmRef = Rte_Al_TE2_OsTask_Bsw5ms_Core0_0_5ms
      OsAppAlarmRef = Rte_Al_TE_IoHwAb_IoHwAb_IoHwAbRunnable
      OsAppAlarmRef = Rte_Al_TE_OsTask_App10ms_Core0_0_10ms
      OsAppScheduleTableRef = OsScheduleTable
      OsAppIsrRef = ADC0SR1_ISR
      OsApplicationHooks: OsAppErrorHook=false, OsAppShutdownHook=false, OsAppStartupHook=false
    CounterIsr_SystemTimer_Core0 (OsIsr):
      OsIsrCategory = CATEGORY_2
      OsIsrInterruptType = EXTERNAL
      OsIsrInterruptSource = 1168
      OsIsrInterruptPriority = 23
      OsIsrStackSize = 1024
      OsIsrEnableNesting = false
      OsIsrUsesFpu = false
      OsIsrInitialEnableInterruptSource = false
      OsIsrSpecialFunctionName = Os_TimerPfrtIsr
    OsCore1 (OsCore):
      OsCoreIsAutostart = false
      OsCoreIsAutosar = true
      OsCoreEntrySymbol = _start_tc1
      OsCorePhysicalCoreRef = Core1
      OsCoreEcucCoreRef = EcucCoreDefinition_Core1
      OsCoreIdleTask = IdleTask_OsCore1
      OsCoreSystemApplication = SystemApplication_OsCore1
      OsCoreStacks:
        OsCoreKernelStackSize = 1024
        OsCoreStartupStackSize = 1024
        OsCoreShutdownStackSize = 1024
        OsCoreErrorStackSize = 1024
        OsCoreProtectionStackSize = 1024
        OsCoreInitStackSize = 1024
      XSignalChl_OsCore0 (OsCoreXSignalChannel): OsCoreXSignalChannelSize=1, OsCoreXSignalChannelReceiverIsr=XSignalIsr_OsCore0
      XSignalChl_OsCore2 (OsCoreXSignalChannel): OsCoreXSignalChannelSize=1, OsCoreXSignalChannelReceiverIsr=XSignalIsr_OsCore2
    IdleTask_OsCore1 (OsTask):
      OsTaskActivation = 1
      OsTaskPriority = 4294967295
      OsTaskSchedule = FULL
      OsTaskStackSharing = false
      OsTaskStackSize = 1024
      OsTaskType = AUTO
      OsTaskUsesFpu = false
      OsTaskAccessingApplication = SystemApplication_OsCore{0..2}
      OsTaskAutostart: OsTaskAppModeRef=OS_APPMODE_ANY
    SystemApplication_OsCore1 (OsApplication):
      OsTrusted = true
      OsTrustedApplicationDelayTimingViolationCall = false
      OsTrustedApplicationWithProtection = false
      OsApplicationIsPrivileged = true
      OsAppUseTrustedFunctionStubs = false
      OsApplicationCoreRef = EcucCoreDefinition_Core1
      OsAppTaskRef = IdleTask_OsCore1
      OsAppIsrRef = XSignalIsr_OsCore1
      OsAppCounterRef = SystemTimer_Core1
      OsAppIsrRef = CounterIsr_SystemTimer_Core1
      OsAppTaskRef = Os/OsTask_App10ms_Core1
      OsAppEcucPartitionRef = EcucPartition_ASILB_C1
      OsAppAlarmRef = Rte_Al_TE2_EcuM_EcuM_MainFunction
      OsAppTaskRef = Default_Init_Task_Core1
      OsAppAlarmRef = Rte_Al_TE_AppCtrl1_AppCtrl1_MainFuntion
      OsAppIsrRef = CanIsr_0
      OsApplicationHooks: OsAppErrorHook=false, OsAppShutdownHook=false, OsAppStartupHook=false
    XSignalIsr_OsCore0 (OsIsr):
      OsIsrCategory = CATEGORY_2
      OsIsrInterruptType = EXTERNAL
      OsIsrInterruptSource = 4096
      OsIsrInterruptPriority = 22
      OsIsrStackSize = 1024
      OsIsrEnableNesting = false
      OsIsrUsesFpu = false
      OsIsrInitialEnableInterruptSource = false
      OsIsrSpecialFunctionName = Os_XSigRecvIsrHandler
      OsIsrXSignalReceiver:
        OsIsrXSignalReceiverProvidedApis = ShutdownAllCores
        OsIsrXSignalReceiverProvidedApis = ActivateTask
        OsIsrXSignalReceiverProvidedApis = CancelAlarm
        OsIsrXSignalReceiverProvidedApis = ChainTask
        OsIsrXSignalReceiverProvidedApis = ControlIdle
        OsIsrXSignalReceiverProvidedApis = GetAlarm
        OsIsrXSignalReceiverProvidedApis = GetApplicationState
        OsIsrXSignalReceiverProvidedApis = GetCounterValue
        OsIsrXSignalReceiverProvidedApis = GetElapsedValue
        OsIsrXSignalReceiverProvidedApis = GetErrorHookStackUsage
        OsIsrXSignalReceiverProvidedApis = GetEvent
        OsIsrXSignalReceiverProvidedApis = GetISRStackUsage
        OsIsrXSignalReceiverProvidedApis = GetKernelStackUsage
        OsIsrXSignalReceiverProvidedApis = GetProtectionHookStackUsage
        OsIsrXSignalReceiverProvidedApis = GetScheduleTableStatus
        OsIsrXSignalReceiverProvidedApis = GetShutdownHookStackUsage
        OsIsrXSignalReceiverProvidedApis = GetStartupHookStackUsage
        OsIsrXSignalReceiverProvidedApis = GetTaskStackUsage
        OsIsrXSignalReceiverProvidedApis = GetTaskState
        OsIsrXSignalReceiverProvidedApis = HookCallCallback
        OsIsrXSignalReceiverProvidedApis = NextScheduleTable
        OsIsrXSignalReceiverProvidedApis = SetAbsAlarm
        OsIsrXSignalReceiverProvidedApis = SetEvent
        OsIsrXSignalReceiverProvidedApis = SetRelAlarm
        OsIsrXSignalReceiverProvidedApis = StartScheduleTableAbs
        OsIsrXSignalReceiverProvidedApis = StartScheduleTableRel
        OsIsrXSignalReceiverProvidedApis = StopScheduleTable
        OsIsrXSignalReceiverProvidedApis = TerminateApplication
    XSignalIsr_OsCore1 (OsIsr):
      OsIsrCategory = CATEGORY_2
      OsIsrInterruptType = EXTERNAL
      OsIsrInterruptSource = 4128
      OsIsrInterruptPriority = 34
      OsIsrStackSize = 1024
      OsIsrEnableNesting = false
      OsIsrUsesFpu = false
      OsIsrInitialEnableInterruptSource = false
      OsIsrSpecialFunctionName = Os_XSigRecvIsrHandler
      OsIsrXSignalReceiver:
        OsIsrXSignalReceiverProvidedApis = ShutdownAllCores
        OsIsrXSignalReceiverProvidedApis = ActivateTask
        OsIsrXSignalReceiverProvidedApis = CancelAlarm
        OsIsrXSignalReceiverProvidedApis = ChainTask
        OsIsrXSignalReceiverProvidedApis = ControlIdle
        OsIsrXSignalReceiverProvidedApis = GetAlarm
        OsIsrXSignalReceiverProvidedApis = GetApplicationState
        OsIsrXSignalReceiverProvidedApis = GetCounterValue
        OsIsrXSignalReceiverProvidedApis = GetElapsedValue
        OsIsrXSignalReceiverProvidedApis = GetErrorHookStackUsage
        OsIsrXSignalReceiverProvidedApis = GetEvent
        OsIsrXSignalReceiverProvidedApis = GetISRStackUsage
        OsIsrXSignalReceiverProvidedApis = GetKernelStackUsage
        OsIsrXSignalReceiverProvidedApis = GetProtectionHookStackUsage
        OsIsrXSignalReceiverProvidedApis = GetScheduleTableStatus
        OsIsrXSignalReceiverProvidedApis = GetShutdownHookStackUsage
        OsIsrXSignalReceiverProvidedApis = GetStartupHookStackUsage
        OsIsrXSignalReceiverProvidedApis = GetTaskStackUsage
        OsIsrXSignalReceiverProvidedApis = GetTaskState
        OsIsrXSignalReceiverProvidedApis = HookCallCallback
        OsIsrXSignalReceiverProvidedApis = NextScheduleTable
        OsIsrXSignalReceiverProvidedApis = SetAbsAlarm
        OsIsrXSignalReceiverProvidedApis = SetEvent
        OsIsrXSignalReceiverProvidedApis = SetRelAlarm
        OsIsrXSignalReceiverProvidedApis = StartScheduleTableAbs
        OsIsrXSignalReceiverProvidedApis = StartScheduleTableRel
        OsIsrXSignalReceiverProvidedApis = StopScheduleTable
        OsIsrXSignalReceiverProvidedApis = TerminateApplication
    OsCore2 (OsCore):
      OsCoreIsAutostart = false
      OsCoreIsAutosar = true
      OsCoreEntrySymbol = _start_tc2
      OsCorePhysicalCoreRef = Core2
      OsCoreEcucCoreRef = EcucCoreDefinition_Core2
      OsCoreIdleTask = IdleTask_OsCore2
      OsCoreSystemApplication = SystemApplication_OsCore2
      OsCoreStacks:
        OsCoreKernelStackSize = 1024
        OsCoreStartupStackSize = 1024
        OsCoreShutdownStackSize = 1024
        OsCoreErrorStackSize = 1024
        OsCoreProtectionStackSize = 1024
        OsCoreInitStackSize = 1024
      XSignalChl_OsCore0 (OsCoreXSignalChannel): OsCoreXSignalChannelSize=1, OsCoreXSignalChannelReceiverIsr=XSignalIsr_OsCore0
      XSignalChl_OsCore1 (OsCoreXSignalChannel): OsCoreXSignalChannelSize=1, OsCoreXSignalChannelReceiverIsr=XSignalIsr_OsCore1
    IdleTask_OsCore2 (OsTask):
      OsTaskActivation = 1
      OsTaskPriority = 4294967295
      OsTaskSchedule = FULL
      OsTaskStackSharing = false
      OsTaskStackSize = 1024
      OsTaskType = AUTO
      OsTaskUsesFpu = false
      OsTaskAccessingApplication = SystemApplication_OsCore{0..2}
      OsTaskAutostart: OsTaskAppModeRef=OS_APPMODE_ANY
    SystemApplication_OsCore2 (OsApplication):
      OsTrusted = true
      OsTrustedApplicationDelayTimingViolationCall = false
      OsTrustedApplicationWithProtection = false
      OsApplicationIsPrivileged = true
      OsAppUseTrustedFunctionStubs = false
      OsApplicationCoreRef = EcucCoreDefinition_Core2
      OsAppTaskRef = IdleTask_OsCore2
      OsAppIsrRef = XSignalIsr_OsCore2
      OsAppIsrRef = CounterIsr_SystemTimer_Core2
      OsAppCounterRef = SystemTimer_Core2
      OsAppTaskRef = Os/OsTask_App10ms_Core2
      OsAppEcucPartitionRef = EcucPartition_ASILB_C2
      OsAppTaskRef = Default_Init_Task_Core2
      OsAppAlarmRef = Rte_Al_TE2_OsTask_App10ms_Core2_0_5ms
      OsAppAlarmRef = Rte_Al_TE_AppCtrl2_AppCtrl2_MainFunction
      OsApplicationHooks: OsAppErrorHook=false, OsAppShutdownHook=false, OsAppStartupHook=false
    XSignalIsr_OsCore2 (OsIsr):
      OsIsrCategory = CATEGORY_2
      OsIsrInterruptType = EXTERNAL
      OsIsrInterruptSource = 4160
      OsIsrInterruptPriority = 44
      OsIsrStackSize = 1024
      OsIsrEnableNesting = false
      OsIsrUsesFpu = false
      OsIsrInitialEnableInterruptSource = false
      OsIsrSpecialFunctionName = Os_XSigRecvIsrHandler
      OsIsrXSignalReceiver:
        OsIsrXSignalReceiverProvidedApis = ShutdownAllCores
        OsIsrXSignalReceiverProvidedApis = ActivateTask
        OsIsrXSignalReceiverProvidedApis = CancelAlarm
        OsIsrXSignalReceiverProvidedApis = ChainTask
        OsIsrXSignalReceiverProvidedApis = ControlIdle
        OsIsrXSignalReceiverProvidedApis = GetAlarm
        OsIsrXSignalReceiverProvidedApis = GetApplicationState
        OsIsrXSignalReceiverProvidedApis = GetCounterValue
        OsIsrXSignalReceiverProvidedApis = GetElapsedValue
        OsIsrXSignalReceiverProvidedApis = GetErrorHookStackUsage
        OsIsrXSignalReceiverProvidedApis = GetEvent
        OsIsrXSignalReceiverProvidedApis = GetISRStackUsage
        OsIsrXSignalReceiverProvidedApis = GetKernelStackUsage
        OsIsrXSignalReceiverProvidedApis = GetProtectionHookStackUsage
        OsIsrXSignalReceiverProvidedApis = GetScheduleTableStatus
        OsIsrXSignalReceiverProvidedApis = GetShutdownHookStackUsage
        OsIsrXSignalReceiverProvidedApis = GetStartupHookStackUsage
        OsIsrXSignalReceiverProvidedApis = GetTaskStackUsage
        OsIsrXSignalReceiverProvidedApis = GetTaskState
        OsIsrXSignalReceiverProvidedApis = HookCallCallback
        OsIsrXSignalReceiverProvidedApis = NextScheduleTable
        OsIsrXSignalReceiverProvidedApis = SetAbsAlarm
        OsIsrXSignalReceiverProvidedApis = SetEvent
        OsIsrXSignalReceiverProvidedApis = SetRelAlarm
        OsIsrXSignalReceiverProvidedApis = StartScheduleTableAbs
        OsIsrXSignalReceiverProvidedApis = StartScheduleTableRel
        OsIsrXSignalReceiverProvidedApis = StopScheduleTable
        OsIsrXSignalReceiverProvidedApis = TerminateApplication
    SystemTimer_Core2 (OsCounter):
      OsCounterMaxAllowedValue = 1073741823
      OsCounterMinCycle = 1
      OsCounterTicksPerBase = 80000
      OsCounterType = HARDWARE
      OsSecondsPerTick = 0.001
      OsCounterAccessingApplication = SystemApplication_OsCore{0..2}
      OsDriver: OsDriverHighResolution=false, OsDriverHardwareTimerChannelRef=STM2_Ch0, OsDriverIsrRef=CounterIsr_SystemTimer_Core2
    CounterIsr_SystemTimer_Core2 (OsIsr):
      OsIsrCategory = CATEGORY_2
      OsIsrInterruptType = EXTERNAL
      OsIsrInterruptSource = 1184
      OsIsrInterruptPriority = 55
      OsIsrStackSize = 1024
      OsIsrEnableNesting = false
      OsIsrUsesFpu = false
      OsIsrInitialEnableInterruptSource = false
      OsIsrSpecialFunctionName = Os_TimerPfrtIsr
    CounterIsr_SystemTimer_Core1 (OsIsr):
      OsIsrCategory = CATEGORY_2
      OsIsrInterruptType = EXTERNAL
      OsIsrInterruptSource = 1176
      OsIsrInterruptPriority = 24
      OsIsrStackSize = 1024
      OsIsrEnableNesting = false
      OsIsrUsesFpu = false
      OsIsrInitialEnableInterruptSource = false
      OsIsrSpecialFunctionName = Os_TimerPfrtIsr
    SystemTimer_Core1 (OsCounter):
      OsCounterMaxAllowedValue = 1073741823
      OsCounterMinCycle = 1
      OsCounterTicksPerBase = 80000
      OsCounterType = HARDWARE
      OsSecondsPerTick = 0.001
      OsCounterAccessingApplication = SystemApplication_OsCore{0..2}
      OsDriver: OsDriverHighResolution=false, OsDriverHardwareTimerChannelRef=STM1_Ch0, OsDriverIsrRef=CounterIsr_SystemTimer_Core1
    3 x OsTask, all with OsTaskActivation=1, OsTaskSchedule=NON, OsTaskStackSharing=false, OsTaskStackSize=1024, OsTaskType=AUTO, OsTaskUsesFpu=false, OsTaskAccessingApplication=SystemApplication_OsCore0, OsTaskAccessingApplication=SystemApplication_OsCore1, OsTaskAccessingApplication=SystemApplication_OsCore2:
      OsTask_App10ms_Core0: OsTaskPriority=34, OsTaskResourceRef=OsResource_Core0
      OsTask_App10ms_Core1: OsTaskPriority=42, OsTaskResourceRef=OsResource_Core1, OsTaskEventRef=Rte_Ev_RunS2_EcuM_EcuM_MainFunction, OsTaskEventRef=Rte_Ev_Run_AppCtrl1_AppCtrl1_MainFuntion
      OsTask_App10ms_Core2: OsTaskPriority=46, OsTaskResourceRef=OsResource_Core2, OsTaskEventRef=Rte_Ev_Cyclic2_OsTask_App10ms_Core2_0_5ms, OsTaskEventRef=Rte_Ev_Run_AppCtrl2_AppCtrl2_MainFunction
    3 x OsResource, all with OsResourceProperty=STANDARD:
      OsResource_Core{0..2}: OsResourceAccessingApplication=SystemApplication_OsCore{0..2}
    Rte_Al_TE2_EcuM_EcuM_MainFunction (OsAlarm):
      OsAlarmCounterRef = SystemTimer_Core1
      OsAlarmAccessingApplication = SystemApplication_OsCore0
      OsAlarmAccessingApplication = SystemApplication_OsCore2
      OsAlarmAccessingApplication = SystemApplication_OsCore1
      OsAlarmAction
        OsAlarmSetEvent: OsAlarmSetEventRef=Rte_Ev_RunS2_EcuM_EcuM_MainFunction, OsAlarmSetEventTaskRef=Os/OsTask_App10ms_Core1
    Rte_Ev_RunS2_EcuM_EcuM_MainFunction (OsEvent)
    OsBarrier
    3 x OsTask, all with OsTaskActivation=1, OsTaskSchedule=NON, OsTaskStackSharing=false, OsTaskStackSize=1024, OsTaskType=BASIC, OsTaskUsesFpu=false, OsTaskAccessingApplication=SystemApplication_OsCore0, OsTaskAccessingApplication=SystemApplication_OsCore1, OsTaskAccessingApplication=SystemApplication_OsCore2:
      Default_Init_Task: OsTaskPriority=30
        OsTaskAutostart: OsTaskAppModeRef=OS_APPMODE_ANY
      Default_Init_Task_Core1: OsTaskPriority=50
        OsTaskAutostart: OsTaskAppModeRef=OS_APPMODE_ANY
      Default_Init_Task_Core2: OsTaskPriority=50
        OsTaskAutostart: OsTaskAppModeRef=OS_APPMODE_ANY
    CanIsr_1 (OsIsr):  # /ActiveEcuC/Can PLAIN_TEXT Can transmit, receive and busoff events of controller CT_DBCNetWork_78f82e94. This OsIsr container has been created automatically based on the driver configuration.
      OsIsrCategory = CATEGORY_2
      OsIsrInterruptType = EXTERNAL
      OsIsrInterruptSource = 2308
      OsIsrInterruptPriority = 10
      OsIsrStackSize = 1024
      OsIsrEnableNesting = false
      OsIsrUsesFpu = false
      OsIsrInitialEnableInterruptSource = true
    OsTask_App_Init_Task (OsTask):
      OsTaskActivation = 1
      OsTaskPriority = 50
      OsTaskSchedule = NON
      OsTaskStackSharing = false
      OsTaskStackSize = 1024
      OsTaskType = BASIC
      OsTaskUsesFpu = false
      OsTaskAccessingApplication = SystemApplication_OsCore{0..2}
    GTMTIM2SR7_ISR (OsIsr):
      OsIsrCategory = CATEGORY_2
      OsIsrInterruptType = EXTERNAL
      OsIsrInterruptSource = 6120
      OsIsrInterruptPriority = 9
      OsIsrStackSize = 1024
      OsIsrEnableNesting = false
      OsIsrUsesFpu = false
      OsIsrInitialEnableInterruptSource = true
    OsTask_Bsw5ms_Core0 (OsTask):
      OsTaskActivation = 1
      OsTaskPriority = 35
      OsTaskSchedule = NON
      OsTaskStackSharing = false
      OsTaskStackSize = 1024
      OsTaskType = AUTO
      OsTaskUsesFpu = false
      OsTaskAccessingApplication = SystemApplication_OsCore{0..2}
      OsTaskEventRef = Rte_Ev_Cyclic2_OsTask_Bsw5ms_Core0_0_5ms
      OsTaskEventRef = Rte_Ev_Run_IoHwAb_IoHwAb_IoHwAbRunnable
      OsTaskResourceRef = OsResource_Core0
    Rte_Al_TE2_OsTask_App10ms_Core2_0_5ms (OsAlarm):
      OsAlarmCounterRef = SystemTimer_Core2
      OsAlarmAccessingApplication = SystemApplication_OsCore{0..2}
      OsAlarmAction
        OsAlarmSetEvent: OsAlarmSetEventRef=Rte_Ev_Cyclic2_OsTask_App10ms_Core2_0_5ms, OsAlarmSetEventTaskRef=Os/OsTask_App10ms_Core2
    Rte_Al_TE2_OsTask_Bsw5ms_Core0_0_5ms (OsAlarm):
      OsAlarmCounterRef = SystemTimer_Core0
      OsAlarmAccessingApplication = SystemApplication_OsCore1
      OsAlarmAccessingApplication = SystemApplication_OsCore2
      OsAlarmAccessingApplication = SystemApplication_OsCore0
      OsAlarmAction
        OsAlarmSetEvent: OsAlarmSetEventRef=Rte_Ev_Cyclic2_OsTask_Bsw5ms_Core0_0_5ms, OsAlarmSetEventTaskRef=Os/OsTask_Bsw5ms_Core0
    Rte_Ev_Cyclic2_OsTask_App10ms_Core2_0_5ms (OsEvent)
    Rte_Ev_Cyclic2_OsTask_Bsw5ms_Core0_0_5ms (OsEvent)
    3 x OsAlarm, all with OsAlarmAccessingApplication=SystemApplication_OsCore0, OsAlarmAccessingApplication=SystemApplication_OsCore2, OsAlarmAccessingApplication=SystemApplication_OsCore1:
      Rte_Al_TE_AppCtrl1_AppCtrl1_MainFuntion: OsAlarmCounterRef=SystemTimer_Core1
        OsAlarmAction
          OsAlarmSetEvent: OsAlarmSetEventRef=Rte_Ev_Run_AppCtrl1_AppCtrl1_MainFuntion, OsAlarmSetEventTaskRef=Os/OsTask_App10ms_Core1
      Rte_Al_TE_AppCtrl2_AppCtrl2_MainFunction: OsAlarmCounterRef=SystemTimer_Core2
        OsAlarmAction
          OsAlarmSetEvent: OsAlarmSetEventRef=Rte_Ev_Run_AppCtrl2_AppCtrl2_MainFunction, OsAlarmSetEventTaskRef=Os/OsTask_App10ms_Core2
      Rte_Al_TE_IoHwAb_IoHwAb_IoHwAbRunnable: OsAlarmCounterRef=SystemTimer_Core0
        OsAlarmAction
          OsAlarmSetEvent: OsAlarmSetEventRef=Rte_Ev_Run_IoHwAb_IoHwAb_IoHwAbRunnable, OsAlarmSetEventTaskRef=Os/OsTask_Bsw5ms_Core0
    3 x OsEvent:
      Rte_Ev_Run_AppCtrl1_AppCtrl1_MainFuntion
      Rte_Ev_Run_AppCtrl2_AppCtrl2_MainFunction
      Rte_Ev_Run_IoHwAb_IoHwAb_IoHwAbRunnable
    CanIsr_0 (OsIsr):  # /ActiveEcuC/Can PLAIN_TEXT Can transmit, receive and busoff events of controller CT_DBCNetWork_INTER1_f93f8858. This OsIsr container has been created automatically based on the driver configuration.
      OsIsrCategory = CATEGORY_2
      OsIsrInterruptType = EXTERNAL
      OsIsrInterruptSource = 2304
      OsIsrInterruptPriority = 10
      OsIsrStackSize = 1024
      OsIsrEnableNesting = false
      OsIsrUsesFpu = false
      OsIsrInitialEnableInterruptSource = true
    Rte_Al_TE_OsTask_App10ms_Core0_0_10ms (OsAlarm):
      OsAlarmCounterRef = SystemTimer_Core0
      OsAlarmAccessingApplication = SystemApplication_OsCore1
      OsAlarmAccessingApplication = SystemApplication_OsCore2
      OsAlarmAccessingApplication = SystemApplication_OsCore0
      OsAlarmAction
        OsAlarmActivateTask: OsAlarmActivateTaskRef=OsTask_App10ms_Core0
    OsScheduleTable:
      OsScheduleTableDuration = 10
      OsScheduleTableRepeating = false
      OsScheduleTableCounterRef = SystemTimer_Core0
      OsSchTblAccessingApplication = SystemApplication_OsCore{0..2}
      3 x OsScheduleTableExpiryPoint:
        EP_0: OsScheduleTblExpPointOffset=0
          OsScheduleTableEventSetting: OsScheduleTableSetEventRef=Rte_Ev_Cyclic2_OsTask_Bsw5ms_Core0_0_5ms, OsScheduleTableSetEventTaskRef=Os/OsTask_Bsw5ms_Core0
          OsScheduleTableEventSetting_001 (OsScheduleTableEventSetting): OsScheduleTableSetEventRef=Rte_Ev_Run_IoHwAb_IoHwAb_IoHwAbRunnable, OsScheduleTableSetEventTaskRef=Os/OsTask_Bsw5ms_Core0
        EP_1: OsScheduleTblExpPointOffset=1
          OsScheduleTableTaskActivation: OsScheduleTableActivateTaskRef=OsTask_App10ms_Core0
        EP_5: OsScheduleTblExpPointOffset=5
          OsScheduleTableEventSetting: OsScheduleTableSetEventRef=Rte_Ev_Cyclic2_OsTask_Bsw5ms_Core0_0_5ms, OsScheduleTableSetEventTaskRef=Os/OsTask_Bsw5ms_Core0
          OsScheduleTableEventSetting_001 (OsScheduleTableEventSetting): OsScheduleTableSetEventRef=Rte_Ev_Run_IoHwAb_IoHwAb_IoHwAbRunnable, OsScheduleTableSetEventTaskRef=Os/OsTask_Bsw5ms_Core0
    ADC0SR1_ISR (OsIsr):
      OsIsrCategory = CATEGORY_2
      OsIsrInterruptType = EXTERNAL
      OsIsrInterruptSource = 2436
      OsIsrInterruptPriority = 150
      OsIsrStackSize = 1024
      OsIsrEnableNesting = false
      OsIsrUsesFpu = false
      OsIsrInitialEnableInterruptSource = true
