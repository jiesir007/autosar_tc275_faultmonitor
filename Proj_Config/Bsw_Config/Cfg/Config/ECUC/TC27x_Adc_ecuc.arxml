AUTOSAR XML (schema 00046)
package /Adc
  module config Adc: implementation-config-variant=VARIANT-POST-BUILD-LOADABLE, module-description=Adc_Impl
    AdcConfigSet_0 (AdcConfigSet):
      AdcAnalogClockDivider = 10
      AdcDigitalArbiterClockDivider = 0
      AdcLowPowerSupplyVoltage = POWER_SUPPLY_5V
      AdcRefPrechargeControl = USE_VDDM_PRECH_VAREF_ADJ
      AdcSleepMode = SLEEP_MODE_ACCEPT
      AdcCcu6ModuleRef = Ccu6
      AdcSystemClock = McuClockReferencePoint
      AdcGlobInputClass_0 (AdcGlobInputClass): AdcGlobChResolution=CH_RES_10BIT, AdcGlobChSampleTime=0
      AdcGlobInputClass_1 (AdcGlobInputClass): AdcGlobChResolution=CH_RES_10BIT, AdcGlobChSampleTime=0
      AdcHwUnit_0 (AdcHwUnit):
        AdcArbitrationRoundLength = ARBITRATION_SLOTS_4
        AdcClockSource = CLK_SRC_SYS_CLK
        AdcHwUnitId = HWUNIT_ADC0
        AdcPostCal = POST_CAL_DISABLE
        AdcSyncConvMode = ADC_STANDALONE
        AdcChannel_0 (AdcChannel):
          AdcAnChannelNum = 0
          AdcChannelHighLimit = 255
          AdcChannelId = 0
          AdcChannelLimitCheck = false
          AdcChannelLowLimit = 0
          AdcChannelRangeSelect = ADC_RANGE_ALWAYS
          AdcChannelRefVoltsrcHigh = REF_VOLTAGE_VAREF
          AdcChannelRefVoltsrcLow = REF_VOLTAGE_VAGND
          AdcSyncChannel = false
          AdcInputClassSelection = AdcGlobInputClass_0
        AdcGroup_0 (AdcGroup):
          AdcEmuxScanEnable = false
          AdcGroupAccessMode = ADC_ACCESS_MODE_SINGLE
          AdcGroupConversionMode = ADC_CONV_MODE_ONESHOT
          AdcGroupId = 0
          AdcGroupRequestSource = REQSRC1_NCH_SCAN
          AdcGroupTriggSrc = ADC_TRIGG_SRC_SW
          AdcHwGateSignal = ADC_GATE_SIGNAL_NONE
          AdcStreamingBufferMode = ADC_STREAM_BUFFER_LINEAR
          AdcStreamingNumSamples = 1
          AdcGroupDefinition = AdcChannel_0
        AdcKernelInputClass_0 (AdcKernelInputClass): AdcKernelChResolution=CH_RES_10BIT, AdcKernelChSampleTime=0
        AdcKernelInputClass_1 (AdcKernelInputClass): AdcKernelChResolution=CH_RES_10BIT, AdcKernelChSampleTime=0
    AdcGeneral:
      AdcCcu6Synchronization = false
      AdcDeInitApi = false
      AdcDebugSupport = false
      AdcDevErrorDetect = false
      AdcEnableLimitCheck = false
      AdcEnableQueuing = false
      AdcEnableStartStopGroupApi = true
      AdcGrpNotifCapability = false
      AdcHwTriggerApi = false
      AdcMasterSlaveSync = false
      AdcMaxChConvTimeCount = 10000
      AdcNonAutosarDmaResultHandling = false
      AdcNonAutosarResultPolling = false
      AdcPBFixedAddress = false
      AdcPriorityImplementation = ADC_PRIORITY_NONE
      AdcReadGroupApi = false
      AdcResetSfrAtInit = false
      AdcResultAlignment = ADC_ALIGN_RIGHT
      AdcRunningInUser0Mode = false
      AdcSameChannelQueuing = false
      AdcUseEmux = false
      AdcUserModeDeInitApiEnable = false
      AdcUserModeInitApiEnable = false
      AdcUserModeRuntimeApiEnable = false
      AdcVersionInfoApi = false
    AdcSafety: AdcSafetyEnable=false
    AdcPublishedInformation: AdcChannelValueSigned=false, AdcGroupFirstChannelFixed=false, AdcMaxChannelResolution=12
    CommonPublishedInformation:
      ArMajorVersion = 4
      ArMinorVersion = 2
      ArPatchVersion = 0
      ModuleId = 123
      Release = _TRICORE_TC275
      SwMajorVersion = 3
      SwMinorVersion = 2
      SwPatchVersion = 1
      VendorId = 17
