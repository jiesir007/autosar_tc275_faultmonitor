[part 2 of 2: package /Mcu]
AUTOSAR XML (schema 00046)
package /Mcu  (continued)
  module config Mcu: implementation-config-variant=VARIANT-POST-BUILD-LOADABLE, module-description=Mcu_Impl  (continued)
    McuModuleConfiguration_0 (McuModuleConfiguration):  (continued)
      GtmConfiguration_0 (GtmConfiguration)  (continued)
        4 x Tim:
          Tim_0
            8 x TimChannel:
              TimChannel_0
                TimChannelErrorInterrupt:
                  TimInterruptEnableOnCntOflErr = false
                  TimInterruptEnableOnEcntOflErr = false
                  TimInterruptEnableOnGlitchDetErr = false
                  TimInterruptEnableOnGprxOflErr = false
                  TimInterruptEnableOnNewValErr = false
                  TimInterruptEnableOnToDetErr = false
                TimChannelFilterConfig:
                  TimChFilterCounterFreqSelect = GTM_CONFIGURABLE_CLOCK_0
                  TimChFilterModeForFallingEdge = IMMEDIATE_EDGE_PROPAGATION_MODE
                  TimChFilterModeForRisingEdge = IMMEDIATE_EDGE_PROPAGATION_MODE
                  TimChFilterTimeForFallingEdge = 0
                  TimChFilterTimeForRisingEdge = 0
                  TimChannelFilterEnable = false
                TimChannelGeneral:
                  TimChannelAruEnable = false
                  TimChannelClockSelect = GTM_CONFIGURABLE_CLOCK_0
                  TimChannelCntsInputSelect = CNT_VALUE
                  TimChannelCntsValue = 0
                  TimChannelEcntOvflwSetting = SEL0_OVRFLOW_SIG_ON_ECNT_BITWIDTH_8
                  TimChannelEcntResetSetting = SEL0_ECNT_IN_WRAP_AROUND_MODE
                  TimChannelEnable = false
                  TimChannelExtCaptureModeEnable = false
                  TimChannelExtCaptureSrc = SEL0_NEW_VAL_IRQ
                  TimChannelGpr0InputSelect = TIMEBASE_TBU_TS0
                  TimChannelGpr1InputSelect = TIMEBASE_TBU_TS0
                  TimChannelInputSelect = INPUT_OF_CURRENT_TIM_CHANNEL
                  TimChannelModeSelect = PWM_MEASUREMENT_MODE_TPWM
                  TimChannelOneShotMode = false
                  TimChannelPortPinSelect = NONE_SEL0
                  TimChannelSignalEdgeSelect = FALLING_EDGE
                  TimChannelTbu0Ts0BitsSelect = BITS_0_TO_23
                  TimChannelUsage = USED_BY_OTHER_DRIVERS_OR_UNUSED
                  TimChannelValInitSignal = VAL_LOW
                TimChannelInterrupt:
                  TimInterruptEnableOnCntOfl = false
                  TimInterruptEnableOnEcntOfl = false
                  TimInterruptEnableOnGlitchDet = false
                  TimInterruptEnableOnGprxOfl = false
                  TimInterruptEnableOnNewVal = false
                  TimInterruptEnableOnToDet = false
                  TimInterruptMode = GTM_INTERRUPT_LEVEL_MODE
                  TimNotification = NULL_PTR
                TimChannelTimeoutDetection: TimChTimeoutClockSelect=GTM_CONFIGURABLE_CLOCK_0, TimChTimeoutDetectionEnable=SEL0_TIMOUT_DISABLED, TimChTimeoutDuration=0
              TimChannel_1
                TimChannelErrorInterrupt:
                  TimInterruptEnableOnCntOflErr = false
                  TimInterruptEnableOnEcntOflErr = false
                  TimInterruptEnableOnGlitchDetErr = false
                  TimInterruptEnableOnGprxOflErr = false
                  TimInterruptEnableOnNewValErr = false
                  TimInterruptEnableOnToDetErr = false
                TimChannelFilterConfig:
                  TimChFilterCounterFreqSelect = GTM_CONFIGURABLE_CLOCK_0
                  TimChFilterModeForFallingEdge = IMMEDIATE_EDGE_PROPAGATION_MODE
                  TimChFilterModeForRisingEdge = IMMEDIATE_EDGE_PROPAGATION_MODE
                  TimChFilterTimeForFallingEdge = 0
                  TimChFilterTimeForRisingEdge = 0
                  TimChannelFilterEnable = false
                TimChannelGeneral:
                  TimChannelAruEnable = false
                  TimChannelClockSelect = GTM_CONFIGURABLE_CLOCK_0
                  TimChannelCntsInputSelect = CNT_VALUE
                  TimChannelCntsValue = 0
                  TimChannelEcntOvflwSetting = SEL0_OVRFLOW_SIG_ON_ECNT_BITWIDTH_8
                  TimChannelEcntResetSetting = SEL0_ECNT_IN_WRAP_AROUND_MODE
                  TimChannelEnable = false
                  TimChannelExtCaptureModeEnable = false
                  TimChannelExtCaptureSrc = SEL0_NEW_VAL_IRQ
                  TimChannelGpr0InputSelect = TIMEBASE_TBU_TS0
                  TimChannelGpr1InputSelect = TIMEBASE_TBU_TS0
                  TimChannelInputSelect = INPUT_OF_CURRENT_TIM_CHANNEL
                  TimChannelModeSelect = PWM_MEASUREMENT_MODE_TPWM
                  TimChannelOneShotMode = false
                  TimChannelPortPinSelect = NONE_SEL0
                  TimChannelSignalEdgeSelect = FALLING_EDGE
                  TimChannelTbu0Ts0BitsSelect = BITS_0_TO_23
                  TimChannelUsage = USED_BY_OTHER_DRIVERS_OR_UNUSED
                  TimChannelValInitSignal = VAL_LOW
                TimChannelInterrupt:
                  TimInterruptEnableOnCntOfl = false
                  TimInterruptEnableOnEcntOfl = false
                  TimInterruptEnableOnGlitchDet = false
                  TimInterruptEnableOnGprxOfl = false
                  TimInterruptEnableOnNewVal = false
                  TimInterruptEnableOnToDet = false
                  TimInterruptMode = GTM_INTERRUPT_LEVEL_MODE
                  TimNotification = NULL_PTR
                TimChannelTimeoutDetection: TimChTimeoutClockSelect=GTM_CONFIGURABLE_CLOCK_0, TimChTimeoutDetectionEnable=SEL0_TIMOUT_DISABLED, TimChTimeoutDuration=0
              TimChannel_2
                TimChannelErrorInterrupt:
                  TimInterruptEnableOnCntOflErr = false
                  TimInterruptEnableOnEcntOflErr = false
                  TimInterruptEnableOnGlitchDetErr = false
                  TimInterruptEnableOnGprxOflErr = false
                  TimInterruptEnableOnNewValErr = false
                  TimInterruptEnableOnToDetErr = false
                TimChannelFilterConfig:
                  TimChFilterCounterFreqSelect = GTM_CONFIGURABLE_CLOCK_0
                  TimChFilterModeForFallingEdge = IMMEDIATE_EDGE_PROPAGATION_MODE
                  TimChFilterModeForRisingEdge = IMMEDIATE_EDGE_PROPAGATION_MODE
                  TimChFilterTimeForFallingEdge = 0
                  TimChFilterTimeForRisingEdge = 0
                  TimChannelFilterEnable = false
                TimChannelGeneral:
                  TimChannelAruEnable = false
                  TimChannelClockSelect = GTM_CONFIGURABLE_CLOCK_0
                  TimChannelCntsInputSelect = CNT_VALUE
                  TimChannelCntsValue = 0
                  TimChannelEcntOvflwSetting = SEL0_OVRFLOW_SIG_ON_ECNT_BITWIDTH_8
                  TimChannelEcntResetSetting = SEL0_ECNT_IN_WRAP_AROUND_MODE
                  TimChannelEnable = false
                  TimChannelExtCaptureModeEnable = false
                  TimChannelExtCaptureSrc = SEL0_NEW_VAL_IRQ
                  TimChannelGpr0InputSelect = TIMEBASE_TBU_TS0
                  TimChannelGpr1InputSelect = TIMEBASE_TBU_TS0
                  TimChannelInputSelect = INPUT_OF_CURRENT_TIM_CHANNEL
                  TimChannelModeSelect = PWM_MEASUREMENT_MODE_TPWM
                  TimChannelOneShotMode = false
                  TimChannelPortPinSelect = NONE_SEL0
                  TimChannelSignalEdgeSelect = FALLING_EDGE
                  TimChannelTbu0Ts0BitsSelect = BITS_0_TO_23
                  TimChannelUsage = USED_BY_OTHER_DRIVERS_OR_UNUSED
                  TimChannelValInitSignal = VAL_LOW
                TimChannelInterrupt:
                  TimInterruptEnableOnCntOfl = false
                  TimInterruptEnableOnEcntOfl = false
                  TimInterruptEnableOnGlitchDet = false
                  TimInterruptEnableOnGprxOfl = false
                  TimInterruptEnableOnNewVal = false
                  TimInterruptEnableOnToDet = false
                  TimInterruptMode = GTM_INTERRUPT_LEVEL_MODE
                  TimNotification = NULL_PTR
                TimChannelTimeoutDetection: TimChTimeoutClockSelect=GTM_CONFIGURABLE_CLOCK_0, TimChTimeoutDetectionEnable=SEL0_TIMOUT_DISABLED, TimChTimeoutDuration=0
              TimChannel_3
                TimChannelErrorInterrupt:
                  TimInterruptEnableOnCntOflErr = false
                  TimInterruptEnableOnEcntOflErr = false
                  TimInterruptEnableOnGlitchDetErr = false
                  TimInterruptEnableOnGprxOflErr = false
                  TimInterruptEnableOnNewValErr = false
                  TimInterruptEnableOnToDetErr = false
                TimChannelFilterConfig:
                  TimChFilterCounterFreqSelect = GTM_CONFIGURABLE_CLOCK_0
                  TimChFilterModeForFallingEdge = IMMEDIATE_EDGE_PROPAGATION_MODE
                  TimChFilterModeForRisingEdge = IMMEDIATE_EDGE_PROPAGATION_MODE
                  TimChFilterTimeForFallingEdge = 0
                  TimChFilterTimeForRisingEdge = 0
                  TimChannelFilterEnable = false
                TimChannelGeneral:
                  TimChannelAruEnable = false
                  TimChannelClockSelect = GTM_CONFIGURABLE_CLOCK_0
                  TimChannelCntsInputSelect = CNT_VALUE
                  TimChannelCntsValue = 0
                  TimChannelEcntOvflwSetting = SEL0_OVRFLOW_SIG_ON_ECNT_BITWIDTH_8
                  TimChannelEcntResetSetting = SEL0_ECNT_IN_WRAP_AROUND_MODE
                  TimChannelEnable = false
                  TimChannelExtCaptureModeEnable = false
                  TimChannelExtCaptureSrc = SEL0_NEW_VAL_IRQ
                  TimChannelGpr0InputSelect = TIMEBASE_TBU_TS0
                  TimChannelGpr1InputSelect = TIMEBASE_TBU_TS0
                  TimChannelInputSelect = INPUT_OF_CURRENT_TIM_CHANNEL
                  TimChannelModeSelect = PWM_MEASUREMENT_MODE_TPWM
                  TimChannelOneShotMode = false
                  TimChannelPortPinSelect = NONE_SEL0
                  TimChannelSignalEdgeSelect = FALLING_EDGE
                  TimChannelTbu0Ts0BitsSelect = BITS_0_TO_23
                  TimChannelUsage = USED_BY_OTHER_DRIVERS_OR_UNUSED
                  TimChannelValInitSignal = VAL_LOW
                TimChannelInterrupt:
                  TimInterruptEnableOnCntOfl = false
                  TimInterruptEnableOnEcntOfl = false
                  TimInterruptEnableOnGlitchDet = false
                  TimInterruptEnableOnGprxOfl = false
                  TimInterruptEnableOnNewVal = false
                  TimInterruptEnableOnToDet = false
                  TimInterruptMode = GTM_INTERRUPT_LEVEL_MODE
                  TimNotification = NULL_PTR
                TimChannelTimeoutDetection: TimChTimeoutClockSelect=GTM_CONFIGURABLE_CLOCK_0, TimChTimeoutDetectionEnable=SEL0_TIMOUT_DISABLED, TimChTimeoutDuration=0
              TimChannel_4
                TimChannelErrorInterrupt:
                  TimInterruptEnableOnCntOflErr = false
                  TimInterruptEnableOnEcntOflErr = false
                  TimInterruptEnableOnGlitchDetErr = false
                  TimInterruptEnableOnGprxOflErr = false
                  TimInterruptEnableOnNewValErr = false
                  TimInterruptEnableOnToDetErr = false
                TimChannelFilterConfig:
                  TimChFilterCounterFreqSelect = GTM_CONFIGURABLE_CLOCK_0
                  TimChFilterModeForFallingEdge = IMMEDIATE_EDGE_PROPAGATION_MODE
                  TimChFilterModeForRisingEdge = IMMEDIATE_EDGE_PROPAGATION_MODE
                  TimChFilterTimeForFallingEdge = 0
                  TimChFilterTimeForRisingEdge = 0
                  TimChannelFilterEnable = false
                TimChannelGeneral:
                  TimChannelAruEnable = false
                  TimChannelClockSelect = GTM_CONFIGURABLE_CLOCK_0
                  TimChannelCntsInputSelect = CNT_VALUE
                  TimChannelCntsValue = 0
                  TimChannelEcntOvflwSetting = SEL0_OVRFLOW_SIG_ON_ECNT_BITWIDTH_8
                  TimChannelEcntResetSetting = SEL0_ECNT_IN_WRAP_AROUND_MODE
                  TimChannelEnable = false
                  TimChannelExtCaptureModeEnable = false
                  TimChannelExtCaptureSrc = SEL0_NEW_VAL_IRQ
                  TimChannelGpr0InputSelect = TIMEBASE_TBU_TS0
                  TimChannelGpr1InputSelect = TIMEBASE_TBU_TS0
                  TimChannelInputSelect = INPUT_OF_CURRENT_TIM_CHANNEL
                  TimChannelModeSelect = PWM_MEASUREMENT_MODE_TPWM
                  TimChannelOneShotMode = false
                  TimChannelPortPinSelect = NONE_SEL0
                  TimChannelSignalEdgeSelect = FALLING_EDGE
                  TimChannelTbu0Ts0BitsSelect = BITS_0_TO_23
                  TimChannelUsage = USED_BY_OTHER_DRIVERS_OR_UNUSED
                  TimChannelValInitSignal = VAL_LOW
                TimChannelInterrupt:
                  TimInterruptEnableOnCntOfl = false
                  TimInterruptEnableOnEcntOfl = false
                  TimInterruptEnableOnGlitchDet = false
                  TimInterruptEnableOnGprxOfl = false
                  TimInterruptEnableOnNewVal = false
                  TimInterruptEnableOnToDet = false
                  TimInterruptMode = GTM_INTERRUPT_LEVEL_MODE
                  TimNotification = NULL_PTR
                TimChannelTimeoutDetection: TimChTimeoutClockSelect=GTM_CONFIGURABLE_CLOCK_0, TimChTimeoutDetectionEnable=SEL0_TIMOUT_DISABLED, TimChTimeoutDuration=0
              TimChannel_5
                TimChannelErrorInterrupt:
                  TimInterruptEnableOnCntOflErr = false
                  TimInterruptEnableOnEcntOflErr = false
                  TimInterruptEnableOnGlitchDetErr = false
                  TimInterruptEnableOnGprxOflErr = false
                  TimInterruptEnableOnNewValErr = false
                  TimInterruptEnableOnToDetErr = false
                TimChannelFilterConfig:
                  TimChFilterCounterFreqSelect = GTM_CONFIGURABLE_CLOCK_0
                  TimChFilterModeForFallingEdge = IMMEDIATE_EDGE_PROPAGATION_MODE
                  TimChFilterModeForRisingEdge = IMMEDIATE_EDGE_PROPAGATION_MODE
                  TimChFilterTimeForFallingEdge = 0
                  TimChFilterTimeForRisingEdge = 0
                  TimChannelFilterEnable = false
                TimChannelGeneral:
                  TimChannelAruEnable = false
                  TimChannelClockSelect = GTM_CONFIGURABLE_CLOCK_0
                  TimChannelCntsInputSelect = CNT_VALUE
                  TimChannelCntsValue = 0
                  TimChannelEcntOvflwSetting = SEL0_OVRFLOW_SIG_ON_ECNT_BITWIDTH_8
                  TimChannelEcntResetSetting = SEL0_ECNT_IN_WRAP_AROUND_MODE
                  TimChannelEnable = false
                  TimChannelExtCaptureModeEnable = false
                  TimChannelExtCaptureSrc = SEL0_NEW_VAL_IRQ
                  TimChannelGpr0InputSelect = TIMEBASE_TBU_TS0
                  TimChannelGpr1InputSelect = TIMEBASE_TBU_TS0
                  TimChannelInputSelect = INPUT_OF_CURRENT_TIM_CHANNEL
                  TimChannelModeSelect = PWM_MEASUREMENT_MODE_TPWM
                  TimChannelOneShotMode = false
                  TimChannelPortPinSelect = NONE_SEL0
                  TimChannelSignalEdgeSelect = FALLING_EDGE
                  TimChannelTbu0Ts0BitsSelect = BITS_0_TO_23
                  TimChannelUsage = USED_BY_OTHER_DRIVERS_OR_UNUSED
                  TimChannelValInitSignal = VAL_LOW
                TimChannelInterrupt:
                  TimInterruptEnableOnCntOfl = false
                  TimInterruptEnableOnEcntOfl = false
                  TimInterruptEnableOnGlitchDet = false
                  TimInterruptEnableOnGprxOfl = false
                  TimInterruptEnableOnNewVal = false
                  TimInterruptEnableOnToDet = false
                  TimInterruptMode = GTM_INTERRUPT_LEVEL_MODE
                  TimNotification = NULL_PTR
                TimChannelTimeoutDetection: TimChTimeoutClockSelect=GTM_CONFIGURABLE_CLOCK_0, TimChTimeoutDetectionEnable=SEL0_TIMOUT_DISABLED, TimChTimeoutDuration=0
              TimChannel_6
                TimChannelErrorInterrupt:
                  TimInterruptEnableOnCntOflErr = false
                  TimInterruptEnableOnEcntOflErr = false
                  TimInterruptEnableOnGlitchDetErr = false
                  TimInterruptEnableOnGprxOflErr = false
                  TimInterruptEnableOnNewValErr = false
                  TimInterruptEnableOnToDetErr = false
                TimChannelFilterConfig:
                  TimChFilterCounterFreqSelect = GTM_CONFIGURABLE_CLOCK_0
                  TimChFilterModeForFallingEdge = IMMEDIATE_EDGE_PROPAGATION_MODE
                  TimChFilterModeForRisingEdge = IMMEDIATE_EDGE_PROPAGATION_MODE
                  TimChFilterTimeForFallingEdge = 0
                  TimChFilterTimeForRisingEdge = 0
                  TimChannelFilterEnable = false
                TimChannelGeneral:
                  TimChannelAruEnable = false
                  TimChannelClockSelect = GTM_CONFIGURABLE_CLOCK_0
                  TimChannelCntsInputSelect = CNT_VALUE
                  TimChannelCntsValue = 0
                  TimChannelEcntOvflwSetting = SEL0_OVRFLOW_SIG_ON_ECNT_BITWIDTH_8
                  TimChannelEcntResetSetting = SEL0_ECNT_IN_WRAP_AROUND_MODE
                  TimChannelEnable = false
                  TimChannelExtCaptureModeEnable = false
                  TimChannelExtCaptureSrc = SEL0_NEW_VAL_IRQ
                  TimChannelGpr0InputSelect = TIMEBASE_TBU_TS0
                  TimChannelGpr1InputSelect = TIMEBASE_TBU_TS0
                  TimChannelInputSelect = INPUT_OF_CURRENT_TIM_CHANNEL
                  TimChannelModeSelect = PWM_MEASUREMENT_MODE_TPWM
                  TimChannelOneShotMode = false
                  TimChannelPortPinSelect = NONE_SEL0
                  TimChannelSignalEdgeSelect = FALLING_EDGE
                  TimChannelTbu0Ts0BitsSelect = BITS_0_TO_23
                  TimChannelUsage = USED_BY_OTHER_DRIVERS_OR_UNUSED
                  TimChannelValInitSignal = VAL_LOW
                TimChannelInterrupt:
                  TimInterruptEnableOnCntOfl = false
                  TimInterruptEnableOnEcntOfl = false
                  TimInterruptEnableOnGlitchDet = false
                  TimInterruptEnableOnGprxOfl = false
                  TimInterruptEnableOnNewVal = false
                  TimInterruptEnableOnToDet = false
                  TimInterruptMode = GTM_INTERRUPT_LEVEL_MODE
                  TimNotification = NULL_PTR
                TimChannelTimeoutDetection: TimChTimeoutClockSelect=GTM_CONFIGURABLE_CLOCK_0, TimChTimeoutDetectionEnable=SEL0_TIMOUT_DISABLED, TimChTimeoutDuration=0
              TimChannel_7
                TimChannelErrorInterrupt:
                  TimInterruptEnableOnCntOflErr = false
                  TimInterruptEnableOnEcntOflErr = false
                  TimInterruptEnableOnGlitchDetErr = false
                  TimInterruptEnableOnGprxOflErr = false
                  TimInterruptEnableOnNewValErr = false
                  TimInterruptEnableOnToDetErr = false
                TimChannelFilterConfig:
                  TimChFilterCounterFreqSelect = GTM_CONFIGURABLE_CLOCK_0
                  TimChFilterModeForFallingEdge = IMMEDIATE_EDGE_PROPAGATION_MODE
                  TimChFilterModeForRisingEdge = IMMEDIATE_EDGE_PROPAGATION_MODE
                  TimChFilterTimeForFallingEdge = 0
                  TimChFilterTimeForRisingEdge = 0
                  TimChannelFilterEnable = false
                TimChannelGeneral:
                  TimChannelAruEnable = false
                  TimChannelClockSelect = GTM_CONFIGURABLE_CLOCK_0
                  TimChannelCntsInputSelect = CNT_VALUE
                  TimChannelCntsValue = 0
                  TimChannelEcntOvflwSetting = SEL0_OVRFLOW_SIG_ON_ECNT_BITWIDTH_8
                  TimChannelEcntResetSetting = SEL0_ECNT_IN_WRAP_AROUND_MODE
                  TimChannelEnable = false
                  TimChannelExtCaptureModeEnable = false
                  TimChannelExtCaptureSrc = SEL0_NEW_VAL_IRQ
                  TimChannelGpr0InputSelect = TIMEBASE_TBU_TS0
                  TimChannelGpr1InputSelect = TIMEBASE_TBU_TS0
                  TimChannelInputSelect = INPUT_OF_CURRENT_TIM_CHANNEL
                  TimChannelModeSelect = PWM_MEASUREMENT_MODE_TPWM
                  TimChannelOneShotMode = false
                  TimChannelPortPinSelect = NONE_SEL0
                  TimChannelSignalEdgeSelect = FALLING_EDGE
                  TimChannelTbu0Ts0BitsSelect = BITS_0_TO_23
                  TimChannelUsage = USED_BY_OTHER_DRIVERS_OR_UNUSED
                  TimChannelValInitSignal = VAL_LOW
                TimChannelInterrupt:
                  TimInterruptEnableOnCntOfl = false
                  TimInterruptEnableOnEcntOfl = false
                  TimInterruptEnableOnGlitchDet = false
                  TimInterruptEnableOnGprxOfl = false
                  TimInterruptEnableOnNewVal = false
                  TimInterruptEnableOnToDet = false
                  TimInterruptMode = GTM_INTERRUPT_LEVEL_MODE
                  TimNotification = NULL_PTR
                TimChannelTimeoutDetection: TimChTimeoutClockSelect=GTM_CONFIGURABLE_CLOCK_0, TimChTimeoutDetectionEnable=SEL0_TIMOUT_DISABLED, TimChTimeoutDuration=0
          Tim_1
            8 x TimChannel:
              TimChannel_0
                TimChannelErrorInterrupt:
                  TimInterruptEnableOnCntOflErr = false
                  TimInterruptEnableOnEcntOflErr = false
                  TimInterruptEnableOnGlitchDetErr = false
                  TimInterruptEnableOnGprxOflErr = false
                  TimInterruptEnableOnNewValErr = false
                  TimInterruptEnableOnToDetErr = false
                TimChannelFilterConfig:
                  TimChFilterCounterFreqSelect = GTM_CONFIGURABLE_CLOCK_0
                  TimChFilterModeForFallingEdge = IMMEDIATE_EDGE_PROPAGATION_MODE
                  TimChFilterModeForRisingEdge = IMMEDIATE_EDGE_PROPAGATION_MODE
                  TimChFilterTimeForFallingEdge = 0
                  TimChFilterTimeForRisingEdge = 0
                  TimChannelFilterEnable = false
                TimChannelGeneral:
                  TimChannelAruEnable = false
                  TimChannelClockSelect = GTM_CONFIGURABLE_CLOCK_0
                  TimChannelCntsInputSelect = CNT_VALUE
                  TimChannelCntsValue = 0
                  TimChannelEcntOvflwSetting = SEL0_OVRFLOW_SIG_ON_ECNT_BITWIDTH_8
                  TimChannelEcntResetSetting = SEL0_ECNT_IN_WRAP_AROUND_MODE
                  TimChannelEnable = false
                  TimChannelExtCaptureModeEnable = false
                  TimChannelExtCaptureSrc = SEL0_NEW_VAL_IRQ
                  TimChannelGpr0InputSelect = TIMEBASE_TBU_TS0
                  TimChannelGpr1InputSelect = TIMEBASE_TBU_TS0
                  TimChannelInputSelect = INPUT_OF_CURRENT_TIM_CHANNEL
                  TimChannelModeSelect = PWM_MEASUREMENT_MODE_TPWM
                  TimChannelOneShotMode = false
                  TimChannelPortPinSelect = NONE_SEL0
                  TimChannelSignalEdgeSelect = FALLING_EDGE
                  TimChannelTbu0Ts0BitsSelect = BITS_0_TO_23
                  TimChannelUsage = USED_BY_OTHER_DRIVERS_OR_UNUSED
                  TimChannelValInitSignal = VAL_LOW
                TimChannelInterrupt:
                  TimInterruptEnableOnCntOfl = false
                  TimInterruptEnableOnEcntOfl = false
                  TimInterruptEnableOnGlitchDet = false
                  TimInterruptEnableOnGprxOfl = false
                  TimInterruptEnableOnNewVal = false
                  TimInterruptEnableOnToDet = false
                  TimInterruptMode = GTM_INTERRUPT_LEVEL_MODE
                  TimNotification = NULL_PTR
                TimChannelTimeoutDetection: TimChTimeoutClockSelect=GTM_CONFIGURABLE_CLOCK_0, TimChTimeoutDetectionEnable=SEL0_TIMOUT_DISABLED, TimChTimeoutDuration=0
              TimChannel_1
                TimChannelErrorInterrupt:
                  TimInterruptEnableOnCntOflErr = false
                  TimInterruptEnableOnEcntOflErr = false
                  TimInterruptEnableOnGlitchDetErr = false
                  TimInterruptEnableOnGprxOflErr = false
                  TimInterruptEnableOnNewValErr = false
                  TimInterruptEnableOnToDetErr = false
                TimChannelFilterConfig:
                  TimChFilterCounterFreqSelect = GTM_CONFIGURABLE_CLOCK_0
                  TimChFilterModeForFallingEdge = IMMEDIATE_EDGE_PROPAGATION_MODE
                  TimChFilterModeForRisingEdge = IMMEDIATE_EDGE_PROPAGATION_MODE
                  TimChFilterTimeForFallingEdge = 0
                  TimChFilterTimeForRisingEdge = 0
                  TimChannelFilterEnable = false
                TimChannelGeneral:
                  TimChannelAruEnable = false
                  TimChannelClockSelect = GTM_CONFIGURABLE_CLOCK_0
                  TimChannelCntsInputSelect = CNT_VALUE
                  TimChannelCntsValue = 0
                  TimChannelEcntOvflwSetting = SEL0_OVRFLOW_SIG_ON_ECNT_BITWIDTH_8
                  TimChannelEcntResetSetting = SEL0_ECNT_IN_WRAP_AROUND_MODE
                  TimChannelEnable = false
                  TimChannelExtCaptureModeEnable = false
                  TimChannelExtCaptureSrc = SEL0_NEW_VAL_IRQ
                  TimChannelGpr0InputSelect = TIMEBASE_TBU_TS0
                  TimChannelGpr1InputSelect = TIMEBASE_TBU_TS0
                  TimChannelInputSelect = INPUT_OF_CURRENT_TIM_CHANNEL
                  TimChannelModeSelect = PWM_MEASUREMENT_MODE_TPWM
                  TimChannelOneShotMode = false
                  TimChannelPortPinSelect = NONE_SEL0
                  TimChannelSignalEdgeSelect = FALLING_EDGE
                  TimChannelTbu0Ts0BitsSelect = BITS_0_TO_23
                  TimChannelUsage = USED_BY_OTHER_DRIVERS_OR_UNUSED
                  TimChannelValInitSignal = VAL_LOW
                TimChannelInterrupt:
                  TimInterruptEnableOnCntOfl = false
                  TimInterruptEnableOnEcntOfl = false
                  TimInterruptEnableOnGlitchDet = false
                  TimInterruptEnableOnGprxOfl = false
                  TimInterruptEnableOnNewVal = false
                  TimInterruptEnableOnToDet = false
                  TimInterruptMode = GTM_INTERRUPT_LEVEL_MODE
                  TimNotification = NULL_PTR
                TimChannelTimeoutDetection: TimChTimeoutClockSelect=GTM_CONFIGURABLE_CLOCK_0, TimChTimeoutDetectionEnable=SEL0_TIMOUT_DISABLED, TimChTimeoutDuration=0
              TimChannel_2
                TimChannelErrorInterrupt:
                  TimInterruptEnableOnCntOflErr = false
                  TimInterruptEnableOnEcntOflErr = false
                  TimInterruptEnableOnGlitchDetErr = false
                  TimInterruptEnableOnGprxOflErr = false
                  TimInterruptEnableOnNewValErr = false
                  TimInterruptEnableOnToDetErr = false
                TimChannelFilterConfig:
                  TimChFilterCounterFreqSelect = GTM_CONFIGURABLE_CLOCK_0
                  TimChFilterModeForFallingEdge = IMMEDIATE_EDGE_PROPAGATION_MODE
                  TimChFilterModeForRisingEdge = IMMEDIATE_EDGE_PROPAGATION_MODE
                  TimChFilterTimeForFallingEdge = 0
                  TimChFilterTimeForRisingEdge = 0
                  TimChannelFilterEnable = false
                TimChannelGeneral:
                  TimChannelAruEnable = false
                  TimChannelClockSelect = GTM_CONFIGURABLE_CLOCK_0
                  TimChannelCntsInputSelect = CNT_VALUE
                  TimChannelCntsValue = 0
                  TimChannelEcntOvflwSetting = SEL0_OVRFLOW_SIG_ON_ECNT_BITWIDTH_8
                  TimChannelEcntResetSetting = SEL0_ECNT_IN_WRAP_AROUND_MODE
                  TimChannelEnable = false
                  TimChannelExtCaptureModeEnable = false
                  TimChannelExtCaptureSrc = SEL0_NEW_VAL_IRQ
                  TimChannelGpr0InputSelect = TIMEBASE_TBU_TS0
                  TimChannelGpr1InputSelect = TIMEBASE_TBU_TS0
                  TimChannelInputSelect = INPUT_OF_CURRENT_TIM_CHANNEL
                  TimChannelModeSelect = PWM_MEASUREMENT_MODE_TPWM
                  TimChannelOneShotMode = false
                  TimChannelPortPinSelect = NONE_SEL0
                  TimChannelSignalEdgeSelect = FALLING_EDGE
                  TimChannelTbu0Ts0BitsSelect = BITS_0_TO_23
                  TimChannelUsage = USED_BY_OTHER_DRIVERS_OR_UNUSED
                  TimChannelValInitSignal = VAL_LOW
                TimChannelInterrupt:
                  TimInterruptEnableOnCntOfl = false
                  TimInterruptEnableOnEcntOfl = false
                  TimInterruptEnableOnGlitchDet = false
                  TimInterruptEnableOnGprxOfl = false
                  TimInterruptEnableOnNewVal = false
                  TimInterruptEnableOnToDet = false
                  TimInterruptMode = GTM_INTERRUPT_LEVEL_MODE
                  TimNotification = NULL_PTR
                TimChannelTimeoutDetection: TimChTimeoutClockSelect=GTM_CONFIGURABLE_CLOCK_0, TimChTimeoutDetectionEnable=SEL0_TIMOUT_DISABLED, TimChTimeoutDuration=0
              TimChannel_3
                TimChannelErrorInterrupt:
                  TimInterruptEnableOnCntOflErr = false
                  TimInterruptEnableOnEcntOflErr = false
                  TimInterruptEnableOnGlitchDetErr = false
                  TimInterruptEnableOnGprxOflErr = false
                  TimInterruptEnableOnNewValErr = false
                  TimInterruptEnableOnToDetErr = false
                TimChannelFilterConfig:
                  TimChFilterCounterFreqSelect = GTM_CONFIGURABLE_CLOCK_0
                  TimChFilterModeForFallingEdge = IMMEDIATE_EDGE_PROPAGATION_MODE
                  TimChFilterModeForRisingEdge = IMMEDIATE_EDGE_PROPAGATION_MODE
                  TimChFilterTimeForFallingEdge = 0
                  TimChFilterTimeForRisingEdge = 0
                  TimChannelFilterEnable = false
                TimChannelGeneral:
                  TimChannelAruEnable = false
                  TimChannelClockSelect = GTM_CONFIGURABLE_CLOCK_0
                  TimChannelCntsInputSelect = CNT_VALUE
                  TimChannelCntsValue = 0
                  TimChannelEcntOvflwSetting = SEL0_OVRFLOW_SIG_ON_ECNT_BITWIDTH_8
                  TimChannelEcntResetSetting = SEL0_ECNT_IN_WRAP_AROUND_MODE
                  TimChannelEnable = false
                  TimChannelExtCaptureModeEnable = false
                  TimChannelExtCaptureSrc = SEL0_NEW_VAL_IRQ
                  TimChannelGpr0InputSelect = TIMEBASE_TBU_TS0
                  TimChannelGpr1InputSelect = TIMEBASE_TBU_TS0
                  TimChannelInputSelect = INPUT_OF_CURRENT_TIM_CHANNEL
                  TimChannelModeSelect = PWM_MEASUREMENT_MODE_TPWM
                  TimChannelOneShotMode = false
                  TimChannelPortPinSelect = NONE_SEL0
                  TimChannelSignalEdgeSelect = FALLING_EDGE
                  TimChannelTbu0Ts0BitsSelect = BITS_0_TO_23
                  TimChannelUsage = USED_BY_OTHER_DRIVERS_OR_UNUSED
                  TimChannelValInitSignal = VAL_LOW
                TimChannelInterrupt:
                  TimInterruptEnableOnCntOfl = false
                  TimInterruptEnableOnEcntOfl = false
                  TimInterruptEnableOnGlitchDet = false
                  TimInterruptEnableOnGprxOfl = false
                  TimInterruptEnableOnNewVal = false
                  TimInterruptEnableOnToDet = false
                  TimInterruptMode = GTM_INTERRUPT_LEVEL_MODE
                  TimNotification = NULL_PTR
                TimChannelTimeoutDetection: TimChTimeoutClockSelect=GTM_CONFIGURABLE_CLOCK_0, TimChTimeoutDetectionEnable=SEL0_TIMOUT_DISABLED, TimChTimeoutDuration=0
              TimChannel_4
                TimChannelErrorInterrupt:
                  TimInterruptEnableOnCntOflErr = false
                  TimInterruptEnableOnEcntOflErr = false
                  TimInterruptEnableOnGlitchDetErr = false
                  TimInterruptEnableOnGprxOflErr = false
                  TimInterruptEnableOnNewValErr = false
                  TimInterruptEnableOnToDetErr = false
                TimChannelFilterConfig:
                  TimChFilterCounterFreqSelect = GTM_CONFIGURABLE_CLOCK_0
                  TimChFilterModeForFallingEdge = IMMEDIATE_EDGE_PROPAGATION_MODE
                  TimChFilterModeForRisingEdge = IMMEDIATE_EDGE_PROPAGATION_MODE
                  TimChFilterTimeForFallingEdge = 0
                  TimChFilterTimeForRisingEdge = 0
                  TimChannelFilterEnable = false
                TimChannelGeneral:
                  TimChannelAruEnable = false
                  TimChannelClockSelect = GTM_CONFIGURABLE_CLOCK_0
                  TimChannelCntsInputSelect = CNT_VALUE
                  TimChannelCntsValue = 0
                  TimChannelEcntOvflwSetting = SEL0_OVRFLOW_SIG_ON_ECNT_BITWIDTH_8
                  TimChannelEcntResetSetting = SEL0_ECNT_IN_WRAP_AROUND_MODE
                  TimChannelEnable = false
                  TimChannelExtCaptureModeEnable = false
                  TimChannelExtCaptureSrc = SEL0_NEW_VAL_IRQ
                  TimChannelGpr0InputSelect = TIMEBASE_TBU_TS0
                  TimChannelGpr1InputSelect = TIMEBASE_TBU_TS0
                  TimChannelInputSelect = INPUT_OF_CURRENT_TIM_CHANNEL
                  TimChannelModeSelect = PWM_MEASUREMENT_MODE_TPWM
                  TimChannelOneShotMode = false
                  TimChannelPortPinSelect = NONE_SEL0
                  TimChannelSignalEdgeSelect = FALLING_EDGE
                  TimChannelTbu0Ts0BitsSelect = BITS_0_TO_23
                  TimChannelUsage = USED_BY_OTHER_DRIVERS_OR_UNUSED
                  TimChannelValInitSignal = VAL_LOW
                TimChannelInterrupt:
                  TimInterruptEnableOnCntOfl = false
                  TimInterruptEnableOnEcntOfl = false
                  TimInterruptEnableOnGlitchDet = false
                  TimInterruptEnableOnGprxOfl = false
                  TimInterruptEnableOnNewVal = false
                  TimInterruptEnableOnToDet = false
                  TimInterruptMode = GTM_INTERRUPT_LEVEL_MODE
                  TimNotification = NULL_PTR
                TimChannelTimeoutDetection: TimChTimeoutClockSelect=GTM_CONFIGURABLE_CLOCK_0, TimChTimeoutDetectionEnable=SEL0_TIMOUT_DISABLED, TimChTimeoutDuration=0
              TimChannel_5
                TimChannelErrorInterrupt:
                  TimInterruptEnableOnCntOflErr = false
                  TimInterruptEnableOnEcntOflErr = false
                  TimInterruptEnableOnGlitchDetErr = false
                  TimInterruptEnableOnGprxOflErr = false
                  TimInterruptEnableOnNewValErr = false
                  TimInterruptEnableOnToDetErr = false
                TimChannelFilterConfig:
                  TimChFilterCounterFreqSelect = GTM_CONFIGURABLE_CLOCK_0
                  TimChFilterModeForFallingEdge = IMMEDIATE_EDGE_PROPAGATION_MODE
                  TimChFilterModeForRisingEdge = IMMEDIATE_EDGE_PROPAGATION_MODE
                  TimChFilterTimeForFallingEdge = 0
                  TimChFilterTimeForRisingEdge = 0
                  TimChannelFilterEnable = false
                TimChannelGeneral:
                  TimChannelAruEnable = false
                  TimChannelClockSelect = GTM_CONFIGURABLE_CLOCK_0
                  TimChannelCntsInputSelect = CNT_VALUE
                  TimChannelCntsValue = 0
                  TimChannelEcntOvflwSetting = SEL0_OVRFLOW_SIG_ON_ECNT_BITWIDTH_8
                  TimChannelEcntResetSetting = SEL0_ECNT_IN_WRAP_AROUND_MODE
                  TimChannelEnable = false
                  TimChannelExtCaptureModeEnable = false
                  TimChannelExtCaptureSrc = SEL0_NEW_VAL_IRQ
                  TimChannelGpr0InputSelect = TIMEBASE_TBU_TS0
                  TimChannelGpr1InputSelect = TIMEBASE_TBU_TS0
                  TimChannelInputSelect = INPUT_OF_CURRENT_TIM_CHANNEL
                  TimChannelModeSelect = PWM_MEASUREMENT_MODE_TPWM
                  TimChannelOneShotMode = false
                  TimChannelPortPinSelect = NONE_SEL0
                  TimChannelSignalEdgeSelect = FALLING_EDGE
                  TimChannelTbu0Ts0BitsSelect = BITS_0_TO_23
                  TimChannelUsage = USED_BY_OTHER_DRIVERS_OR_UNUSED
                  TimChannelValInitSignal = VAL_LOW
                TimChannelInterrupt:
                  TimInterruptEnableOnCntOfl = false
                  TimInterruptEnableOnEcntOfl = false
                  TimInterruptEnableOnGlitchDet = false
                  TimInterruptEnableOnGprxOfl = false
                  TimInterruptEnableOnNewVal = false
                  TimInterruptEnableOnToDet = false
                  TimInterruptMode = GTM_INTERRUPT_LEVEL_MODE
                  TimNotification = NULL_PTR
                TimChannelTimeoutDetection: TimChTimeoutClockSelect=GTM_CONFIGURABLE_CLOCK_0, TimChTimeoutDetectionEnable=SEL0_TIMOUT_DISABLED, TimChTimeoutDuration=0
              TimChannel_6
                TimChannelErrorInterrupt:
                  TimInterruptEnableOnCntOflErr = false
                  TimInterruptEnableOnEcntOflErr = false
                  TimInterruptEnableOnGlitchDetErr = false
                  TimInterruptEnableOnGprxOflErr = false
                  TimInterruptEnableOnNewValErr = false
                  TimInterruptEnableOnToDetErr = false
                TimChannelFilterConfig:
                  TimChFilterCounterFreqSelect = GTM_CONFIGURABLE_CLOCK_0
                  TimChFilterModeForFallingEdge = IMMEDIATE_EDGE_PROPAGATION_MODE
                  TimChFilterModeForRisingEdge = IMMEDIATE_EDGE_PROPAGATION_MODE
                  TimChFilterTimeForFallingEdge = 0
                  TimChFilterTimeForRisingEdge = 0
                  TimChannelFilterEnable = false
                TimChannelGeneral:
                  TimChannelAruEnable = false
                  TimChannelClockSelect = GTM_CONFIGURABLE_CLOCK_0
                  TimChannelCntsInputSelect = CNT_VALUE
                  TimChannelCntsValue = 0
                  TimChannelEcntOvflwSetting = SEL0_OVRFLOW_SIG_ON_ECNT_BITWIDTH_8
                  TimChannelEcntResetSetting = SEL0_ECNT_IN_WRAP_AROUND_MODE
                  TimChannelEnable = false
                  TimChannelExtCaptureModeEnable = false
                  TimChannelExtCaptureSrc = SEL0_NEW_VAL_IRQ
                  TimChannelGpr0InputSelect = TIMEBASE_TBU_TS0
                  TimChannelGpr1InputSelect = TIMEBASE_TBU_TS0
                  TimChannelInputSelect = INPUT_OF_CURRENT_TIM_CHANNEL
                  TimChannelModeSelect = PWM_MEASUREMENT_MODE_TPWM
                  TimChannelOneShotMode = false
                  TimChannelPortPinSelect = NONE_SEL0
                  TimChannelSignalEdgeSelect = FALLING_EDGE
                  TimChannelTbu0Ts0BitsSelect = BITS_0_TO_23
                  TimChannelUsage = USED_BY_OTHER_DRIVERS_OR_UNUSED
                  TimChannelValInitSignal = VAL_LOW
                TimChannelInterrupt:
                  TimInterruptEnableOnCntOfl = false
                  TimInterruptEnableOnEcntOfl = false
                  TimInterruptEnableOnGlitchDet = false
                  TimInterruptEnableOnGprxOfl = false
                  TimInterruptEnableOnNewVal = false
                  TimInterruptEnableOnToDet = false
                  TimInterruptMode = GTM_INTERRUPT_LEVEL_MODE
                  TimNotification = NULL_PTR
                TimChannelTimeoutDetection: TimChTimeoutClockSelect=GTM_CONFIGURABLE_CLOCK_0, TimChTimeoutDetectionEnable=SEL0_TIMOUT_DISABLED, TimChTimeoutDuration=0
              TimChannel_7
                TimChannelErrorInterrupt:
                  TimInterruptEnableOnCntOflErr = false
                  TimInterruptEnableOnEcntOflErr = false
                  TimInterruptEnableOnGlitchDetErr = false
                  TimInterruptEnableOnGprxOflErr = false
                  TimInterruptEnableOnNewValErr = false
                  TimInterruptEnableOnToDetErr = false
                TimChannelFilterConfig:
                  TimChFilterCounterFreqSelect = GTM_CONFIGURABLE_CLOCK_0
                  TimChFilterModeForFallingEdge = IMMEDIATE_EDGE_PROPAGATION_MODE
                  TimChFilterModeForRisingEdge = IMMEDIATE_EDGE_PROPAGATION_MODE
                  TimChFilterTimeForFallingEdge = 0
                  TimChFilterTimeForRisingEdge = 0
                  TimChannelFilterEnable = false
                TimChannelGeneral:
                  TimChannelAruEnable = false
                  TimChannelClockSelect = GTM_CONFIGURABLE_CLOCK_0
                  TimChannelCntsInputSelect = CNT_VALUE
                  TimChannelCntsValue = 0
                  TimChannelEcntOvflwSetting = SEL0_OVRFLOW_SIG_ON_ECNT_BITWIDTH_8
                  TimChannelEcntResetSetting = SEL0_ECNT_IN_WRAP_AROUND_MODE
                  TimChannelEnable = false
                  TimChannelExtCaptureModeEnable = false
                  TimChannelExtCaptureSrc = SEL0_NEW_VAL_IRQ
                  TimChannelGpr0InputSelect = TIMEBASE_TBU_TS0
                  TimChannelGpr1InputSelect = TIMEBASE_TBU_TS0
                  TimChannelInputSelect = INPUT_OF_CURRENT_TIM_CHANNEL
                  TimChannelModeSelect = PWM_MEASUREMENT_MODE_TPWM
                  TimChannelOneShotMode = false
                  TimChannelPortPinSelect = NONE_SEL0
                  TimChannelSignalEdgeSelect = FALLING_EDGE
                  TimChannelTbu0Ts0BitsSelect = BITS_0_TO_23
                  TimChannelUsage = USED_BY_OTHER_DRIVERS_OR_UNUSED
                  TimChannelValInitSignal = VAL_LOW
                TimChannelInterrupt:
                  TimInterruptEnableOnCntOfl = false
                  TimInterruptEnableOnEcntOfl = false
                  TimInterruptEnableOnGlitchDet = false
                  TimInterruptEnableOnGprxOfl = false
                  TimInterruptEnableOnNewVal = false
                  TimInterruptEnableOnToDet = false
                  TimInterruptMode = GTM_INTERRUPT_LEVEL_MODE
                  TimNotification = NULL_PTR
                TimChannelTimeoutDetection: TimChTimeoutClockSelect=GTM_CONFIGURABLE_CLOCK_0, TimChTimeoutDetectionEnable=SEL0_TIMOUT_DISABLED, TimChTimeoutDuration=0
          Tim_2
            8 x TimChannel:
              TimChannel_0
                TimChannelErrorInterrupt:
                  TimInterruptEnableOnCntOflErr = false
                  TimInterruptEnableOnEcntOflErr = false
                  TimInterruptEnableOnGlitchDetErr = false
                  TimInterruptEnableOnGprxOflErr = false
                  TimInterruptEnableOnNewValErr = false
                  TimInterruptEnableOnToDetErr = false
                TimChannelFilterConfig:
                  TimChFilterCounterFreqSelect = GTM_CONFIGURABLE_CLOCK_0
                  TimChFilterModeForFallingEdge = IMMEDIATE_EDGE_PROPAGATION_MODE
                  TimChFilterModeForRisingEdge = IMMEDIATE_EDGE_PROPAGATION_MODE
                  TimChFilterTimeForFallingEdge = 0
                  TimChFilterTimeForRisingEdge = 0
                  TimChannelFilterEnable = false
                TimChannelGeneral:
                  TimChannelAruEnable = false
                  TimChannelClockSelect = GTM_CONFIGURABLE_CLOCK_0
                  TimChannelCntsInputSelect = CNT_VALUE
                  TimChannelCntsValue = 0
                  TimChannelEcntOvflwSetting = SEL0_OVRFLOW_SIG_ON_ECNT_BITWIDTH_8
                  TimChannelEcntResetSetting = SEL0_ECNT_IN_WRAP_AROUND_MODE
                  TimChannelEnable = false
                  TimChannelExtCaptureModeEnable = false
                  TimChannelExtCaptureSrc = SEL0_NEW_VAL_IRQ
                  TimChannelGpr0InputSelect = TIMEBASE_TBU_TS0
                  TimChannelGpr1InputSelect = TIMEBASE_TBU_TS0
                  TimChannelInputSelect = INPUT_OF_CURRENT_TIM_CHANNEL
                  TimChannelModeSelect = PWM_MEASUREMENT_MODE_TPWM
                  TimChannelOneShotMode = false
                  TimChannelPortPinSelect = NONE_SEL0
                  TimChannelSignalEdgeSelect = FALLING_EDGE
                  TimChannelTbu0Ts0BitsSelect = BITS_0_TO_23
                  TimChannelUsage = USED_BY_OTHER_DRIVERS_OR_UNUSED
                  TimChannelValInitSignal = VAL_LOW
                TimChannelInterrupt:
                  TimInterruptEnableOnCntOfl = false
                  TimInterruptEnableOnEcntOfl = false
                  TimInterruptEnableOnGlitchDet = false
                  TimInterruptEnableOnGprxOfl = false
                  TimInterruptEnableOnNewVal = false
                  TimInterruptEnableOnToDet = false
                  TimInterruptMode = GTM_INTERRUPT_LEVEL_MODE
                  TimNotification = NULL_PTR
                TimChannelTimeoutDetection: TimChTimeoutClockSelect=GTM_CONFIGURABLE_CLOCK_0, TimChTimeoutDetectionEnable=SEL0_TIMOUT_DISABLED, TimChTimeoutDuration=0
              TimChannel_1
                TimChannelErrorInterrupt:
                  TimInterruptEnableOnCntOflErr = false
                  TimInterruptEnableOnEcntOflErr = false
                  TimInterruptEnableOnGlitchDetErr = false
                  TimInterruptEnableOnGprxOflErr = false
                  TimInterruptEnableOnNewValErr = false
                  TimInterruptEnableOnToDetErr = false
                TimChannelFilterConfig:
                  TimChFilterCounterFreqSelect = GTM_CONFIGURABLE_CLOCK_0
                  TimChFilterModeForFallingEdge = IMMEDIATE_EDGE_PROPAGATION_MODE
                  TimChFilterModeForRisingEdge = IMMEDIATE_EDGE_PROPAGATION_MODE
                  TimChFilterTimeForFallingEdge = 0
                  TimChFilterTimeForRisingEdge = 0
                  TimChannelFilterEnable = false
                TimChannelGeneral:
                  TimChannelAruEnable = false
                  TimChannelClockSelect = GTM_CONFIGURABLE_CLOCK_0
                  TimChannelCntsInputSelect = CNT_VALUE
                  TimChannelCntsValue = 0
                  TimChannelEcntOvflwSetting = SEL0_OVRFLOW_SIG_ON_ECNT_BITWIDTH_8
                  TimChannelEcntResetSetting = SEL0_ECNT_IN_WRAP_AROUND_MODE
                  TimChannelEnable = false
                  TimChannelExtCaptureModeEnable = false
                  TimChannelExtCaptureSrc = SEL0_NEW_VAL_IRQ
                  TimChannelGpr0InputSelect = TIMEBASE_TBU_TS0
                  TimChannelGpr1InputSelect = TIMEBASE_TBU_TS0
                  TimChannelInputSelect = INPUT_OF_CURRENT_TIM_CHANNEL
                  TimChannelModeSelect = PWM_MEASUREMENT_MODE_TPWM
                  TimChannelOneShotMode = false
                  TimChannelPortPinSelect = NONE_SEL0
                  TimChannelSignalEdgeSelect = FALLING_EDGE
                  TimChannelTbu0Ts0BitsSelect = BITS_0_TO_23
                  TimChannelUsage = USED_BY_OTHER_DRIVERS_OR_UNUSED
                  TimChannelValInitSignal = VAL_LOW
                TimChannelInterrupt:
                  TimInterruptEnableOnCntOfl = false
                  TimInterruptEnableOnEcntOfl = false
                  TimInterruptEnableOnGlitchDet = false
                  TimInterruptEnableOnGprxOfl = false
                  TimInterruptEnableOnNewVal = false
                  TimInterruptEnableOnToDet = false
                  TimInterruptMode = GTM_INTERRUPT_LEVEL_MODE
                  TimNotification = NULL_PTR
                TimChannelTimeoutDetection: TimChTimeoutClockSelect=GTM_CONFIGURABLE_CLOCK_0, TimChTimeoutDetectionEnable=SEL0_TIMOUT_DISABLED, TimChTimeoutDuration=0
              TimChannel_2
                TimChannelErrorInterrupt:
                  TimInterruptEnableOnCntOflErr = false
                  TimInterruptEnableOnEcntOflErr = false
                  TimInterruptEnableOnGlitchDetErr = false
                  TimInterruptEnableOnGprxOflErr = false
                  TimInterruptEnableOnNewValErr = false
                  TimInterruptEnableOnToDetErr = false
                TimChannelFilterConfig:
                  TimChFilterCounterFreqSelect = GTM_CONFIGURABLE_CLOCK_0
                  TimChFilterModeForFallingEdge = IMMEDIATE_EDGE_PROPAGATION_MODE
                  TimChFilterModeForRisingEdge = IMMEDIATE_EDGE_PROPAGATION_MODE
                  TimChFilterTimeForFallingEdge = 0
                  TimChFilterTimeForRisingEdge = 0
                  TimChannelFilterEnable = false
                TimChannelGeneral:
                  TimChannelAruEnable = false
                  TimChannelClockSelect = GTM_CONFIGURABLE_CLOCK_0
                  TimChannelCntsInputSelect = CNT_VALUE
                  TimChannelCntsValue = 0
                  TimChannelEcntOvflwSetting = SEL0_OVRFLOW_SIG_ON_ECNT_BITWIDTH_8
                  TimChannelEcntResetSetting = SEL0_ECNT_IN_WRAP_AROUND_MODE
                  TimChannelEnable = false
                  TimChannelExtCaptureModeEnable = false
                  TimChannelExtCaptureSrc = SEL0_NEW_VAL_IRQ
                  TimChannelGpr0InputSelect = TIMEBASE_TBU_TS0
                  TimChannelGpr1InputSelect = TIMEBASE_TBU_TS0
                  TimChannelInputSelect = INPUT_OF_CURRENT_TIM_CHANNEL
                  TimChannelModeSelect = PWM_MEASUREMENT_MODE_TPWM
                  TimChannelOneShotMode = false
                  TimChannelPortPinSelect = NONE_SEL0
                  TimChannelSignalEdgeSelect = FALLING_EDGE
                  TimChannelTbu0Ts0BitsSelect = BITS_0_TO_23
                  TimChannelUsage = USED_BY_OTHER_DRIVERS_OR_UNUSED
                  TimChannelValInitSignal = VAL_LOW
                TimChannelInterrupt:
                  TimInterruptEnableOnCntOfl = false
                  TimInterruptEnableOnEcntOfl = false
                  TimInterruptEnableOnGlitchDet = false
                  TimInterruptEnableOnGprxOfl = false
                  TimInterruptEnableOnNewVal = false
                  TimInterruptEnableOnToDet = false
                  TimInterruptMode = GTM_INTERRUPT_LEVEL_MODE
                  TimNotification = NULL_PTR
                TimChannelTimeoutDetection: TimChTimeoutClockSelect=GTM_CONFIGURABLE_CLOCK_0, TimChTimeoutDetectionEnable=SEL0_TIMOUT_DISABLED, TimChTimeoutDuration=0
              TimChannel_3
                TimChannelErrorInterrupt:
                  TimInterruptEnableOnCntOflErr = false
                  TimInterruptEnableOnEcntOflErr = false
                  TimInterruptEnableOnGlitchDetErr = false
                  TimInterruptEnableOnGprxOflErr = false
                  TimInterruptEnableOnNewValErr = false
                  TimInterruptEnableOnToDetErr = false
                TimChannelFilterConfig:
                  TimChFilterCounterFreqSelect = GTM_CONFIGURABLE_CLOCK_0
                  TimChFilterModeForFallingEdge = IMMEDIATE_EDGE_PROPAGATION_MODE
                  TimChFilterModeForRisingEdge = IMMEDIATE_EDGE_PROPAGATION_MODE
                  TimChFilterTimeForFallingEdge = 0
                  TimChFilterTimeForRisingEdge = 0
                  TimChannelFilterEnable = false
                TimChannelGeneral:
                  TimChannelAruEnable = false
                  TimChannelClockSelect = GTM_CONFIGURABLE_CLOCK_0
                  TimChannelCntsInputSelect = CNT_VALUE
                  TimChannelCntsValue = 0
                  TimChannelEcntOvflwSetting = SEL0_OVRFLOW_SIG_ON_ECNT_BITWIDTH_8
                  TimChannelEcntResetSetting = SEL0_ECNT_IN_WRAP_AROUND_MODE
                  TimChannelEnable = false
                  TimChannelExtCaptureModeEnable = false
                  TimChannelExtCaptureSrc = SEL0_NEW_VAL_IRQ
                  TimChannelGpr0InputSelect = TIMEBASE_TBU_TS0
                  TimChannelGpr1InputSelect = TIMEBASE_TBU_TS0
                  TimChannelInputSelect = INPUT_OF_CURRENT_TIM_CHANNEL
                  TimChannelModeSelect = PWM_MEASUREMENT_MODE_TPWM
                  TimChannelOneShotMode = false
                  TimChannelPortPinSelect = NONE_SEL0
                  TimChannelSignalEdgeSelect = FALLING_EDGE
                  TimChannelTbu0Ts0BitsSelect = BITS_0_TO_23
                  TimChannelUsage = USED_BY_OTHER_DRIVERS_OR_UNUSED
                  TimChannelValInitSignal = VAL_LOW
                TimChannelInterrupt:
                  TimInterruptEnableOnCntOfl = false
                  TimInterruptEnableOnEcntOfl = false
                  TimInterruptEnableOnGlitchDet = false
                  TimInterruptEnableOnGprxOfl = false
                  TimInterruptEnableOnNewVal = false
                  TimInterruptEnableOnToDet = false
                  TimInterruptMode = GTM_INTERRUPT_LEVEL_MODE
                  TimNotification = NULL_PTR
                TimChannelTimeoutDetection: TimChTimeoutClockSelect=GTM_CONFIGURABLE_CLOCK_0, TimChTimeoutDetectionEnable=SEL0_TIMOUT_DISABLED, TimChTimeoutDuration=0
              TimChannel_4
                TimChannelErrorInterrupt:
                  TimInterruptEnableOnCntOflErr = false
                  TimInterruptEnableOnEcntOflErr = false
                  TimInterruptEnableOnGlitchDetErr = false
                  TimInterruptEnableOnGprxOflErr = false
                  TimInterruptEnableOnNewValErr = false
                  TimInterruptEnableOnToDetErr = false
                TimChannelFilterConfig:
                  TimChFilterCounterFreqSelect = GTM_CONFIGURABLE_CLOCK_0
                  TimChFilterModeForFallingEdge = IMMEDIATE_EDGE_PROPAGATION_MODE
                  TimChFilterModeForRisingEdge = IMMEDIATE_EDGE_PROPAGATION_MODE
                  TimChFilterTimeForFallingEdge = 0
                  TimChFilterTimeForRisingEdge = 0
                  TimChannelFilterEnable = false
                TimChannelGeneral:
                  TimChannelAruEnable = false
                  TimChannelClockSelect = GTM_CONFIGURABLE_CLOCK_0
                  TimChannelCntsInputSelect = CNT_VALUE
                  TimChannelCntsValue = 0
                  TimChannelEcntOvflwSetting = SEL0_OVRFLOW_SIG_ON_ECNT_BITWIDTH_8
                  TimChannelEcntResetSetting = SEL0_ECNT_IN_WRAP_AROUND_MODE
                  TimChannelEnable = false
                  TimChannelExtCaptureModeEnable = false
                  TimChannelExtCaptureSrc = SEL0_NEW_VAL_IRQ
                  TimChannelGpr0InputSelect = TIMEBASE_TBU_TS0
                  TimChannelGpr1InputSelect = TIMEBASE_TBU_TS0
                  TimChannelInputSelect = INPUT_OF_CURRENT_TIM_CHANNEL
                  TimChannelModeSelect = PWM_MEASUREMENT_MODE_TPWM
                  TimChannelOneShotMode = false
                  TimChannelPortPinSelect = NONE_SEL0
                  TimChannelSignalEdgeSelect = FALLING_EDGE
                  TimChannelTbu0Ts0BitsSelect = BITS_0_TO_23
                  TimChannelUsage = USED_BY_OTHER_DRIVERS_OR_UNUSED
                  TimChannelValInitSignal = VAL_LOW
                TimChannelInterrupt:
                  TimInterruptEnableOnCntOfl = false
                  TimInterruptEnableOnEcntOfl = false
                  TimInterruptEnableOnGlitchDet = false
                  TimInterruptEnableOnGprxOfl = false
                  TimInterruptEnableOnNewVal = false
                  TimInterruptEnableOnToDet = false
                  TimInterruptMode = GTM_INTERRUPT_LEVEL_MODE
                  TimNotification = NULL_PTR
                TimChannelTimeoutDetection: TimChTimeoutClockSelect=GTM_CONFIGURABLE_CLOCK_0, TimChTimeoutDetectionEnable=SEL0_TIMOUT_DISABLED, TimChTimeoutDuration=0
              TimChannel_5
                TimChannelErrorInterrupt:
                  TimInterruptEnableOnCntOflErr = false
                  TimInterruptEnableOnEcntOflErr = false
                  TimInterruptEnableOnGlitchDetErr = false
                  TimInterruptEnableOnGprxOflErr = false
                  TimInterruptEnableOnNewValErr = false
                  TimInterruptEnableOnToDetErr = false
                TimChannelFilterConfig:
                  TimChFilterCounterFreqSelect = GTM_CONFIGURABLE_CLOCK_0
                  TimChFilterModeForFallingEdge = IMMEDIATE_EDGE_PROPAGATION_MODE
                  TimChFilterModeForRisingEdge = IMMEDIATE_EDGE_PROPAGATION_MODE
                  TimChFilterTimeForFallingEdge = 0
                  TimChFilterTimeForRisingEdge = 0
                  TimChannelFilterEnable = false
                TimChannelGeneral:
                  TimChannelAruEnable = false
                  TimChannelClockSelect = GTM_CONFIGURABLE_CLOCK_0
                  TimChannelCntsInputSelect = CNT_VALUE
                  TimChannelCntsValue = 0
                  TimChannelEcntOvflwSetting = SEL0_OVRFLOW_SIG_ON_ECNT_BITWIDTH_8
                  TimChannelEcntResetSetting = SEL0_ECNT_IN_WRAP_AROUND_MODE
                  TimChannelEnable = false
                  TimChannelExtCaptureModeEnable = false
                  TimChannelExtCaptureSrc = SEL0_NEW_VAL_IRQ
                  TimChannelGpr0InputSelect = TIMEBASE_TBU_TS0
                  TimChannelGpr1InputSelect = TIMEBASE_TBU_TS0
                  TimChannelInputSelect = INPUT_OF_CURRENT_TIM_CHANNEL
                  TimChannelModeSelect = PWM_MEASUREMENT_MODE_TPWM
                  TimChannelOneShotMode = false
                  TimChannelPortPinSelect = NONE_SEL0
                  TimChannelSignalEdgeSelect = FALLING_EDGE
                  TimChannelTbu0Ts0BitsSelect = BITS_0_TO_23
                  TimChannelUsage = USED_BY_OTHER_DRIVERS_OR_UNUSED
                  TimChannelValInitSignal = VAL_LOW
                TimChannelInterrupt:
                  TimInterruptEnableOnCntOfl = false
                  TimInterruptEnableOnEcntOfl = false
                  TimInterruptEnableOnGlitchDet = false
                  TimInterruptEnableOnGprxOfl = false
                  TimInterruptEnableOnNewVal = false
                  TimInterruptEnableOnToDet = false
                  TimInterruptMode = GTM_INTERRUPT_LEVEL_MODE
                  TimNotification = NULL_PTR
                TimChannelTimeoutDetection: TimChTimeoutClockSelect=GTM_CONFIGURABLE_CLOCK_0, TimChTimeoutDetectionEnable=SEL0_TIMOUT_DISABLED, TimChTimeoutDuration=0
              TimChannel_6
                TimChannelErrorInterrupt:
                  TimInterruptEnableOnCntOflErr = false
                  TimInterruptEnableOnEcntOflErr = false
                  TimInterruptEnableOnGlitchDetErr = false
                  TimInterruptEnableOnGprxOflErr = false
                  TimInterruptEnableOnNewValErr = false
                  TimInterruptEnableOnToDetErr = false
                TimChannelFilterConfig:
                  TimChFilterCounterFreqSelect = GTM_CONFIGURABLE_CLOCK_0
                  TimChFilterModeForFallingEdge = IMMEDIATE_EDGE_PROPAGATION_MODE
                  TimChFilterModeForRisingEdge = IMMEDIATE_EDGE_PROPAGATION_MODE
                  TimChFilterTimeForFallingEdge = 0
                  TimChFilterTimeForRisingEdge = 0
                  TimChannelFilterEnable = false
                TimChannelGeneral:
                  TimChannelAruEnable = false
                  TimChannelClockSelect = GTM_CONFIGURABLE_CLOCK_0
                  TimChannelCntsInputSelect = CNT_VALUE
                  TimChannelCntsValue = 0
                  TimChannelEcntOvflwSetting = SEL0_OVRFLOW_SIG_ON_ECNT_BITWIDTH_8
                  TimChannelEcntResetSetting = SEL0_ECNT_IN_WRAP_AROUND_MODE
                  TimChannelEnable = false
                  TimChannelExtCaptureModeEnable = false
                  TimChannelExtCaptureSrc = SEL0_NEW_VAL_IRQ
                  TimChannelGpr0InputSelect = TIMEBASE_TBU_TS0
                  TimChannelGpr1InputSelect = TIMEBASE_TBU_TS0
                  TimChannelInputSelect = INPUT_OF_CURRENT_TIM_CHANNEL
                  TimChannelModeSelect = PWM_MEASUREMENT_MODE_TPWM
                  TimChannelOneShotMode = false
                  TimChannelPortPinSelect = NONE_SEL0
                  TimChannelSignalEdgeSelect = FALLING_EDGE
                  TimChannelTbu0Ts0BitsSelect = BITS_0_TO_23
                  TimChannelUsage = USED_BY_OTHER_DRIVERS_OR_UNUSED
                  TimChannelValInitSignal = VAL_LOW
                TimChannelInterrupt:
                  TimInterruptEnableOnCntOfl = false
                  TimInterruptEnableOnEcntOfl = false
                  TimInterruptEnableOnGlitchDet = false
                  TimInterruptEnableOnGprxOfl = false
                  TimInterruptEnableOnNewVal = false
                  TimInterruptEnableOnToDet = false
                  TimInterruptMode = GTM_INTERRUPT_LEVEL_MODE
                  TimNotification = NULL_PTR
                TimChannelTimeoutDetection: TimChTimeoutClockSelect=GTM_CONFIGURABLE_CLOCK_0, TimChTimeoutDetectionEnable=SEL0_TIMOUT_DISABLED, TimChTimeoutDuration=0
              TimChannel_7
                TimChannelErrorInterrupt:
                  TimInterruptEnableOnCntOflErr = false
                  TimInterruptEnableOnEcntOflErr = false
                  TimInterruptEnableOnGlitchDetErr = false
                  TimInterruptEnableOnGprxOflErr = false
                  TimInterruptEnableOnNewValErr = false
                  TimInterruptEnableOnToDetErr = false
                TimChannelFilterConfig:
                  TimChFilterCounterFreqSelect = GTM_CONFIGURABLE_CLOCK_0
                  TimChFilterModeForFallingEdge = IMMEDIATE_EDGE_PROPAGATION_MODE
                  TimChFilterModeForRisingEdge = IMMEDIATE_EDGE_PROPAGATION_MODE
                  TimChFilterTimeForFallingEdge = 0
                  TimChFilterTimeForRisingEdge = 0
                  TimChannelFilterEnable = false
                TimChannelGeneral:
                  TimChannelAruEnable = false
                  TimChannelClockSelect = GTM_CONFIGURABLE_CLOCK_0
                  TimChannelCntsInputSelect = CNT_VALUE
                  TimChannelCntsValue = 0
                  TimChannelEcntOvflwSetting = SEL0_OVRFLOW_SIG_ON_ECNT_BITWIDTH_8
                  TimChannelEcntResetSetting = SEL0_ECNT_IN_WRAP_AROUND_MODE
                  TimChannelEnable = false
                  TimChannelExtCaptureModeEnable = false
                  TimChannelExtCaptureSrc = SEL0_NEW_VAL_IRQ
                  TimChannelGpr0InputSelect = TIMEBASE_TBU_TS0
                  TimChannelGpr1InputSelect = TIMEBASE_TBU_TS0
                  TimChannelInputSelect = INPUT_OF_CURRENT_TIM_CHANNEL
                  TimChannelModeSelect = PWM_MEASUREMENT_MODE_TPWM
                  TimChannelOneShotMode = false
                  TimChannelPortPinSelect = TIN75_SEL4_PORT15_PIN4
                  TimChannelSignalEdgeSelect = FALLING_EDGE
                  TimChannelTbu0Ts0BitsSelect = BITS_0_TO_23
                  TimChannelUsage = USED_BY_OTHER_DRIVERS_OR_UNUSED
                  TimChannelValInitSignal = VAL_LOW
                TimChannelInterrupt:
                  TimInterruptEnableOnCntOfl = false
                  TimInterruptEnableOnEcntOfl = false
                  TimInterruptEnableOnGlitchDet = false
                  TimInterruptEnableOnGprxOfl = false
                  TimInterruptEnableOnNewVal = false
                  TimInterruptEnableOnToDet = false
                  TimInterruptMode = GTM_INTERRUPT_LEVEL_MODE
                  TimNotification = NULL_PTR
                TimChannelTimeoutDetection: TimChTimeoutClockSelect=GTM_CONFIGURABLE_CLOCK_0, TimChTimeoutDetectionEnable=SEL0_TIMOUT_DISABLED, TimChTimeoutDuration=0
          Tim_3
            8 x TimChannel:
              TimChannel_0
                TimChannelErrorInterrupt:
                  TimInterruptEnableOnCntOflErr = false
                  TimInterruptEnableOnEcntOflErr = false
                  TimInterruptEnableOnGlitchDetErr = false
                  TimInterruptEnableOnGprxOflErr = false
                  TimInterruptEnableOnNewValErr = false
                  TimInterruptEnableOnToDetErr = false
                TimChannelFilterConfig:
                  TimChFilterCounterFreqSelect = GTM_CONFIGURABLE_CLOCK_0
                  TimChFilterModeForFallingEdge = IMMEDIATE_EDGE_PROPAGATION_MODE
                  TimChFilterModeForRisingEdge = IMMEDIATE_EDGE_PROPAGATION_MODE
                  TimChFilterTimeForFallingEdge = 0
                  TimChFilterTimeForRisingEdge = 0
                  TimChannelFilterEnable = false
                TimChannelGeneral:
                  TimChannelAruEnable = false
                  TimChannelClockSelect = GTM_CONFIGURABLE_CLOCK_0
                  TimChannelCntsInputSelect = CNT_VALUE
                  TimChannelCntsValue = 0
                  TimChannelEcntOvflwSetting = SEL0_OVRFLOW_SIG_ON_ECNT_BITWIDTH_8
                  TimChannelEcntResetSetting = SEL0_ECNT_IN_WRAP_AROUND_MODE
                  TimChannelEnable = false
                  TimChannelExtCaptureModeEnable = false
                  TimChannelExtCaptureSrc = SEL0_NEW_VAL_IRQ
                  TimChannelGpr0InputSelect = TIMEBASE_TBU_TS0
                  TimChannelGpr1InputSelect = TIMEBASE_TBU_TS0
                  TimChannelInputSelect = INPUT_OF_CURRENT_TIM_CHANNEL
                  TimChannelModeSelect = PWM_MEASUREMENT_MODE_TPWM
                  TimChannelOneShotMode = false
                  TimChannelPortPinSelect = NONE_SEL0
                  TimChannelSignalEdgeSelect = FALLING_EDGE
                  TimChannelTbu0Ts0BitsSelect = BITS_0_TO_23
                  TimChannelUsage = USED_BY_OTHER_DRIVERS_OR_UNUSED
                  TimChannelValInitSignal = VAL_LOW
                TimChannelInterrupt:
                  TimInterruptEnableOnCntOfl = false
                  TimInterruptEnableOnEcntOfl = false
                  TimInterruptEnableOnGlitchDet = false
                  TimInterruptEnableOnGprxOfl = false
                  TimInterruptEnableOnNewVal = false
                  TimInterruptEnableOnToDet = false
                  TimInterruptMode = GTM_INTERRUPT_LEVEL_MODE
                  TimNotification = NULL_PTR
                TimChannelTimeoutDetection: TimChTimeoutClockSelect=GTM_CONFIGURABLE_CLOCK_0, TimChTimeoutDetectionEnable=SEL0_TIMOUT_DISABLED, TimChTimeoutDuration=0
              TimChannel_1
                TimChannelErrorInterrupt:
                  TimInterruptEnableOnCntOflErr = false
                  TimInterruptEnableOnEcntOflErr = false
                  TimInterruptEnableOnGlitchDetErr = false
                  TimInterruptEnableOnGprxOflErr = false
                  TimInterruptEnableOnNewValErr = false
                  TimInterruptEnableOnToDetErr = false
                TimChannelFilterConfig:
                  TimChFilterCounterFreqSelect = GTM_CONFIGURABLE_CLOCK_0
                  TimChFilterModeForFallingEdge = IMMEDIATE_EDGE_PROPAGATION_MODE
                  TimChFilterModeForRisingEdge = IMMEDIATE_EDGE_PROPAGATION_MODE
                  TimChFilterTimeForFallingEdge = 0
                  TimChFilterTimeForRisingEdge = 0
                  TimChannelFilterEnable = false
                TimChannelGeneral:
                  TimChannelAruEnable = false
                  TimChannelClockSelect = GTM_CONFIGURABLE_CLOCK_0
                  TimChannelCntsInputSelect = CNT_VALUE
                  TimChannelCntsValue = 0
                  TimChannelEcntOvflwSetting = SEL0_OVRFLOW_SIG_ON_ECNT_BITWIDTH_8
                  TimChannelEcntResetSetting = SEL0_ECNT_IN_WRAP_AROUND_MODE
                  TimChannelEnable = false
                  TimChannelExtCaptureModeEnable = false
                  TimChannelExtCaptureSrc = SEL0_NEW_VAL_IRQ
                  TimChannelGpr0InputSelect = TIMEBASE_TBU_TS0
                  TimChannelGpr1InputSelect = TIMEBASE_TBU_TS0
                  TimChannelInputSelect = INPUT_OF_CURRENT_TIM_CHANNEL
                  TimChannelModeSelect = PWM_MEASUREMENT_MODE_TPWM
                  TimChannelOneShotMode = false
                  TimChannelPortPinSelect = NONE_SEL0
                  TimChannelSignalEdgeSelect = FALLING_EDGE
                  TimChannelTbu0Ts0BitsSelect = BITS_0_TO_23
                  TimChannelUsage = USED_BY_OTHER_DRIVERS_OR_UNUSED
                  TimChannelValInitSignal = VAL_LOW
                TimChannelInterrupt:
                  TimInterruptEnableOnCntOfl = false
                  TimInterruptEnableOnEcntOfl = false
                  TimInterruptEnableOnGlitchDet = false
                  TimInterruptEnableOnGprxOfl = false
                  TimInterruptEnableOnNewVal = false
                  TimInterruptEnableOnToDet = false
                  TimInterruptMode = GTM_INTERRUPT_LEVEL_MODE
                  TimNotification = NULL_PTR
                TimChannelTimeoutDetection: TimChTimeoutClockSelect=GTM_CONFIGURABLE_CLOCK_0, TimChTimeoutDetectionEnable=SEL0_TIMOUT_DISABLED, TimChTimeoutDuration=0
              TimChannel_2
                TimChannelErrorInterrupt:
                  TimInterruptEnableOnCntOflErr = false
                  TimInterruptEnableOnEcntOflErr = false
                  TimInterruptEnableOnGlitchDetErr = false
                  TimInterruptEnableOnGprxOflErr = false
                  TimInterruptEnableOnNewValErr = false
                  TimInterruptEnableOnToDetErr = false
                TimChannelFilterConfig:
                  TimChFilterCounterFreqSelect = GTM_CONFIGURABLE_CLOCK_0
                  TimChFilterModeForFallingEdge = IMMEDIATE_EDGE_PROPAGATION_MODE
                  TimChFilterModeForRisingEdge = IMMEDIATE_EDGE_PROPAGATION_MODE
                  TimChFilterTimeForFallingEdge = 0
                  TimChFilterTimeForRisingEdge = 0
                  TimChannelFilterEnable = false
                TimChannelGeneral:
                  TimChannelAruEnable = false
                  TimChannelClockSelect = GTM_CONFIGURABLE_CLOCK_0
                  TimChannelCntsInputSelect = CNT_VALUE
                  TimChannelCntsValue = 0
                  TimChannelEcntOvflwSetting = SEL0_OVRFLOW_SIG_ON_ECNT_BITWIDTH_8
                  TimChannelEcntResetSetting = SEL0_ECNT_IN_WRAP_AROUND_MODE
                  TimChannelEnable = false
                  TimChannelExtCaptureModeEnable = false
                  TimChannelExtCaptureSrc = SEL0_NEW_VAL_IRQ
                  TimChannelGpr0InputSelect = TIMEBASE_TBU_TS0
                  TimChannelGpr1InputSelect = TIMEBASE_TBU_TS0
                  TimChannelInputSelect = INPUT_OF_CURRENT_TIM_CHANNEL
                  TimChannelModeSelect = PWM_MEASUREMENT_MODE_TPWM
                  TimChannelOneShotMode = false
                  TimChannelPortPinSelect = NONE_SEL0
                  TimChannelSignalEdgeSelect = FALLING_EDGE
                  TimChannelTbu0Ts0BitsSelect = BITS_0_TO_23
                  TimChannelUsage = USED_BY_OTHER_DRIVERS_OR_UNUSED
                  TimChannelValInitSignal = VAL_LOW
                TimChannelInterrupt:
                  TimInterruptEnableOnCntOfl = false
                  TimInterruptEnableOnEcntOfl = false
                  TimInterruptEnableOnGlitchDet = false
                  TimInterruptEnableOnGprxOfl = false
                  TimInterruptEnableOnNewVal = false
                  TimInterruptEnableOnToDet = false
                  TimInterruptMode = GTM_INTERRUPT_LEVEL_MODE
                  TimNotification = NULL_PTR
                TimChannelTimeoutDetection: TimChTimeoutClockSelect=GTM_CONFIGURABLE_CLOCK_0, TimChTimeoutDetectionEnable=SEL0_TIMOUT_DISABLED, TimChTimeoutDuration=0
              TimChannel_3
                TimChannelErrorInterrupt:
                  TimInterruptEnableOnCntOflErr = false
                  TimInterruptEnableOnEcntOflErr = false
                  TimInterruptEnableOnGlitchDetErr = false
                  TimInterruptEnableOnGprxOflErr = false
                  TimInterruptEnableOnNewValErr = false
                  TimInterruptEnableOnToDetErr = false
                TimChannelFilterConfig:
                  TimChFilterCounterFreqSelect = GTM_CONFIGURABLE_CLOCK_0
                  TimChFilterModeForFallingEdge = IMMEDIATE_EDGE_PROPAGATION_MODE
                  TimChFilterModeForRisingEdge = IMMEDIATE_EDGE_PROPAGATION_MODE
                  TimChFilterTimeForFallingEdge = 0
                  TimChFilterTimeForRisingEdge = 0
                  TimChannelFilterEnable = false
                TimChannelGeneral:
                  TimChannelAruEnable = false
                  TimChannelClockSelect = GTM_CONFIGURABLE_CLOCK_0
                  TimChannelCntsInputSelect = CNT_VALUE
                  TimChannelCntsValue = 0
                  TimChannelEcntOvflwSetting = SEL0_OVRFLOW_SIG_ON_ECNT_BITWIDTH_8
                  TimChannelEcntResetSetting = SEL0_ECNT_IN_WRAP_AROUND_MODE
                  TimChannelEnable = false
                  TimChannelExtCaptureModeEnable = false
                  TimChannelExtCaptureSrc = SEL0_NEW_VAL_IRQ
                  TimChannelGpr0InputSelect = TIMEBASE_TBU_TS0
                  TimChannelGpr1InputSelect = TIMEBASE_TBU_TS0
                  TimChannelInputSelect = INPUT_OF_CURRENT_TIM_CHANNEL
                  TimChannelModeSelect = PWM_MEASUREMENT_MODE_TPWM
                  TimChannelOneShotMode = false
                  TimChannelPortPinSelect = NONE_SEL0
                  TimChannelSignalEdgeSelect = FALLING_EDGE
                  TimChannelTbu0Ts0BitsSelect = BITS_0_TO_23
                  TimChannelUsage = USED_BY_OTHER_DRIVERS_OR_UNUSED
                  TimChannelValInitSignal = VAL_LOW
                TimChannelInterrupt:
                  TimInterruptEnableOnCntOfl = false
                  TimInterruptEnableOnEcntOfl = false
                  TimInterruptEnableOnGlitchDet = false
                  TimInterruptEnableOnGprxOfl = false
                  TimInterruptEnableOnNewVal = false
                  TimInterruptEnableOnToDet = false
                  TimInterruptMode = GTM_INTERRUPT_LEVEL_MODE
                  TimNotification = NULL_PTR
                TimChannelTimeoutDetection: TimChTimeoutClockSelect=GTM_CONFIGURABLE_CLOCK_0, TimChTimeoutDetectionEnable=SEL0_TIMOUT_DISABLED, TimChTimeoutDuration=0
              TimChannel_4
                TimChannelErrorInterrupt:
                  TimInterruptEnableOnCntOflErr = false
                  TimInterruptEnableOnEcntOflErr = false
                  TimInterruptEnableOnGlitchDetErr = false
                  TimInterruptEnableOnGprxOflErr = false
                  TimInterruptEnableOnNewValErr = false
                  TimInterruptEnableOnToDetErr = false
                TimChannelFilterConfig:
                  TimChFilterCounterFreqSelect = GTM_CONFIGURABLE_CLOCK_0
                  TimChFilterModeForFallingEdge = IMMEDIATE_EDGE_PROPAGATION_MODE
                  TimChFilterModeForRisingEdge = IMMEDIATE_EDGE_PROPAGATION_MODE
                  TimChFilterTimeForFallingEdge = 0
                  TimChFilterTimeForRisingEdge = 0
                  TimChannelFilterEnable = false
                TimChannelGeneral:
                  TimChannelAruEnable = false
                  TimChannelClockSelect = GTM_CONFIGURABLE_CLOCK_0
                  TimChannelCntsInputSelect = CNT_VALUE
                  TimChannelCntsValue = 0
                  TimChannelEcntOvflwSetting = SEL0_OVRFLOW_SIG_ON_ECNT_BITWIDTH_8
                  TimChannelEcntResetSetting = SEL0_ECNT_IN_WRAP_AROUND_MODE
                  TimChannelEnable = false
                  TimChannelExtCaptureModeEnable = false
                  TimChannelExtCaptureSrc = SEL0_NEW_VAL_IRQ
                  TimChannelGpr0InputSelect = TIMEBASE_TBU_TS0
                  TimChannelGpr1InputSelect = TIMEBASE_TBU_TS0
                  TimChannelInputSelect = INPUT_OF_CURRENT_TIM_CHANNEL
                  TimChannelModeSelect = PWM_MEASUREMENT_MODE_TPWM
                  TimChannelOneShotMode = false
                  TimChannelPortPinSelect = NONE_SEL0
                  TimChannelSignalEdgeSelect = FALLING_EDGE
                  TimChannelTbu0Ts0BitsSelect = BITS_0_TO_23
                  TimChannelUsage = USED_BY_OTHER_DRIVERS_OR_UNUSED
                  TimChannelValInitSignal = VAL_LOW
                TimChannelInterrupt:
                  TimInterruptEnableOnCntOfl = false
                  TimInterruptEnableOnEcntOfl = false
                  TimInterruptEnableOnGlitchDet = false
                  TimInterruptEnableOnGprxOfl = false
                  TimInterruptEnableOnNewVal = false
                  TimInterruptEnableOnToDet = false
                  TimInterruptMode = GTM_INTERRUPT_LEVEL_MODE
                  TimNotification = NULL_PTR
                TimChannelTimeoutDetection: TimChTimeoutClockSelect=GTM_CONFIGURABLE_CLOCK_0, TimChTimeoutDetectionEnable=SEL0_TIMOUT_DISABLED, TimChTimeoutDuration=0
              TimChannel_5
                TimChannelErrorInterrupt:
                  TimInterruptEnableOnCntOflErr = false
                  TimInterruptEnableOnEcntOflErr = false
                  TimInterruptEnableOnGlitchDetErr = false
                  TimInterruptEnableOnGprxOflErr = false
                  TimInterruptEnableOnNewValErr = false
                  TimInterruptEnableOnToDetErr = false
                TimChannelFilterConfig:
                  TimChFilterCounterFreqSelect = GTM_CONFIGURABLE_CLOCK_0
                  TimChFilterModeForFallingEdge = IMMEDIATE_EDGE_PROPAGATION_MODE
                  TimChFilterModeForRisingEdge = IMMEDIATE_EDGE_PROPAGATION_MODE
                  TimChFilterTimeForFallingEdge = 0
                  TimChFilterTimeForRisingEdge = 0
                  TimChannelFilterEnable = false
                TimChannelGeneral:
                  TimChannelAruEnable = false
                  TimChannelClockSelect = GTM_CONFIGURABLE_CLOCK_0
                  TimChannelCntsInputSelect = CNT_VALUE
                  TimChannelCntsValue = 0
                  TimChannelEcntOvflwSetting = SEL0_OVRFLOW_SIG_ON_ECNT_BITWIDTH_8
                  TimChannelEcntResetSetting = SEL0_ECNT_IN_WRAP_AROUND_MODE
                  TimChannelEnable = false
                  TimChannelExtCaptureModeEnable = false
                  TimChannelExtCaptureSrc = SEL0_NEW_VAL_IRQ
                  TimChannelGpr0InputSelect = TIMEBASE_TBU_TS0
                  TimChannelGpr1InputSelect = TIMEBASE_TBU_TS0
                  TimChannelInputSelect = INPUT_OF_CURRENT_TIM_CHANNEL
                  TimChannelModeSelect = PWM_MEASUREMENT_MODE_TPWM
                  TimChannelOneShotMode = false
                  TimChannelPortPinSelect = NONE_SEL0
                  TimChannelSignalEdgeSelect = FALLING_EDGE
                  TimChannelTbu0Ts0BitsSelect = BITS_0_TO_23
                  TimChannelUsage = USED_BY_OTHER_DRIVERS_OR_UNUSED
                  TimChannelValInitSignal = VAL_LOW
                TimChannelInterrupt:
                  TimInterruptEnableOnCntOfl = false
                  TimInterruptEnableOnEcntOfl = false
                  TimInterruptEnableOnGlitchDet = false
                  TimInterruptEnableOnGprxOfl = false
                  TimInterruptEnableOnNewVal = false
                  TimInterruptEnableOnToDet = false
                  TimInterruptMode = GTM_INTERRUPT_LEVEL_MODE
                  TimNotification = NULL_PTR
                TimChannelTimeoutDetection: TimChTimeoutClockSelect=GTM_CONFIGURABLE_CLOCK_0, TimChTimeoutDetectionEnable=SEL0_TIMOUT_DISABLED, TimChTimeoutDuration=0
              TimChannel_6
                TimChannelErrorInterrupt:
                  TimInterruptEnableOnCntOflErr = false
                  TimInterruptEnableOnEcntOflErr = false
                  TimInterruptEnableOnGlitchDetErr = false
                  TimInterruptEnableOnGprxOflErr = false
                  TimInterruptEnableOnNewValErr = false
                  TimInterruptEnableOnToDetErr = false
                TimChannelFilterConfig:
                  TimChFilterCounterFreqSelect = GTM_CONFIGURABLE_CLOCK_0
                  TimChFilterModeForFallingEdge = IMMEDIATE_EDGE_PROPAGATION_MODE
                  TimChFilterModeForRisingEdge = IMMEDIATE_EDGE_PROPAGATION_MODE
                  TimChFilterTimeForFallingEdge = 0
                  TimChFilterTimeForRisingEdge = 0
                  TimChannelFilterEnable = false
                TimChannelGeneral:
                  TimChannelAruEnable = false
                  TimChannelClockSelect = GTM_CONFIGURABLE_CLOCK_0
                  TimChannelCntsInputSelect = CNT_VALUE
                  TimChannelCntsValue = 0
                  TimChannelEcntOvflwSetting = SEL0_OVRFLOW_SIG_ON_ECNT_BITWIDTH_8
                  TimChannelEcntResetSetting = SEL0_ECNT_IN_WRAP_AROUND_MODE
                  TimChannelEnable = false
                  TimChannelExtCaptureModeEnable = false
                  TimChannelExtCaptureSrc = SEL0_NEW_VAL_IRQ
                  TimChannelGpr0InputSelect = TIMEBASE_TBU_TS0
                  TimChannelGpr1InputSelect = TIMEBASE_TBU_TS0
                  TimChannelInputSelect = INPUT_OF_CURRENT_TIM_CHANNEL
                  TimChannelModeSelect = PWM_MEASUREMENT_MODE_TPWM
                  TimChannelOneShotMode = false
                  TimChannelPortPinSelect = NONE_SEL0
                  TimChannelSignalEdgeSelect = FALLING_EDGE
                  TimChannelTbu0Ts0BitsSelect = BITS_0_TO_23
                  TimChannelUsage = USED_BY_OTHER_DRIVERS_OR_UNUSED
                  TimChannelValInitSignal = VAL_LOW
                TimChannelInterrupt:
                  TimInterruptEnableOnCntOfl = false
                  TimInterruptEnableOnEcntOfl = false
                  TimInterruptEnableOnGlitchDet = false
                  TimInterruptEnableOnGprxOfl = false
                  TimInterruptEnableOnNewVal = false
                  TimInterruptEnableOnToDet = false
                  TimInterruptMode = GTM_INTERRUPT_LEVEL_MODE
                  TimNotification = NULL_PTR
                TimChannelTimeoutDetection: TimChTimeoutClockSelect=GTM_CONFIGURABLE_CLOCK_0, TimChTimeoutDetectionEnable=SEL0_TIMOUT_DISABLED, TimChTimeoutDuration=0
              TimChannel_7
                TimChannelErrorInterrupt:
                  TimInterruptEnableOnCntOflErr = false
                  TimInterruptEnableOnEcntOflErr = false
                  TimInterruptEnableOnGlitchDetErr = false
                  TimInterruptEnableOnGprxOflErr = false
                  TimInterruptEnableOnNewValErr = false
                  TimInterruptEnableOnToDetErr = false
                TimChannelFilterConfig:
                  TimChFilterCounterFreqSelect = GTM_CONFIGURABLE_CLOCK_0
                  TimChFilterModeForFallingEdge = IMMEDIATE_EDGE_PROPAGATION_MODE
                  TimChFilterModeForRisingEdge = IMMEDIATE_EDGE_PROPAGATION_MODE
                  TimChFilterTimeForFallingEdge = 0
                  TimChFilterTimeForRisingEdge = 0
                  TimChannelFilterEnable = false
                TimChannelGeneral:
                  TimChannelAruEnable = false
                  TimChannelClockSelect = GTM_CONFIGURABLE_CLOCK_0
                  TimChannelCntsInputSelect = CNT_VALUE
                  TimChannelCntsValue = 0
                  TimChannelEcntOvflwSetting = SEL0_OVRFLOW_SIG_ON_ECNT_BITWIDTH_8
                  TimChannelEcntResetSetting = SEL0_ECNT_IN_WRAP_AROUND_MODE
                  TimChannelEnable = false
                  TimChannelExtCaptureModeEnable = false
                  TimChannelExtCaptureSrc = SEL0_NEW_VAL_IRQ
                  TimChannelGpr0InputSelect = TIMEBASE_TBU_TS0
                  TimChannelGpr1InputSelect = TIMEBASE_TBU_TS0
                  TimChannelInputSelect = INPUT_OF_CURRENT_TIM_CHANNEL
                  TimChannelModeSelect = PWM_MEASUREMENT_MODE_TPWM
                  TimChannelOneShotMode = false
                  TimChannelPortPinSelect = NONE_SEL0
                  TimChannelSignalEdgeSelect = FALLING_EDGE
                  TimChannelTbu0Ts0BitsSelect = BITS_0_TO_23
                  TimChannelUsage = USED_BY_OTHER_DRIVERS_OR_UNUSED
                  TimChannelValInitSignal = VAL_LOW
                TimChannelInterrupt:
                  TimInterruptEnableOnCntOfl = false
                  TimInterruptEnableOnEcntOfl = false
                  TimInterruptEnableOnGlitchDet = false
                  TimInterruptEnableOnGprxOfl = false
                  TimInterruptEnableOnNewVal = false
                  TimInterruptEnableOnToDet = false
                  TimInterruptMode = GTM_INTERRUPT_LEVEL_MODE
                  TimNotification = NULL_PTR
                TimChannelTimeoutDetection: TimChTimeoutClockSelect=GTM_CONFIGURABLE_CLOCK_0, TimChTimeoutDetectionEnable=SEL0_TIMOUT_DISABLED, TimChTimeoutDuration=0
        3 x Tom:
          Tom_0
            16 x TomChannel:
              TomChannel_0
                TomChannelEnable: TomChDisableOnTgcTrigger=false, TomChannelEnable=AT_START
                TomChannelInterrupt: TomIntEnableOnDutyCycleMatchCcu1=false, TomIntEnableOnPeriodMatchCcu0=false, TomInterruptMode=GTM_INTERRUPT_LEVEL_MODE, TomNotification=NULL_PTR
                TomChannelOutput:
                  TomChOutputDisableOnTgcTrig = false
                  TomChannelOutputControl = DONT_ENABLE_CHANNEL_OUTPUT
                  TomChannelOutputSignalLevel = LOW
                  TomChannelPortPinSelect = TOUT18_SELA_PORT0_PIN9
                TomChannelTimerParameters:
                  TomChDCycCompareShadowValSr1 = 0
                  TomChEnableForceUpdate = false
                  TomChPeriodCompareShadowValSr0 = 0
                  TomChResetCn0OnForceUpdate = false
                  TomChUpdateEnableOnCn0Reset = false
                  TomChannelBitReversalMode = false
                  TomChannelClockSelect = GTM_FIXED_CLOCK_0
                  TomChannelCounterCn0Reset = ON_COMPARE_MATCH_ON_CHANNEL
                  TomChannelCounterValCn0 = 0
                  TomChannelDutyCycleCompareValCm1 = 0
                  TomChannelGatedCounterMode = false
                  TomChannelOneShotMode = false
                  TomChannelPeriodCompareValCm0 = 0
                  TomChannelSpeMode = false
                  TomChannelTriggerOutput = TRIG_FROM_PREVIOUS_CHANNEL
                TomChannelUsage: TomChannelUsage=USED_BY_OTHER_DRIVERS_OR_UNUSED
              TomChannel_1
                TomChannelEnable: TomChDisableOnTgcTrigger=false, TomChannelEnable=AT_START
                TomChannelInterrupt: TomIntEnableOnDutyCycleMatchCcu1=false, TomIntEnableOnPeriodMatchCcu0=false, TomInterruptMode=GTM_INTERRUPT_LEVEL_MODE, TomNotification=NULL_PTR
                TomChannelOutput:
                  TomChOutputDisableOnTgcTrig = false
                  TomChannelOutputControl = DONT_ENABLE_CHANNEL_OUTPUT
                  TomChannelOutputSignalLevel = LOW
                  TomChannelPortPinSelect = TOUT19_SELA_PORT0_PIN10
                TomChannelTimerParameters:
                  TomChDCycCompareShadowValSr1 = 0
                  TomChEnableForceUpdate = false
                  TomChPeriodCompareShadowValSr0 = 0
                  TomChResetCn0OnForceUpdate = false
                  TomChUpdateEnableOnCn0Reset = false
                  TomChannelBitReversalMode = false
                  TomChannelClockSelect = GTM_FIXED_CLOCK_0
                  TomChannelCounterCn0Reset = ON_COMPARE_MATCH_ON_CHANNEL
                  TomChannelCounterValCn0 = 0
                  TomChannelDutyCycleCompareValCm1 = 0
                  TomChannelGatedCounterMode = false
                  TomChannelOneShotMode = false
                  TomChannelPeriodCompareValCm0 = 0
                  TomChannelSpeMode = false
                  TomChannelTriggerOutput = TRIG_FROM_PREVIOUS_CHANNEL
                TomChannelUsage: TomChannelUsage=USED_BY_OTHER_DRIVERS_OR_UNUSED
              TomChannel_10
                TomChannelEnable: TomChDisableOnTgcTrigger=false, TomChannelEnable=AT_START
                TomChannelInterrupt: TomIntEnableOnDutyCycleMatchCcu1=false, TomIntEnableOnPeriodMatchCcu0=false, TomInterruptMode=GTM_INTERRUPT_LEVEL_MODE, TomNotification=NULL_PTR
                TomChannelOutput:
                  TomChOutputDisableOnTgcTrig = false
                  TomChannelOutputControl = DONT_ENABLE_CHANNEL_OUTPUT
                  TomChannelOutputSignalLevel = LOW
                  TomChannelPortPinSelect = TOUT12_SELA_PORT0_PIN3
                TomChannelTimerParameters:
                  TomChDCycCompareShadowValSr1 = 0
                  TomChEnableForceUpdate = false
                  TomChPeriodCompareShadowValSr0 = 0
                  TomChResetCn0OnForceUpdate = false
                  TomChUpdateEnableOnCn0Reset = false
                  TomChannelBitReversalMode = false
                  TomChannelClockSelect = GTM_FIXED_CLOCK_0
                  TomChannelCounterCn0Reset = ON_COMPARE_MATCH_ON_CHANNEL
                  TomChannelCounterValCn0 = 0
                  TomChannelDutyCycleCompareValCm1 = 0
                  TomChannelGatedCounterMode = false
                  TomChannelOneShotMode = false
                  TomChannelPeriodCompareValCm0 = 0
                  TomChannelSpeMode = false
                  TomChannelTriggerOutput = TRIG_FROM_PREVIOUS_CHANNEL
                TomChannelUsage: TomChannelUsage=USED_BY_OTHER_DRIVERS_OR_UNUSED
              TomChannel_11
                TomChannelEnable: TomChDisableOnTgcTrigger=false, TomChannelEnable=AT_START
                TomChannelInterrupt: TomIntEnableOnDutyCycleMatchCcu1=false, TomIntEnableOnPeriodMatchCcu0=false, TomInterruptMode=GTM_INTERRUPT_LEVEL_MODE, TomNotification=NULL_PTR
                TomChannelOutput:
                  TomChOutputDisableOnTgcTrig = false
                  TomChannelOutputControl = DONT_ENABLE_CHANNEL_OUTPUT
                  TomChannelOutputSignalLevel = LOW
                  TomChannelPortPinSelect = TOUT13_SELA_PORT0_PIN4
                TomChannelTimerParameters:
                  TomChDCycCompareShadowValSr1 = 0
                  TomChEnableForceUpdate = false
                  TomChPeriodCompareShadowValSr0 = 0
                  TomChResetCn0OnForceUpdate = false
                  TomChUpdateEnableOnCn0Reset = false
                  TomChannelBitReversalMode = false
                  TomChannelClockSelect = GTM_FIXED_CLOCK_0
                  TomChannelCounterCn0Reset = ON_COMPARE_MATCH_ON_CHANNEL
                  TomChannelCounterValCn0 = 0
                  TomChannelDutyCycleCompareValCm1 = 0
                  TomChannelGatedCounterMode = false
                  TomChannelOneShotMode = false
                  TomChannelPeriodCompareValCm0 = 0
                  TomChannelSpeMode = false
                  TomChannelTriggerOutput = TRIG_FROM_PREVIOUS_CHANNEL
                TomChannelUsage: TomChannelUsage=USED_BY_OTHER_DRIVERS_OR_UNUSED
              TomChannel_12
                TomChannelEnable: TomChDisableOnTgcTrigger=false, TomChannelEnable=AT_START
                TomChannelInterrupt: TomIntEnableOnDutyCycleMatchCcu1=false, TomIntEnableOnPeriodMatchCcu0=false, TomInterruptMode=GTM_INTERRUPT_LEVEL_MODE, TomNotification=NULL_PTR
                TomChannelOutput:
                  TomChOutputDisableOnTgcTrig = false
                  TomChannelOutputControl = DONT_ENABLE_CHANNEL_OUTPUT
                  TomChannelOutputSignalLevel = LOW
                  TomChannelPortPinSelect = TOUT14_SELA_PORT0_PIN5
                TomChannelTimerParameters:
                  TomChDCycCompareShadowValSr1 = 0
                  TomChEnableForceUpdate = false
                  TomChPeriodCompareShadowValSr0 = 0
                  TomChResetCn0OnForceUpdate = false
                  TomChUpdateEnableOnCn0Reset = false
                  TomChannelBitReversalMode = false
                  TomChannelClockSelect = GTM_FIXED_CLOCK_0
                  TomChannelCounterCn0Reset = ON_COMPARE_MATCH_ON_CHANNEL
                  TomChannelCounterValCn0 = 0
                  TomChannelDutyCycleCompareValCm1 = 0
                  TomChannelGatedCounterMode = false
                  TomChannelOneShotMode = false
                  TomChannelPeriodCompareValCm0 = 0
                  TomChannelSpeMode = false
                  TomChannelTriggerOutput = TRIG_FROM_PREVIOUS_CHANNEL
                TomChannelUsage: TomChannelUsage=USED_BY_OTHER_DRIVERS_OR_UNUSED
              TomChannel_13
                TomChannelEnable: TomChDisableOnTgcTrigger=false, TomChannelEnable=AT_START
                TomChannelInterrupt: TomIntEnableOnDutyCycleMatchCcu1=false, TomIntEnableOnPeriodMatchCcu0=false, TomInterruptMode=GTM_INTERRUPT_LEVEL_MODE, TomNotification=NULL_PTR
                TomChannelOutput:
                  TomChOutputDisableOnTgcTrig = false
                  TomChannelOutputControl = DONT_ENABLE_CHANNEL_OUTPUT
                  TomChannelOutputSignalLevel = LOW
                  TomChannelPortPinSelect = TOUT15_SELA_PORT0_PIN6
                TomChannelTimerParameters:
                  TomChDCycCompareShadowValSr1 = 0
                  TomChEnableForceUpdate = false
                  TomChPeriodCompareShadowValSr0 = 0
                  TomChResetCn0OnForceUpdate = false
                  TomChUpdateEnableOnCn0Reset = false
                  TomChannelBitReversalMode = false
                  TomChannelClockSelect = GTM_FIXED_CLOCK_0
                  TomChannelCounterCn0Reset = ON_COMPARE_MATCH_ON_CHANNEL
                  TomChannelCounterValCn0 = 0
                  TomChannelDutyCycleCompareValCm1 = 0
                  TomChannelGatedCounterMode = false
                  TomChannelOneShotMode = false
                  TomChannelPeriodCompareValCm0 = 0
                  TomChannelSpeMode = false
                  TomChannelTriggerOutput = TRIG_FROM_PREVIOUS_CHANNEL
                TomChannelUsage: TomChannelUsage=USED_BY_OTHER_DRIVERS_OR_UNUSED
              TomChannel_14
                TomChannelEnable: TomChDisableOnTgcTrigger=false, TomChannelEnable=AT_START
                TomChannelInterrupt: TomIntEnableOnDutyCycleMatchCcu1=false, TomIntEnableOnPeriodMatchCcu0=false, TomInterruptMode=GTM_INTERRUPT_LEVEL_MODE, TomNotification=NULL_PTR
                TomChannelOutput:
                  TomChOutputDisableOnTgcTrig = false
                  TomChannelOutputControl = DONT_ENABLE_CHANNEL_OUTPUT
                  TomChannelOutputSignalLevel = LOW
                  TomChannelPortPinSelect = TOUT16_SELA_PORT0_PIN7
                TomChannelTimerParameters:
                  TomChDCycCompareShadowValSr1 = 0
                  TomChEnableForceUpdate = false
                  TomChPeriodCompareShadowValSr0 = 0
                  TomChResetCn0OnForceUpdate = false
                  TomChUpdateEnableOnCn0Reset = false
                  TomChannelBitReversalMode = false
                  TomChannelClockSelect = GTM_FIXED_CLOCK_0
                  TomChannelCounterCn0Reset = ON_COMPARE_MATCH_ON_CHANNEL
                  TomChannelCounterValCn0 = 0
                  TomChannelDutyCycleCompareValCm1 = 0
                  TomChannelGatedCounterMode = false
                  TomChannelOneShotMode = false
                  TomChannelPeriodCompareValCm0 = 0
                  TomChannelSpeMode = false
                  TomChannelTriggerOutput = TRIG_FROM_PREVIOUS_CHANNEL
                TomChannelUsage: TomChannelUsage=USED_BY_OTHER_DRIVERS_OR_UNUSED
              TomChannel_15
                TomChannelEnable: TomChDisableOnTgcTrigger=false, TomChannelEnable=AT_START
                TomChannelInterrupt: TomIntEnableOnDutyCycleMatchCcu1=false, TomIntEnableOnPeriodMatchCcu0=false, TomInterruptMode=GTM_INTERRUPT_LEVEL_MODE, TomNotification=NULL_PTR
                TomChannelOutput:
                  TomChOutputDisableOnTgcTrig = false
                  TomChannelOutputControl = DONT_ENABLE_CHANNEL_OUTPUT
                  TomChannelOutputSignalLevel = LOW
                  TomChannelPortPinSelect = TOUT17_SELA_PORT0_PIN8
                TomChannelTimerParameters:
                  TomChDCycCompareShadowValSr1 = 0
                  TomChEnableForceUpdate = false
                  TomChPeriodCompareShadowValSr0 = 0
                  TomChResetCn0OnForceUpdate = false
                  TomChUpdateEnableOnCn0Reset = false
                  TomChannelBitReversalMode = false
                  TomChannelClockSelect = GTM_FIXED_CLOCK_0
                  TomChannelCounterCn0Reset = ON_COMPARE_MATCH_ON_CHANNEL
                  TomChannelCounterValCn0 = 0
                  TomChannelDutyCycleCompareValCm1 = 0
                  TomChannelGatedCounterMode = false
                  TomChannelOneShotMode = false
                  TomChannelPeriodCompareValCm0 = 0
                  TomChannelSpeMode = false
                  TomChannelTriggerOutput = TRIG_FROM_PREVIOUS_CHANNEL
                TomChannelUsage: TomChannelUsage=USED_BY_OTHER_DRIVERS_OR_UNUSED
              TomChannel_2
                TomChannelEnable: TomChDisableOnTgcTrigger=false, TomChannelEnable=AT_START
                TomChannelInterrupt: TomIntEnableOnDutyCycleMatchCcu1=false, TomIntEnableOnPeriodMatchCcu0=false, TomInterruptMode=GTM_INTERRUPT_LEVEL_MODE, TomNotification=NULL_PTR
                TomChannelOutput:
                  TomChOutputDisableOnTgcTrig = false
                  TomChannelOutputControl = DONT_ENABLE_CHANNEL_OUTPUT
                  TomChannelOutputSignalLevel = LOW
                  TomChannelPortPinSelect = TOUT20_SELA_PORT0_PIN11
                TomChannelTimerParameters:
                  TomChDCycCompareShadowValSr1 = 0
                  TomChEnableForceUpdate = false
                  TomChPeriodCompareShadowValSr0 = 0
                  TomChResetCn0OnForceUpdate = false
                  TomChUpdateEnableOnCn0Reset = false
                  TomChannelBitReversalMode = false
                  TomChannelClockSelect = GTM_FIXED_CLOCK_0
                  TomChannelCounterCn0Reset = ON_COMPARE_MATCH_ON_CHANNEL
                  TomChannelCounterValCn0 = 0
                  TomChannelDutyCycleCompareValCm1 = 0
                  TomChannelGatedCounterMode = false
                  TomChannelOneShotMode = false
                  TomChannelPeriodCompareValCm0 = 0
                  TomChannelSpeMode = false
                  TomChannelTriggerOutput = TRIG_FROM_PREVIOUS_CHANNEL
                TomChannelUsage: TomChannelUsage=USED_BY_OTHER_DRIVERS_OR_UNUSED
              TomChannel_3
                TomChannelEnable: TomChDisableOnTgcTrigger=false, TomChannelEnable=AT_START
                TomChannelInterrupt: TomIntEnableOnDutyCycleMatchCcu1=false, TomIntEnableOnPeriodMatchCcu0=false, TomInterruptMode=GTM_INTERRUPT_LEVEL_MODE, TomNotification=NULL_PTR
                TomChannelOutput:
                  TomChOutputDisableOnTgcTrig = false
                  TomChannelOutputControl = DONT_ENABLE_CHANNEL_OUTPUT
                  TomChannelOutputSignalLevel = LOW
                  TomChannelPortPinSelect = TOUT21_SELA_PORT0_PIN12
                TomChannelTimerParameters:
                  TomChDCycCompareShadowValSr1 = 0
                  TomChEnableForceUpdate = false
                  TomChPeriodCompareShadowValSr0 = 0
                  TomChResetCn0OnForceUpdate = false
                  TomChUpdateEnableOnCn0Reset = false
                  TomChannelBitReversalMode = false
                  TomChannelClockSelect = GTM_FIXED_CLOCK_0
                  TomChannelCounterCn0Reset = ON_COMPARE_MATCH_ON_CHANNEL
                  TomChannelCounterValCn0 = 0
                  TomChannelDutyCycleCompareValCm1 = 0
                  TomChannelGatedCounterMode = false
                  TomChannelOneShotMode = false
                  TomChannelPeriodCompareValCm0 = 0
                  TomChannelSpeMode = false
                  TomChannelTriggerOutput = TRIG_FROM_PREVIOUS_CHANNEL
                TomChannelUsage: TomChannelUsage=USED_BY_OTHER_DRIVERS_OR_UNUSED
              TomChannel_4
                TomChannelEnable: TomChDisableOnTgcTrigger=false, TomChannelEnable=AT_START
                TomChannelInterrupt: TomIntEnableOnDutyCycleMatchCcu1=false, TomIntEnableOnPeriodMatchCcu0=false, TomInterruptMode=GTM_INTERRUPT_LEVEL_MODE, TomNotification=NULL_PTR
                TomChannelOutput:
                  TomChOutputDisableOnTgcTrig = false
                  TomChannelOutputControl = DONT_ENABLE_CHANNEL_OUTPUT
                  TomChannelOutputSignalLevel = LOW
                  TomChannelPortPinSelect = TOUT102_SELA_PORT10_PIN0
                TomChannelTimerParameters:
                  TomChDCycCompareShadowValSr1 = 0
                  TomChEnableForceUpdate = false
                  TomChPeriodCompareShadowValSr0 = 0
                  TomChResetCn0OnForceUpdate = false
                  TomChUpdateEnableOnCn0Reset = false
                  TomChannelBitReversalMode = false
                  TomChannelClockSelect = GTM_FIXED_CLOCK_0
                  TomChannelCounterCn0Reset = ON_COMPARE_MATCH_ON_CHANNEL
                  TomChannelCounterValCn0 = 0
                  TomChannelDutyCycleCompareValCm1 = 0
                  TomChannelGatedCounterMode = false
                  TomChannelOneShotMode = false
                  TomChannelPeriodCompareValCm0 = 0
                  TomChannelSpeMode = false
                  TomChannelTriggerOutput = TRIG_FROM_PREVIOUS_CHANNEL
                TomChannelUsage: TomChannelUsage=USED_BY_OTHER_DRIVERS_OR_UNUSED
              TomChannel_5
                TomChannelEnable: TomChDisableOnTgcTrigger=false, TomChannelEnable=AT_START
                TomChannelInterrupt: TomIntEnableOnDutyCycleMatchCcu1=false, TomIntEnableOnPeriodMatchCcu0=false, TomInterruptMode=GTM_INTERRUPT_LEVEL_MODE, TomNotification=NULL_PTR
                TomChannelOutput:
                  TomChOutputDisableOnTgcTrig = false
                  TomChannelOutputControl = DONT_ENABLE_CHANNEL_OUTPUT
                  TomChannelOutputSignalLevel = LOW
                  TomChannelPortPinSelect = TOUT110_SELA_PORT10_PIN8
                TomChannelTimerParameters:
                  TomChDCycCompareShadowValSr1 = 0
                  TomChEnableForceUpdate = false
                  TomChPeriodCompareShadowValSr0 = 0
                  TomChResetCn0OnForceUpdate = false
                  TomChUpdateEnableOnCn0Reset = false
                  TomChannelBitReversalMode = false
                  TomChannelClockSelect = GTM_FIXED_CLOCK_0
                  TomChannelCounterCn0Reset = ON_COMPARE_MATCH_ON_CHANNEL
                  TomChannelCounterValCn0 = 0
                  TomChannelDutyCycleCompareValCm1 = 0
                  TomChannelGatedCounterMode = false
                  TomChannelOneShotMode = false
                  TomChannelPeriodCompareValCm0 = 0
                  TomChannelSpeMode = false
                  TomChannelTriggerOutput = TRIG_FROM_PREVIOUS_CHANNEL
                TomChannelUsage: TomChannelUsage=USED_BY_OTHER_DRIVERS_OR_UNUSED
              TomChannel_6
                TomChannelEnable: TomChDisableOnTgcTrigger=false, TomChannelEnable=AT_START
                TomChannelInterrupt: TomIntEnableOnDutyCycleMatchCcu1=false, TomIntEnableOnPeriodMatchCcu0=false, TomInterruptMode=GTM_INTERRUPT_LEVEL_MODE, TomNotification=NULL_PTR
                TomChannelOutput:
                  TomChOutputDisableOnTgcTrig = false
                  TomChannelOutputControl = DONT_ENABLE_CHANNEL_OUTPUT
                  TomChannelOutputSignalLevel = LOW
                  TomChannelPortPinSelect = TOUT106_SELA_PORT10_PIN4
                TomChannelTimerParameters:
                  TomChDCycCompareShadowValSr1 = 0
                  TomChEnableForceUpdate = false
                  TomChPeriodCompareShadowValSr0 = 0
                  TomChResetCn0OnForceUpdate = false
                  TomChUpdateEnableOnCn0Reset = false
                  TomChannelBitReversalMode = false
                  TomChannelClockSelect = GTM_FIXED_CLOCK_0
                  TomChannelCounterCn0Reset = ON_COMPARE_MATCH_ON_CHANNEL
                  TomChannelCounterValCn0 = 0
                  TomChannelDutyCycleCompareValCm1 = 0
                  TomChannelGatedCounterMode = false
                  TomChannelOneShotMode = false
                  TomChannelPeriodCompareValCm0 = 0
                  TomChannelSpeMode = false
                  TomChannelTriggerOutput = TRIG_FROM_PREVIOUS_CHANNEL
                TomChannelUsage: TomChannelUsage=USED_BY_OTHER_DRIVERS_OR_UNUSED
              TomChannel_7
                TomChannelEnable: TomChDisableOnTgcTrigger=false, TomChannelEnable=AT_START
                TomChannelInterrupt: TomIntEnableOnDutyCycleMatchCcu1=false, TomIntEnableOnPeriodMatchCcu0=false, TomInterruptMode=GTM_INTERRUPT_LEVEL_MODE, TomNotification=NULL_PTR
                TomChannelOutput:
                  TomChOutputDisableOnTgcTrig = false
                  TomChannelOutputControl = DONT_ENABLE_CHANNEL_OUTPUT
                  TomChannelOutputSignalLevel = LOW
                  TomChannelPortPinSelect = TOUT93_SELA_PORT13_PIN2
                TomChannelTimerParameters:
                  TomChDCycCompareShadowValSr1 = 0
                  TomChEnableForceUpdate = false
                  TomChPeriodCompareShadowValSr0 = 0
                  TomChResetCn0OnForceUpdate = false
                  TomChUpdateEnableOnCn0Reset = false
                  TomChannelBitReversalMode = false
                  TomChannelClockSelect = GTM_FIXED_CLOCK_0
                  TomChannelCounterCn0Reset = ON_COMPARE_MATCH_ON_CHANNEL
                  TomChannelCounterValCn0 = 0
                  TomChannelDutyCycleCompareValCm1 = 0
                  TomChannelGatedCounterMode = false
                  TomChannelOneShotMode = false
                  TomChannelPeriodCompareValCm0 = 0
                  TomChannelSpeMode = false
                  TomChannelTriggerOutput = TRIG_FROM_PREVIOUS_CHANNEL
                TomChannelUsage: TomChannelUsage=USED_BY_OTHER_DRIVERS_OR_UNUSED
              TomChannel_8
                TomChannelEnable: TomChDisableOnTgcTrigger=false, TomChannelEnable=AT_START
                TomChannelInterrupt: TomIntEnableOnDutyCycleMatchCcu1=false, TomIntEnableOnPeriodMatchCcu0=false, TomInterruptMode=GTM_INTERRUPT_LEVEL_MODE, TomNotification=NULL_PTR
                TomChannelOutput:
                  TomChOutputDisableOnTgcTrig = false
                  TomChannelOutputControl = DONT_ENABLE_CHANNEL_OUTPUT
                  TomChannelOutputSignalLevel = LOW
                  TomChannelPortPinSelect = TOUT9_SELA_PORT0_PIN0
                TomChannelTimerParameters:
                  TomChDCycCompareShadowValSr1 = 0
                  TomChEnableForceUpdate = false
                  TomChPeriodCompareShadowValSr0 = 0
                  TomChResetCn0OnForceUpdate = false
                  TomChUpdateEnableOnCn0Reset = false
                  TomChannelBitReversalMode = false
                  TomChannelClockSelect = GTM_FIXED_CLOCK_0
                  TomChannelCounterCn0Reset = ON_COMPARE_MATCH_ON_CHANNEL
                  TomChannelCounterValCn0 = 0
                  TomChannelDutyCycleCompareValCm1 = 0
                  TomChannelGatedCounterMode = false
                  TomChannelOneShotMode = false
                  TomChannelPeriodCompareValCm0 = 0
                  TomChannelSpeMode = false
                  TomChannelTriggerOutput = TRIG_FROM_PREVIOUS_CHANNEL
                TomChannelUsage: TomChannelUsage=USED_BY_OTHER_DRIVERS_OR_UNUSED
              TomChannel_9
                TomChannelEnable: TomChDisableOnTgcTrigger=false, TomChannelEnable=AT_START
                TomChannelInterrupt: TomIntEnableOnDutyCycleMatchCcu1=false, TomIntEnableOnPeriodMatchCcu0=false, TomInterruptMode=GTM_INTERRUPT_LEVEL_MODE, TomNotification=NULL_PTR
                TomChannelOutput:
                  TomChOutputDisableOnTgcTrig = false
                  TomChannelOutputControl = DONT_ENABLE_CHANNEL_OUTPUT
                  TomChannelOutputSignalLevel = LOW
                  TomChannelPortPinSelect = TOUT10_SELA_PORT0_PIN1
                TomChannelTimerParameters:
                  TomChDCycCompareShadowValSr1 = 0
                  TomChEnableForceUpdate = false
                  TomChPeriodCompareShadowValSr0 = 0
                  TomChResetCn0OnForceUpdate = false
                  TomChUpdateEnableOnCn0Reset = false
                  TomChannelBitReversalMode = false
                  TomChannelClockSelect = GTM_FIXED_CLOCK_0
                  TomChannelCounterCn0Reset = ON_COMPARE_MATCH_ON_CHANNEL
                  TomChannelCounterValCn0 = 0
                  TomChannelDutyCycleCompareValCm1 = 0
                  TomChannelGatedCounterMode = false
                  TomChannelOneShotMode = false
                  TomChannelPeriodCompareValCm0 = 0
                  TomChannelSpeMode = false
                  TomChannelTriggerOutput = TRIG_FROM_PREVIOUS_CHANNEL
                TomChannelUsage: TomChannelUsage=USED_BY_OTHER_DRIVERS_OR_UNUSED
            TomTriggersForTgc_0 (TomTriggersForTgc)
              TomTgcInternalTriggerSelect:
                TomTgcIntTriggerFromChannel{0..7} = false
              TomTgcTriggerByTimebase: TomTgcTbuTimebaseSelect=TBU_TS0_TIMEBASE, TomTgcTimeBaseTriggerEnable=false, TomTgcTimebaseMatchValue=0
            TomTriggersForTgc_1 (TomTriggersForTgc)
              TomTgcInternalTriggerSelect:
                TomTgcIntTriggerFromChannel{0..7} = false
              TomTgcTriggerByTimebase: TomTgcTbuTimebaseSelect=TBU_TS0_TIMEBASE, TomTgcTimeBaseTriggerEnable=false, TomTgcTimebaseMatchValue=0
          Tom_1
            16 x TomChannel:
              TomChannel_0
                TomChannelEnable: TomChDisableOnTgcTrigger=false, TomChannelEnable=AT_START
                TomChannelInterrupt: TomIntEnableOnDutyCycleMatchCcu1=false, TomIntEnableOnPeriodMatchCcu0=false, TomInterruptMode=GTM_INTERRUPT_LEVEL_MODE, TomNotification=NULL_PTR
                TomChannelOutput:
                  TomChOutputDisableOnTgcTrig = false
                  TomChannelOutputControl = DONT_ENABLE_CHANNEL_OUTPUT
                  TomChannelOutputSignalLevel = LOW
                  TomChannelPortPinSelect = TOUT9_SELB_PORT0_PIN0
                TomChannelTimerParameters:
                  TomChDCycCompareShadowValSr1 = 0
                  TomChEnableForceUpdate = false
                  TomChPeriodCompareShadowValSr0 = 0
                  TomChResetCn0OnForceUpdate = false
                  TomChUpdateEnableOnCn0Reset = false
                  TomChannelBitReversalMode = false
                  TomChannelClockSelect = GTM_FIXED_CLOCK_0
                  TomChannelCounterCn0Reset = ON_COMPARE_MATCH_ON_CHANNEL
                  TomChannelCounterValCn0 = 0
                  TomChannelDutyCycleCompareValCm1 = 0
                  TomChannelGatedCounterMode = false
                  TomChannelOneShotMode = false
                  TomChannelPeriodCompareValCm0 = 0
                  TomChannelSpeMode = false
                  TomChannelTriggerOutput = TRIG_FROM_PREVIOUS_CHANNEL
                TomChannelUsage: TomChannelUsage=USED_BY_OTHER_DRIVERS_OR_UNUSED
              TomChannel_1
                TomChannelEnable: TomChDisableOnTgcTrigger=false, TomChannelEnable=AT_START
                TomChannelInterrupt: TomIntEnableOnDutyCycleMatchCcu1=false, TomIntEnableOnPeriodMatchCcu0=false, TomInterruptMode=GTM_INTERRUPT_LEVEL_MODE, TomNotification=NULL_PTR
                TomChannelOutput:
                  TomChOutputDisableOnTgcTrig = false
                  TomChannelOutputControl = DONT_ENABLE_CHANNEL_OUTPUT
                  TomChannelOutputSignalLevel = LOW
                  TomChannelPortPinSelect = TOUT10_SELB_PORT0_PIN1
                TomChannelTimerParameters:
                  TomChDCycCompareShadowValSr1 = 0
                  TomChEnableForceUpdate = false
                  TomChPeriodCompareShadowValSr0 = 0
                  TomChResetCn0OnForceUpdate = false
                  TomChUpdateEnableOnCn0Reset = false
                  TomChannelBitReversalMode = false
                  TomChannelClockSelect = GTM_FIXED_CLOCK_0
                  TomChannelCounterCn0Reset = ON_COMPARE_MATCH_ON_CHANNEL
                  TomChannelCounterValCn0 = 0
                  TomChannelDutyCycleCompareValCm1 = 0
                  TomChannelGatedCounterMode = false
                  TomChannelOneShotMode = false
                  TomChannelPeriodCompareValCm0 = 0
                  TomChannelSpeMode = false
                  TomChannelTriggerOutput = TRIG_FROM_PREVIOUS_CHANNEL
                TomChannelUsage: TomChannelUsage=USED_BY_OTHER_DRIVERS_OR_UNUSED
              TomChannel_10
                TomChannelEnable: TomChDisableOnTgcTrigger=false, TomChannelEnable=AT_START
                TomChannelInterrupt: TomIntEnableOnDutyCycleMatchCcu1=false, TomIntEnableOnPeriodMatchCcu0=false, TomInterruptMode=GTM_INTERRUPT_LEVEL_MODE, TomNotification=NULL_PTR
                TomChannelOutput:
                  TomChOutputDisableOnTgcTrig = false
                  TomChannelOutputControl = DONT_ENABLE_CHANNEL_OUTPUT
                  TomChannelOutputSignalLevel = LOW
                  TomChannelPortPinSelect = TOUT2_SELB_PORT2_PIN2
                TomChannelTimerParameters:
                  TomChDCycCompareShadowValSr1 = 0
                  TomChEnableForceUpdate = false
                  TomChPeriodCompareShadowValSr0 = 0
                  TomChResetCn0OnForceUpdate = false
                  TomChUpdateEnableOnCn0Reset = false
                  TomChannelBitReversalMode = false
                  TomChannelClockSelect = GTM_FIXED_CLOCK_0
                  TomChannelCounterCn0Reset = ON_COMPARE_MATCH_ON_CHANNEL
                  TomChannelCounterValCn0 = 0
                  TomChannelDutyCycleCompareValCm1 = 0
                  TomChannelGatedCounterMode = false
                  TomChannelOneShotMode = false
                  TomChannelPeriodCompareValCm0 = 0
                  TomChannelSpeMode = false
                  TomChannelTriggerOutput = TRIG_FROM_PREVIOUS_CHANNEL
                TomChannelUsage: TomChannelUsage=USED_BY_OTHER_DRIVERS_OR_UNUSED
              TomChannel_11
                TomChannelEnable: TomChDisableOnTgcTrigger=false, TomChannelEnable=AT_START
                TomChannelInterrupt: TomIntEnableOnDutyCycleMatchCcu1=false, TomIntEnableOnPeriodMatchCcu0=false, TomInterruptMode=GTM_INTERRUPT_LEVEL_MODE, TomNotification=NULL_PTR
                TomChannelOutput:
                  TomChOutputDisableOnTgcTrig = false
                  TomChannelOutputControl = DONT_ENABLE_CHANNEL_OUTPUT
                  TomChannelOutputSignalLevel = LOW
                  TomChannelPortPinSelect = TOUT3_SELB_PORT2_PIN3
                TomChannelTimerParameters:
                  TomChDCycCompareShadowValSr1 = 0
                  TomChEnableForceUpdate = false
                  TomChPeriodCompareShadowValSr0 = 0
                  TomChResetCn0OnForceUpdate = false
                  TomChUpdateEnableOnCn0Reset = false
                  TomChannelBitReversalMode = false
                  TomChannelClockSelect = GTM_FIXED_CLOCK_0
                  TomChannelCounterCn0Reset = ON_COMPARE_MATCH_ON_CHANNEL
                  TomChannelCounterValCn0 = 0
                  TomChannelDutyCycleCompareValCm1 = 0
                  TomChannelGatedCounterMode = false
                  TomChannelOneShotMode = false
                  TomChannelPeriodCompareValCm0 = 0
                  TomChannelSpeMode = false
                  TomChannelTriggerOutput = TRIG_FROM_PREVIOUS_CHANNEL
                TomChannelUsage: TomChannelUsage=USED_BY_OTHER_DRIVERS_OR_UNUSED
              TomChannel_12
                TomChannelEnable: TomChDisableOnTgcTrigger=false, TomChannelEnable=AT_START
                TomChannelInterrupt: TomIntEnableOnDutyCycleMatchCcu1=false, TomIntEnableOnPeriodMatchCcu0=false, TomInterruptMode=GTM_INTERRUPT_LEVEL_MODE, TomNotification=NULL_PTR
                TomChannelOutput:
                  TomChOutputDisableOnTgcTrig = false
                  TomChannelOutputControl = DONT_ENABLE_CHANNEL_OUTPUT
                  TomChannelOutputSignalLevel = LOW
                  TomChannelPortPinSelect = TOUT4_SELB_PORT2_PIN4
                TomChannelTimerParameters:
                  TomChDCycCompareShadowValSr1 = 0
                  TomChEnableForceUpdate = false
                  TomChPeriodCompareShadowValSr0 = 0
                  TomChResetCn0OnForceUpdate = false
                  TomChUpdateEnableOnCn0Reset = false
                  TomChannelBitReversalMode = false
                  TomChannelClockSelect = GTM_FIXED_CLOCK_0
                  TomChannelCounterCn0Reset = ON_COMPARE_MATCH_ON_CHANNEL
                  TomChannelCounterValCn0 = 0
                  TomChannelDutyCycleCompareValCm1 = 0
                  TomChannelGatedCounterMode = false
                  TomChannelOneShotMode = false
                  TomChannelPeriodCompareValCm0 = 0
                  TomChannelSpeMode = false
                  TomChannelTriggerOutput = TRIG_FROM_PREVIOUS_CHANNEL
                TomChannelUsage: TomChannelUsage=USED_BY_OTHER_DRIVERS_OR_UNUSED
              TomChannel_13
                TomChannelEnable: TomChDisableOnTgcTrigger=false, TomChannelEnable=AT_START
                TomChannelInterrupt: TomIntEnableOnDutyCycleMatchCcu1=false, TomIntEnableOnPeriodMatchCcu0=false, TomInterruptMode=GTM_INTERRUPT_LEVEL_MODE, TomNotification=NULL_PTR
                TomChannelOutput:
                  TomChOutputDisableOnTgcTrig = false
                  TomChannelOutputControl = DONT_ENABLE_CHANNEL_OUTPUT
                  TomChannelOutputSignalLevel = LOW
                  TomChannelPortPinSelect = TOUT5_SELB_PORT2_PIN5
                TomChannelTimerParameters:
                  TomChDCycCompareShadowValSr1 = 0
                  TomChEnableForceUpdate = false
                  TomChPeriodCompareShadowValSr0 = 0
                  TomChResetCn0OnForceUpdate = false
                  TomChUpdateEnableOnCn0Reset = false
                  TomChannelBitReversalMode = false
                  TomChannelClockSelect = GTM_FIXED_CLOCK_0
                  TomChannelCounterCn0Reset = ON_COMPARE_MATCH_ON_CHANNEL
                  TomChannelCounterValCn0 = 0
                  TomChannelDutyCycleCompareValCm1 = 0
                  TomChannelGatedCounterMode = false
                  TomChannelOneShotMode = false
                  TomChannelPeriodCompareValCm0 = 0
                  TomChannelSpeMode = false
                  TomChannelTriggerOutput = TRIG_FROM_PREVIOUS_CHANNEL
                TomChannelUsage: TomChannelUsage=USED_BY_OTHER_DRIVERS_OR_UNUSED
              TomChannel_14
                TomChannelEnable: TomChDisableOnTgcTrigger=false, TomChannelEnable=AT_START
                TomChannelInterrupt: TomIntEnableOnDutyCycleMatchCcu1=false, TomIntEnableOnPeriodMatchCcu0=false, TomInterruptMode=GTM_INTERRUPT_LEVEL_MODE, TomNotification=NULL_PTR
                TomChannelOutput:
                  TomChOutputDisableOnTgcTrig = false
                  TomChannelOutputControl = DONT_ENABLE_CHANNEL_OUTPUT
                  TomChannelOutputSignalLevel = LOW
                  TomChannelPortPinSelect = TOUT6_SELB_PORT2_PIN6
                TomChannelTimerParameters:
                  TomChDCycCompareShadowValSr1 = 0
                  TomChEnableForceUpdate = false
                  TomChPeriodCompareShadowValSr0 = 0
                  TomChResetCn0OnForceUpdate = false
                  TomChUpdateEnableOnCn0Reset = false
                  TomChannelBitReversalMode = false
                  TomChannelClockSelect = GTM_FIXED_CLOCK_0
                  TomChannelCounterCn0Reset = ON_COMPARE_MATCH_ON_CHANNEL
                  TomChannelCounterValCn0 = 0
                  TomChannelDutyCycleCompareValCm1 = 0
                  TomChannelGatedCounterMode = false
                  TomChannelOneShotMode = false
                  TomChannelPeriodCompareValCm0 = 0
                  TomChannelSpeMode = false
                  TomChannelTriggerOutput = TRIG_FROM_PREVIOUS_CHANNEL
                TomChannelUsage: TomChannelUsage=USED_BY_OTHER_DRIVERS_OR_UNUSED
              TomChannel_15
                TomChannelEnable: TomChDisableOnTgcTrigger=false, TomChannelEnable=AT_START
                TomChannelInterrupt: TomIntEnableOnDutyCycleMatchCcu1=false, TomIntEnableOnPeriodMatchCcu0=false, TomInterruptMode=GTM_INTERRUPT_LEVEL_MODE, TomNotification=NULL_PTR
                TomChannelOutput:
                  TomChOutputDisableOnTgcTrig = false
                  TomChannelOutputControl = DONT_ENABLE_CHANNEL_OUTPUT
                  TomChannelOutputSignalLevel = LOW
                  TomChannelPortPinSelect = TOUT7_SELB_PORT2_PIN7
                TomChannelTimerParameters:
                  TomChDCycCompareShadowValSr1 = 0
                  TomChEnableForceUpdate = false
                  TomChPeriodCompareShadowValSr0 = 0
                  TomChResetCn0OnForceUpdate = false
                  TomChUpdateEnableOnCn0Reset = false
                  TomChannelBitReversalMode = false
                  TomChannelClockSelect = GTM_FIXED_CLOCK_0
                  TomChannelCounterCn0Reset = ON_COMPARE_MATCH_ON_CHANNEL
                  TomChannelCounterValCn0 = 0
                  TomChannelDutyCycleCompareValCm1 = 0
                  TomChannelGatedCounterMode = false
                  TomChannelOneShotMode = false
                  TomChannelPeriodCompareValCm0 = 0
                  TomChannelSpeMode = false
                  TomChannelTriggerOutput = TRIG_FROM_PREVIOUS_CHANNEL
                TomChannelUsage: TomChannelUsage=USED_BY_OTHER_DRIVERS_OR_UNUSED
              TomChannel_2
                TomChannelEnable: TomChDisableOnTgcTrigger=false, TomChannelEnable=AT_START
                TomChannelInterrupt: TomIntEnableOnDutyCycleMatchCcu1=false, TomIntEnableOnPeriodMatchCcu0=false, TomInterruptMode=GTM_INTERRUPT_LEVEL_MODE, TomNotification=NULL_PTR
                TomChannelOutput:
                  TomChOutputDisableOnTgcTrig = false
                  TomChannelOutputControl = DONT_ENABLE_CHANNEL_OUTPUT
                  TomChannelOutputSignalLevel = LOW
                  TomChannelPortPinSelect = TOUT12_SELB_PORT0_PIN3
                TomChannelTimerParameters:
                  TomChDCycCompareShadowValSr1 = 0
                  TomChEnableForceUpdate = false
                  TomChPeriodCompareShadowValSr0 = 0
                  TomChResetCn0OnForceUpdate = false
                  TomChUpdateEnableOnCn0Reset = false
                  TomChannelBitReversalMode = false
                  TomChannelClockSelect = GTM_FIXED_CLOCK_0
                  TomChannelCounterCn0Reset = ON_COMPARE_MATCH_ON_CHANNEL
                  TomChannelCounterValCn0 = 0
                  TomChannelDutyCycleCompareValCm1 = 0
                  TomChannelGatedCounterMode = false
                  TomChannelOneShotMode = false
                  TomChannelPeriodCompareValCm0 = 0
                  TomChannelSpeMode = false
                  TomChannelTriggerOutput = TRIG_FROM_PREVIOUS_CHANNEL
                TomChannelUsage: TomChannelUsage=USED_BY_OTHER_DRIVERS_OR_UNUSED
              TomChannel_3
                TomChannelEnable: TomChDisableOnTgcTrigger=false, TomChannelEnable=AT_START
                TomChannelInterrupt: TomIntEnableOnDutyCycleMatchCcu1=false, TomIntEnableOnPeriodMatchCcu0=false, TomInterruptMode=GTM_INTERRUPT_LEVEL_MODE, TomNotification=NULL_PTR
                TomChannelOutput:
                  TomChOutputDisableOnTgcTrig = false
                  TomChannelOutputControl = DONT_ENABLE_CHANNEL_OUTPUT
                  TomChannelOutputSignalLevel = LOW
                  TomChannelPortPinSelect = TOUT13_SELB_PORT0_PIN4
                TomChannelTimerParameters:
                  TomChDCycCompareShadowValSr1 = 0
                  TomChEnableForceUpdate = false
                  TomChPeriodCompareShadowValSr0 = 0
                  TomChResetCn0OnForceUpdate = false
                  TomChUpdateEnableOnCn0Reset = false
                  TomChannelBitReversalMode = false
                  TomChannelClockSelect = GTM_FIXED_CLOCK_0
                  TomChannelCounterCn0Reset = ON_COMPARE_MATCH_ON_CHANNEL
                  TomChannelCounterValCn0 = 0
                  TomChannelDutyCycleCompareValCm1 = 0
                  TomChannelGatedCounterMode = false
                  TomChannelOneShotMode = false
                  TomChannelPeriodCompareValCm0 = 0
                  TomChannelSpeMode = false
                  TomChannelTriggerOutput = TRIG_FROM_PREVIOUS_CHANNEL
                TomChannelUsage: TomChannelUsage=USED_BY_OTHER_DRIVERS_OR_UNUSED
              TomChannel_4
                TomChannelEnable: TomChDisableOnTgcTrigger=false, TomChannelEnable=AT_START
                TomChannelInterrupt: TomIntEnableOnDutyCycleMatchCcu1=false, TomIntEnableOnPeriodMatchCcu0=false, TomInterruptMode=GTM_INTERRUPT_LEVEL_MODE, TomNotification=NULL_PTR
                TomChannelOutput:
                  TomChOutputDisableOnTgcTrig = false
                  TomChannelOutputControl = DONT_ENABLE_CHANNEL_OUTPUT
                  TomChannelOutputSignalLevel = LOW
                  TomChannelPortPinSelect = TOUT14_SELB_PORT0_PIN5
                TomChannelTimerParameters:
                  TomChDCycCompareShadowValSr1 = 0
                  TomChEnableForceUpdate = false
                  TomChPeriodCompareShadowValSr0 = 0
                  TomChResetCn0OnForceUpdate = false
                  TomChUpdateEnableOnCn0Reset = false
                  TomChannelBitReversalMode = false
                  TomChannelClockSelect = GTM_FIXED_CLOCK_0
                  TomChannelCounterCn0Reset = ON_COMPARE_MATCH_ON_CHANNEL
                  TomChannelCounterValCn0 = 0
                  TomChannelDutyCycleCompareValCm1 = 0
                  TomChannelGatedCounterMode = false
                  TomChannelOneShotMode = false
                  TomChannelPeriodCompareValCm0 = 0
                  TomChannelSpeMode = false
                  TomChannelTriggerOutput = TRIG_FROM_PREVIOUS_CHANNEL
                TomChannelUsage: TomChannelUsage=USED_BY_OTHER_DRIVERS_OR_UNUSED
              TomChannel_5
                TomChannelEnable: TomChDisableOnTgcTrigger=false, TomChannelEnable=AT_START
                TomChannelInterrupt: TomIntEnableOnDutyCycleMatchCcu1=false, TomIntEnableOnPeriodMatchCcu0=false, TomInterruptMode=GTM_INTERRUPT_LEVEL_MODE, TomNotification=NULL_PTR
                TomChannelOutput:
                  TomChOutputDisableOnTgcTrig = false
                  TomChannelOutputControl = DONT_ENABLE_CHANNEL_OUTPUT
                  TomChannelOutputSignalLevel = LOW
                  TomChannelPortPinSelect = TOUT15_SELB_PORT0_PIN6
                TomChannelTimerParameters:
                  TomChDCycCompareShadowValSr1 = 0
                  TomChEnableForceUpdate = false
                  TomChPeriodCompareShadowValSr0 = 0
                  TomChResetCn0OnForceUpdate = false
                  TomChUpdateEnableOnCn0Reset = false
                  TomChannelBitReversalMode = false
                  TomChannelClockSelect = GTM_FIXED_CLOCK_0
                  TomChannelCounterCn0Reset = ON_COMPARE_MATCH_ON_CHANNEL
                  TomChannelCounterValCn0 = 0
                  TomChannelDutyCycleCompareValCm1 = 0
                  TomChannelGatedCounterMode = false
                  TomChannelOneShotMode = false
                  TomChannelPeriodCompareValCm0 = 0
                  TomChannelSpeMode = false
                  TomChannelTriggerOutput = TRIG_FROM_PREVIOUS_CHANNEL
                TomChannelUsage: TomChannelUsage=USED_BY_OTHER_DRIVERS_OR_UNUSED
              TomChannel_6
                TomChannelEnable: TomChDisableOnTgcTrigger=false, TomChannelEnable=AT_START
                TomChannelInterrupt: TomIntEnableOnDutyCycleMatchCcu1=false, TomIntEnableOnPeriodMatchCcu0=false, TomInterruptMode=GTM_INTERRUPT_LEVEL_MODE, TomNotification=NULL_PTR
                TomChannelOutput:
                  TomChOutputDisableOnTgcTrig = false
                  TomChannelOutputControl = DONT_ENABLE_CHANNEL_OUTPUT
                  TomChannelOutputSignalLevel = LOW
                  TomChannelPortPinSelect = TOUT16_SELB_PORT0_PIN7
                TomChannelTimerParameters:
                  TomChDCycCompareShadowValSr1 = 0
                  TomChEnableForceUpdate = false
                  TomChPeriodCompareShadowValSr0 = 0
                  TomChResetCn0OnForceUpdate = false
                  TomChUpdateEnableOnCn0Reset = false
                  TomChannelBitReversalMode = false
                  TomChannelClockSelect = GTM_FIXED_CLOCK_0
                  TomChannelCounterCn0Reset = ON_COMPARE_MATCH_ON_CHANNEL
                  TomChannelCounterValCn0 = 0
                  TomChannelDutyCycleCompareValCm1 = 0
                  TomChannelGatedCounterMode = false
                  TomChannelOneShotMode = false
                  TomChannelPeriodCompareValCm0 = 0
                  TomChannelSpeMode = false
                  TomChannelTriggerOutput = TRIG_FROM_PREVIOUS_CHANNEL
                TomChannelUsage: TomChannelUsage=USED_BY_OTHER_DRIVERS_OR_UNUSED
              TomChannel_7
                TomChannelEnable: TomChDisableOnTgcTrigger=false, TomChannelEnable=AT_START
                TomChannelInterrupt: TomIntEnableOnDutyCycleMatchCcu1=false, TomIntEnableOnPeriodMatchCcu0=false, TomInterruptMode=GTM_INTERRUPT_LEVEL_MODE, TomNotification=NULL_PTR
                TomChannelOutput:
                  TomChOutputDisableOnTgcTrig = false
                  TomChannelOutputControl = DONT_ENABLE_CHANNEL_OUTPUT
                  TomChannelOutputSignalLevel = LOW
                  TomChannelPortPinSelect = TOUT17_SELB_PORT0_PIN8
                TomChannelTimerParameters:
                  TomChDCycCompareShadowValSr1 = 0
                  TomChEnableForceUpdate = false
                  TomChPeriodCompareShadowValSr0 = 0
                  TomChResetCn0OnForceUpdate = false
                  TomChUpdateEnableOnCn0Reset = false
                  TomChannelBitReversalMode = false
                  TomChannelClockSelect = GTM_FIXED_CLOCK_0
                  TomChannelCounterCn0Reset = ON_COMPARE_MATCH_ON_CHANNEL
                  TomChannelCounterValCn0 = 0
                  TomChannelDutyCycleCompareValCm1 = 0
                  TomChannelGatedCounterMode = false
                  TomChannelOneShotMode = false
                  TomChannelPeriodCompareValCm0 = 0
                  TomChannelSpeMode = false
                  TomChannelTriggerOutput = TRIG_FROM_PREVIOUS_CHANNEL
                TomChannelUsage: TomChannelUsage=USED_BY_OTHER_DRIVERS_OR_UNUSED
              TomChannel_8
                TomChannelEnable: TomChDisableOnTgcTrigger=false, TomChannelEnable=AT_START
                TomChannelInterrupt: TomIntEnableOnDutyCycleMatchCcu1=false, TomIntEnableOnPeriodMatchCcu0=false, TomInterruptMode=GTM_INTERRUPT_LEVEL_MODE, TomNotification=NULL_PTR
                TomChannelOutput:
                  TomChOutputDisableOnTgcTrig = false
                  TomChannelOutputControl = DONT_ENABLE_CHANNEL_OUTPUT
                  TomChannelOutputSignalLevel = LOW
                  TomChannelPortPinSelect = TOUT0_SELB_PORT2_PIN0
                TomChannelTimerParameters:
                  TomChDCycCompareShadowValSr1 = 0
                  TomChEnableForceUpdate = false
                  TomChPeriodCompareShadowValSr0 = 0
                  TomChResetCn0OnForceUpdate = false
                  TomChUpdateEnableOnCn0Reset = false
                  TomChannelBitReversalMode = false
                  TomChannelClockSelect = GTM_FIXED_CLOCK_0
                  TomChannelCounterCn0Reset = ON_COMPARE_MATCH_ON_CHANNEL
                  TomChannelCounterValCn0 = 0
                  TomChannelDutyCycleCompareValCm1 = 0
                  TomChannelGatedCounterMode = false
                  TomChannelOneShotMode = false
                  TomChannelPeriodCompareValCm0 = 0
                  TomChannelSpeMode = false
                  TomChannelTriggerOutput = TRIG_FROM_PREVIOUS_CHANNEL
                TomChannelUsage: TomChannelUsage=USED_BY_OTHER_DRIVERS_OR_UNUSED
              TomChannel_9
                TomChannelEnable: TomChDisableOnTgcTrigger=false, TomChannelEnable=AT_START
                TomChannelInterrupt: TomIntEnableOnDutyCycleMatchCcu1=false, TomIntEnableOnPeriodMatchCcu0=false, TomInterruptMode=GTM_INTERRUPT_LEVEL_MODE, TomNotification=NULL_PTR
                TomChannelOutput:
                  TomChOutputDisableOnTgcTrig = false
                  TomChannelOutputControl = DONT_ENABLE_CHANNEL_OUTPUT
                  TomChannelOutputSignalLevel = LOW
                  TomChannelPortPinSelect = TOUT1_SELB_PORT2_PIN1
                TomChannelTimerParameters:
                  TomChDCycCompareShadowValSr1 = 0
                  TomChEnableForceUpdate = false
                  TomChPeriodCompareShadowValSr0 = 0
                  TomChResetCn0OnForceUpdate = false
                  TomChUpdateEnableOnCn0Reset = false
                  TomChannelBitReversalMode = false
                  TomChannelClockSelect = GTM_FIXED_CLOCK_0
                  TomChannelCounterCn0Reset = ON_COMPARE_MATCH_ON_CHANNEL
                  TomChannelCounterValCn0 = 0
                  TomChannelDutyCycleCompareValCm1 = 0
                  TomChannelGatedCounterMode = false
                  TomChannelOneShotMode = false
                  TomChannelPeriodCompareValCm0 = 0
                  TomChannelSpeMode = false
                  TomChannelTriggerOutput = TRIG_FROM_PREVIOUS_CHANNEL
                TomChannelUsage: TomChannelUsage=USED_BY_OTHER_DRIVERS_OR_UNUSED
            TomTriggersForTgc_0 (TomTriggersForTgc)
              TomTgcInternalTriggerSelect:
                TomTgcIntTriggerFromChannel{0..7} = false
              TomTgcTriggerByTimebase: TomTgcTbuTimebaseSelect=TBU_TS0_TIMEBASE, TomTgcTimeBaseTriggerEnable=false, TomTgcTimebaseMatchValue=0
            TomTriggersForTgc_1 (TomTriggersForTgc)
              TomTgcInternalTriggerSelect:
                TomTgcIntTriggerFromChannel{0..7} = false
              TomTgcTriggerByTimebase: TomTgcTbuTimebaseSelect=TBU_TS0_TIMEBASE, TomTgcTimeBaseTriggerEnable=false, TomTgcTimebaseMatchValue=0
          Tom_2
            16 x TomChannel:
              TomChannel_0
                TomChannelEnable: TomChDisableOnTgcTrigger=false, TomChannelEnable=AT_START
                TomChannelInterrupt: TomIntEnableOnDutyCycleMatchCcu1=false, TomIntEnableOnPeriodMatchCcu0=false, TomInterruptMode=GTM_INTERRUPT_LEVEL_MODE, TomNotification=NULL_PTR
                TomChannelOutput:
                  TomChOutputDisableOnTgcTrig = false
                  TomChannelOutputControl = DONT_ENABLE_CHANNEL_OUTPUT
                  TomChannelOutputSignalLevel = LOW
                  TomChannelPortPinSelect = TOUT94_SELB_PORT13_PIN3
                TomChannelTimerParameters:
                  TomChDCycCompareShadowValSr1 = 0
                  TomChEnableForceUpdate = false
                  TomChPeriodCompareShadowValSr0 = 0
                  TomChResetCn0OnForceUpdate = false
                  TomChUpdateEnableOnCn0Reset = false
                  TomChannelBitReversalMode = false
                  TomChannelClockSelect = GTM_FIXED_CLOCK_0
                  TomChannelCounterCn0Reset = ON_COMPARE_MATCH_ON_CHANNEL
                  TomChannelCounterValCn0 = 0
                  TomChannelDutyCycleCompareValCm1 = 0
                  TomChannelGatedCounterMode = false
                  TomChannelOneShotMode = false
                  TomChannelPeriodCompareValCm0 = 0
                  TomChannelSpeMode = false
                  TomChannelTriggerOutput = TRIG_FROM_PREVIOUS_CHANNEL
                TomChannelUsage: TomChannelUsage=USED_BY_OTHER_DRIVERS_OR_UNUSED
              TomChannel_1
                TomChannelEnable: TomChDisableOnTgcTrigger=false, TomChannelEnable=AT_START
                TomChannelInterrupt: TomIntEnableOnDutyCycleMatchCcu1=false, TomIntEnableOnPeriodMatchCcu0=false, TomInterruptMode=GTM_INTERRUPT_LEVEL_MODE, TomNotification=NULL_PTR
                TomChannelOutput:
                  TomChOutputDisableOnTgcTrig = false
                  TomChannelOutputControl = DONT_ENABLE_CHANNEL_OUTPUT
                  TomChannelOutputSignalLevel = LOW
                  TomChannelPortPinSelect = TOUT95_SELB_PORT11_PIN2
                TomChannelTimerParameters:
                  TomChDCycCompareShadowValSr1 = 0
                  TomChEnableForceUpdate = false
                  TomChPeriodCompareShadowValSr0 = 0
                  TomChResetCn0OnForceUpdate = false
                  TomChUpdateEnableOnCn0Reset = false
                  TomChannelBitReversalMode = false
                  TomChannelClockSelect = GTM_FIXED_CLOCK_0
                  TomChannelCounterCn0Reset = ON_COMPARE_MATCH_ON_CHANNEL
                  TomChannelCounterValCn0 = 0
                  TomChannelDutyCycleCompareValCm1 = 0
                  TomChannelGatedCounterMode = false
                  TomChannelOneShotMode = false
                  TomChannelPeriodCompareValCm0 = 0
                  TomChannelSpeMode = false
                  TomChannelTriggerOutput = TRIG_FROM_PREVIOUS_CHANNEL
                TomChannelUsage: TomChannelUsage=USED_BY_OTHER_DRIVERS_OR_UNUSED
              TomChannel_10
                TomChannelEnable: TomChDisableOnTgcTrigger=false, TomChannelEnable=AT_START
                TomChannelInterrupt: TomIntEnableOnDutyCycleMatchCcu1=false, TomIntEnableOnPeriodMatchCcu0=false, TomInterruptMode=GTM_INTERRUPT_LEVEL_MODE, TomNotification=NULL_PTR
                TomChannelOutput:
                  TomChOutputDisableOnTgcTrig = false
                  TomChannelOutputControl = DONT_ENABLE_CHANNEL_OUTPUT
                  TomChannelOutputSignalLevel = LOW
                  TomChannelPortPinSelect = TOUT104_SELB_PORT10_PIN2
                TomChannelTimerParameters:
                  TomChDCycCompareShadowValSr1 = 0
                  TomChEnableForceUpdate = false
                  TomChPeriodCompareShadowValSr0 = 0
                  TomChResetCn0OnForceUpdate = false
                  TomChUpdateEnableOnCn0Reset = false
                  TomChannelBitReversalMode = false
                  TomChannelClockSelect = GTM_FIXED_CLOCK_0
                  TomChannelCounterCn0Reset = ON_COMPARE_MATCH_ON_CHANNEL
                  TomChannelCounterValCn0 = 0
                  TomChannelDutyCycleCompareValCm1 = 0
                  TomChannelGatedCounterMode = false
                  TomChannelOneShotMode = false
                  TomChannelPeriodCompareValCm0 = 0
                  TomChannelSpeMode = false
                  TomChannelTriggerOutput = TRIG_FROM_PREVIOUS_CHANNEL
                TomChannelUsage: TomChannelUsage=USED_BY_OTHER_DRIVERS_OR_UNUSED
              TomChannel_11
                TomChannelEnable: TomChDisableOnTgcTrigger=false, TomChannelEnable=AT_START
                TomChannelInterrupt: TomIntEnableOnDutyCycleMatchCcu1=false, TomIntEnableOnPeriodMatchCcu0=false, TomInterruptMode=GTM_INTERRUPT_LEVEL_MODE, TomNotification=NULL_PTR
                TomChannelOutput:
                  TomChOutputDisableOnTgcTrig = false
                  TomChannelOutputControl = DONT_ENABLE_CHANNEL_OUTPUT
                  TomChannelOutputSignalLevel = LOW
                  TomChannelPortPinSelect = TOUT105_SELB_PORT10_PIN3
                TomChannelTimerParameters:
                  TomChDCycCompareShadowValSr1 = 0
                  TomChEnableForceUpdate = false
                  TomChPeriodCompareShadowValSr0 = 0
                  TomChResetCn0OnForceUpdate = false
                  TomChUpdateEnableOnCn0Reset = false
                  TomChannelBitReversalMode = false
                  TomChannelClockSelect = GTM_FIXED_CLOCK_0
                  TomChannelCounterCn0Reset = ON_COMPARE_MATCH_ON_CHANNEL
                  TomChannelCounterValCn0 = 0
                  TomChannelDutyCycleCompareValCm1 = 0
                  TomChannelGatedCounterMode = false
                  TomChannelOneShotMode = false
                  TomChannelPeriodCompareValCm0 = 0
                  TomChannelSpeMode = false
                  TomChannelTriggerOutput = TRIG_FROM_PREVIOUS_CHANNEL
                TomChannelUsage: TomChannelUsage=USED_BY_OTHER_DRIVERS_OR_UNUSED
              TomChannel_12
                TomChannelEnable: TomChDisableOnTgcTrigger=false, TomChannelEnable=AT_START
                TomChannelInterrupt: TomIntEnableOnDutyCycleMatchCcu1=false, TomIntEnableOnPeriodMatchCcu0=false, TomInterruptMode=GTM_INTERRUPT_LEVEL_MODE, TomNotification=NULL_PTR
                TomChannelOutput:
                  TomChOutputDisableOnTgcTrig = false
                  TomChannelOutputControl = DONT_ENABLE_CHANNEL_OUTPUT
                  TomChannelOutputSignalLevel = LOW
                  TomChannelPortPinSelect = TOUT102_SELB_PORT10_PIN0
                TomChannelTimerParameters:
                  TomChDCycCompareShadowValSr1 = 0
                  TomChEnableForceUpdate = false
                  TomChPeriodCompareShadowValSr0 = 0
                  TomChResetCn0OnForceUpdate = false
                  TomChUpdateEnableOnCn0Reset = false
                  TomChannelBitReversalMode = false
                  TomChannelClockSelect = GTM_FIXED_CLOCK_0
                  TomChannelCounterCn0Reset = ON_COMPARE_MATCH_ON_CHANNEL
                  TomChannelCounterValCn0 = 0
                  TomChannelDutyCycleCompareValCm1 = 0
                  TomChannelGatedCounterMode = false
                  TomChannelOneShotMode = false
                  TomChannelPeriodCompareValCm0 = 0
                  TomChannelSpeMode = false
                  TomChannelTriggerOutput = TRIG_FROM_PREVIOUS_CHANNEL
                TomChannelUsage: TomChannelUsage=USED_BY_OTHER_DRIVERS_OR_UNUSED
              TomChannel_13
                TomChannelEnable: TomChDisableOnTgcTrigger=false, TomChannelEnable=AT_START
                TomChannelInterrupt: TomIntEnableOnDutyCycleMatchCcu1=false, TomIntEnableOnPeriodMatchCcu0=false, TomInterruptMode=GTM_INTERRUPT_LEVEL_MODE, TomNotification=NULL_PTR
                TomChannelOutput:
                  TomChOutputDisableOnTgcTrig = false
                  TomChannelOutputControl = DONT_ENABLE_CHANNEL_OUTPUT
                  TomChannelOutputSignalLevel = LOW
                  TomChannelPortPinSelect = TOUT110_SELB_PORT10_PIN8
                TomChannelTimerParameters:
                  TomChDCycCompareShadowValSr1 = 0
                  TomChEnableForceUpdate = false
                  TomChPeriodCompareShadowValSr0 = 0
                  TomChResetCn0OnForceUpdate = false
                  TomChUpdateEnableOnCn0Reset = false
                  TomChannelBitReversalMode = false
                  TomChannelClockSelect = GTM_FIXED_CLOCK_0
                  TomChannelCounterCn0Reset = ON_COMPARE_MATCH_ON_CHANNEL
                  TomChannelCounterValCn0 = 0
                  TomChannelDutyCycleCompareValCm1 = 0
                  TomChannelGatedCounterMode = false
                  TomChannelOneShotMode = false
                  TomChannelPeriodCompareValCm0 = 0
                  TomChannelSpeMode = false
                  TomChannelTriggerOutput = TRIG_FROM_PREVIOUS_CHANNEL
                TomChannelUsage: TomChannelUsage=USED_BY_OTHER_DRIVERS_OR_UNUSED
              TomChannel_14
                TomChannelEnable: TomChDisableOnTgcTrigger=false, TomChannelEnable=AT_START
                TomChannelInterrupt: TomIntEnableOnDutyCycleMatchCcu1=false, TomIntEnableOnPeriodMatchCcu0=false, TomInterruptMode=GTM_INTERRUPT_LEVEL_MODE, TomNotification=NULL_PTR
                TomChannelOutput:
                  TomChOutputDisableOnTgcTrig = false
                  TomChannelOutputControl = DONT_ENABLE_CHANNEL_OUTPUT
                  TomChannelOutputSignalLevel = LOW
                  TomChannelPortPinSelect = TOUT74_SELB_PORT15_PIN3
                TomChannelTimerParameters:
                  TomChDCycCompareShadowValSr1 = 0
                  TomChEnableForceUpdate = false
                  TomChPeriodCompareShadowValSr0 = 0
                  TomChResetCn0OnForceUpdate = false
                  TomChUpdateEnableOnCn0Reset = false
                  TomChannelBitReversalMode = false
                  TomChannelClockSelect = GTM_FIXED_CLOCK_0
                  TomChannelCounterCn0Reset = ON_COMPARE_MATCH_ON_CHANNEL
                  TomChannelCounterValCn0 = 0
                  TomChannelDutyCycleCompareValCm1 = 0
                  TomChannelGatedCounterMode = false
                  TomChannelOneShotMode = false
                  TomChannelPeriodCompareValCm0 = 0
                  TomChannelSpeMode = false
                  TomChannelTriggerOutput = TRIG_FROM_PREVIOUS_CHANNEL
                TomChannelUsage: TomChannelUsage=USED_BY_OTHER_DRIVERS_OR_UNUSED
              TomChannel_15
                TomChannelEnable: TomChDisableOnTgcTrigger=false, TomChannelEnable=AT_START
                TomChannelInterrupt: TomIntEnableOnDutyCycleMatchCcu1=false, TomIntEnableOnPeriodMatchCcu0=false, TomInterruptMode=GTM_INTERRUPT_LEVEL_MODE, TomNotification=NULL_PTR
                TomChannelOutput:
                  TomChOutputDisableOnTgcTrig = false
                  TomChannelOutputControl = DONT_ENABLE_CHANNEL_OUTPUT
                  TomChannelOutputSignalLevel = LOW
                  TomChannelPortPinSelect = TOUT75_SELB_PORT15_PIN4
                TomChannelTimerParameters:
                  TomChDCycCompareShadowValSr1 = 0
                  TomChEnableForceUpdate = false
                  TomChPeriodCompareShadowValSr0 = 0
                  TomChResetCn0OnForceUpdate = false
                  TomChUpdateEnableOnCn0Reset = false
                  TomChannelBitReversalMode = false
                  TomChannelClockSelect = GTM_FIXED_CLOCK_0
                  TomChannelCounterCn0Reset = ON_COMPARE_MATCH_ON_CHANNEL
                  TomChannelCounterValCn0 = 0
                  TomChannelDutyCycleCompareValCm1 = 0
                  TomChannelGatedCounterMode = false
                  TomChannelOneShotMode = false
                  TomChannelPeriodCompareValCm0 = 0
                  TomChannelSpeMode = false
                  TomChannelTriggerOutput = TRIG_FROM_PREVIOUS_CHANNEL
                TomChannelUsage: TomChannelUsage=USED_BY_OTHER_DRIVERS_OR_UNUSED
              TomChannel_2
                TomChannelEnable: TomChDisableOnTgcTrigger=false, TomChannelEnable=AT_START
                TomChannelInterrupt: TomIntEnableOnDutyCycleMatchCcu1=false, TomIntEnableOnPeriodMatchCcu0=false, TomInterruptMode=GTM_INTERRUPT_LEVEL_MODE, TomNotification=NULL_PTR
                TomChannelOutput:
                  TomChOutputDisableOnTgcTrig = false
                  TomChannelOutputControl = DONT_ENABLE_CHANNEL_OUTPUT
                  TomChannelOutputSignalLevel = LOW
                  TomChannelPortPinSelect = TOUT96_SELB_PORT11_PIN3
                TomChannelTimerParameters:
                  TomChDCycCompareShadowValSr1 = 0
                  TomChEnableForceUpdate = false
                  TomChPeriodCompareShadowValSr0 = 0
                  TomChResetCn0OnForceUpdate = false
                  TomChUpdateEnableOnCn0Reset = false
                  TomChannelBitReversalMode = false
                  TomChannelClockSelect = GTM_FIXED_CLOCK_0
                  TomChannelCounterCn0Reset = ON_COMPARE_MATCH_ON_CHANNEL
                  TomChannelCounterValCn0 = 0
                  TomChannelDutyCycleCompareValCm1 = 0
                  TomChannelGatedCounterMode = false
                  TomChannelOneShotMode = false
                  TomChannelPeriodCompareValCm0 = 0
                  TomChannelSpeMode = false
                  TomChannelTriggerOutput = TRIG_FROM_PREVIOUS_CHANNEL
                TomChannelUsage: TomChannelUsage=USED_BY_OTHER_DRIVERS_OR_UNUSED
              TomChannel_3
                TomChannelEnable: TomChDisableOnTgcTrigger=false, TomChannelEnable=AT_START
                TomChannelInterrupt: TomIntEnableOnDutyCycleMatchCcu1=false, TomIntEnableOnPeriodMatchCcu0=false, TomInterruptMode=GTM_INTERRUPT_LEVEL_MODE, TomNotification=NULL_PTR
                TomChannelOutput:
                  TomChOutputDisableOnTgcTrig = false
                  TomChannelOutputControl = DONT_ENABLE_CHANNEL_OUTPUT
                  TomChannelOutputSignalLevel = LOW
                  TomChannelPortPinSelect = TOUT97_SELB_PORT11_PIN6
                TomChannelTimerParameters:
                  TomChDCycCompareShadowValSr1 = 0
                  TomChEnableForceUpdate = false
                  TomChPeriodCompareShadowValSr0 = 0
                  TomChResetCn0OnForceUpdate = false
                  TomChUpdateEnableOnCn0Reset = false
                  TomChannelBitReversalMode = false
                  TomChannelClockSelect = GTM_FIXED_CLOCK_0
                  TomChannelCounterCn0Reset = ON_COMPARE_MATCH_ON_CHANNEL
                  TomChannelCounterValCn0 = 0
                  TomChannelDutyCycleCompareValCm1 = 0
                  TomChannelGatedCounterMode = false
                  TomChannelOneShotMode = false
                  TomChannelPeriodCompareValCm0 = 0
                  TomChannelSpeMode = false
                  TomChannelTriggerOutput = TRIG_FROM_PREVIOUS_CHANNEL
                TomChannelUsage: TomChannelUsage=USED_BY_OTHER_DRIVERS_OR_UNUSED
              TomChannel_4
                TomChannelEnable: TomChDisableOnTgcTrigger=false, TomChannelEnable=AT_START
                TomChannelInterrupt: TomIntEnableOnDutyCycleMatchCcu1=false, TomIntEnableOnPeriodMatchCcu0=false, TomInterruptMode=GTM_INTERRUPT_LEVEL_MODE, TomNotification=NULL_PTR
                TomChannelOutput:
                  TomChOutputDisableOnTgcTrig = false
                  TomChannelOutputControl = DONT_ENABLE_CHANNEL_OUTPUT
                  TomChannelOutputSignalLevel = LOW
                  TomChannelPortPinSelect = TOUT98_SELB_PORT11_PIN9
                TomChannelTimerParameters:
                  TomChDCycCompareShadowValSr1 = 0
                  TomChEnableForceUpdate = false
                  TomChPeriodCompareShadowValSr0 = 0
                  TomChResetCn0OnForceUpdate = false
                  TomChUpdateEnableOnCn0Reset = false
                  TomChannelBitReversalMode = false
                  TomChannelClockSelect = GTM_FIXED_CLOCK_0
                  TomChannelCounterCn0Reset = ON_COMPARE_MATCH_ON_CHANNEL
                  TomChannelCounterValCn0 = 0
                  TomChannelDutyCycleCompareValCm1 = 0
                  TomChannelGatedCounterMode = false
                  TomChannelOneShotMode = false
                  TomChannelPeriodCompareValCm0 = 0
                  TomChannelSpeMode = false
                  TomChannelTriggerOutput = TRIG_FROM_PREVIOUS_CHANNEL
                TomChannelUsage: TomChannelUsage=USED_BY_OTHER_DRIVERS_OR_UNUSED
              TomChannel_5
                TomChannelEnable: TomChDisableOnTgcTrigger=false, TomChannelEnable=AT_START
                TomChannelInterrupt: TomIntEnableOnDutyCycleMatchCcu1=false, TomIntEnableOnPeriodMatchCcu0=false, TomInterruptMode=GTM_INTERRUPT_LEVEL_MODE, TomNotification=NULL_PTR
                TomChannelOutput:
                  TomChOutputDisableOnTgcTrig = false
                  TomChannelOutputControl = DONT_ENABLE_CHANNEL_OUTPUT
                  TomChannelOutputSignalLevel = LOW
                  TomChannelPortPinSelect = TOUT99_SELB_PORT11_PIN10
                TomChannelTimerParameters:
                  TomChDCycCompareShadowValSr1 = 0
                  TomChEnableForceUpdate = false
                  TomChPeriodCompareShadowValSr0 = 0
                  TomChResetCn0OnForceUpdate = false
                  TomChUpdateEnableOnCn0Reset = false
                  TomChannelBitReversalMode = false
                  TomChannelClockSelect = GTM_FIXED_CLOCK_0
                  TomChannelCounterCn0Reset = ON_COMPARE_MATCH_ON_CHANNEL
                  TomChannelCounterValCn0 = 0
                  TomChannelDutyCycleCompareValCm1 = 0
                  TomChannelGatedCounterMode = false
                  TomChannelOneShotMode = false
                  TomChannelPeriodCompareValCm0 = 0
                  TomChannelSpeMode = false
                  TomChannelTriggerOutput = TRIG_FROM_PREVIOUS_CHANNEL
                TomChannelUsage: TomChannelUsage=USED_BY_OTHER_DRIVERS_OR_UNUSED
              TomChannel_6
                TomChannelEnable: TomChDisableOnTgcTrigger=false, TomChannelEnable=AT_START
                TomChannelInterrupt: TomIntEnableOnDutyCycleMatchCcu1=false, TomIntEnableOnPeriodMatchCcu0=false, TomInterruptMode=GTM_INTERRUPT_LEVEL_MODE, TomNotification=NULL_PTR
                TomChannelOutput:
                  TomChOutputDisableOnTgcTrig = false
                  TomChannelOutputControl = DONT_ENABLE_CHANNEL_OUTPUT
                  TomChannelOutputSignalLevel = LOW
                  TomChannelPortPinSelect = TOUT106_SELB_PORT10_PIN4
                TomChannelTimerParameters:
                  TomChDCycCompareShadowValSr1 = 0
                  TomChEnableForceUpdate = false
                  TomChPeriodCompareShadowValSr0 = 0
                  TomChResetCn0OnForceUpdate = false
                  TomChUpdateEnableOnCn0Reset = false
                  TomChannelBitReversalMode = false
                  TomChannelClockSelect = GTM_FIXED_CLOCK_0
                  TomChannelCounterCn0Reset = ON_COMPARE_MATCH_ON_CHANNEL
                  TomChannelCounterValCn0 = 0
                  TomChannelDutyCycleCompareValCm1 = 0
                  TomChannelGatedCounterMode = false
                  TomChannelOneShotMode = false
                  TomChannelPeriodCompareValCm0 = 0
                  TomChannelSpeMode = false
                  TomChannelTriggerOutput = TRIG_FROM_PREVIOUS_CHANNEL
                TomChannelUsage: TomChannelUsage=USED_BY_OTHER_DRIVERS_OR_UNUSED
              TomChannel_7
                TomChannelEnable: TomChDisableOnTgcTrigger=false, TomChannelEnable=AT_START
                TomChannelInterrupt: TomIntEnableOnDutyCycleMatchCcu1=false, TomIntEnableOnPeriodMatchCcu0=false, TomInterruptMode=GTM_INTERRUPT_LEVEL_MODE, TomNotification=NULL_PTR
                TomChannelOutput:
                  TomChOutputDisableOnTgcTrig = false
                  TomChannelOutputControl = DONT_ENABLE_CHANNEL_OUTPUT
                  TomChannelOutputSignalLevel = LOW
                  TomChannelPortPinSelect = TOUT101_SELB_PORT11_PIN12
                TomChannelTimerParameters:
                  TomChDCycCompareShadowValSr1 = 0
                  TomChEnableForceUpdate = false
                  TomChPeriodCompareShadowValSr0 = 0
                  TomChResetCn0OnForceUpdate = false
                  TomChUpdateEnableOnCn0Reset = false
                  TomChannelBitReversalMode = false
                  TomChannelClockSelect = GTM_FIXED_CLOCK_0
                  TomChannelCounterCn0Reset = ON_COMPARE_MATCH_ON_CHANNEL
                  TomChannelCounterValCn0 = 0
                  TomChannelDutyCycleCompareValCm1 = 0
                  TomChannelGatedCounterMode = false
                  TomChannelOneShotMode = false
                  TomChannelPeriodCompareValCm0 = 0
                  TomChannelSpeMode = false
                  TomChannelTriggerOutput = TRIG_FROM_PREVIOUS_CHANNEL
                TomChannelUsage: TomChannelUsage=USED_BY_OTHER_DRIVERS_OR_UNUSED
              TomChannel_8
                TomChannelEnable: TomChDisableOnTgcTrigger=false, TomChannelEnable=AT_START
                TomChannelInterrupt: TomIntEnableOnDutyCycleMatchCcu1=false, TomIntEnableOnPeriodMatchCcu0=false, TomInterruptMode=GTM_INTERRUPT_LEVEL_MODE, TomNotification=NULL_PTR
                TomChannelOutput:
                  TomChOutputDisableOnTgcTrig = false
                  TomChannelOutputControl = DONT_ENABLE_CHANNEL_OUTPUT
                  TomChannelOutputSignalLevel = LOW
                  TomChannelPortPinSelect = TOUT109_SELB_PORT10_PIN7
                TomChannelTimerParameters:
                  TomChDCycCompareShadowValSr1 = 0
                  TomChEnableForceUpdate = false
                  TomChPeriodCompareShadowValSr0 = 0
                  TomChResetCn0OnForceUpdate = false
                  TomChUpdateEnableOnCn0Reset = false
                  TomChannelBitReversalMode = false
                  TomChannelClockSelect = GTM_FIXED_CLOCK_0
                  TomChannelCounterCn0Reset = ON_COMPARE_MATCH_ON_CHANNEL
                  TomChannelCounterValCn0 = 0
                  TomChannelDutyCycleCompareValCm1 = 0
                  TomChannelGatedCounterMode = false
                  TomChannelOneShotMode = false
                  TomChannelPeriodCompareValCm0 = 0
                  TomChannelSpeMode = false
                  TomChannelTriggerOutput = TRIG_FROM_PREVIOUS_CHANNEL
                TomChannelUsage: TomChannelUsage=USED_BY_OTHER_DRIVERS_OR_UNUSED
              TomChannel_9
                TomChannelEnable: TomChDisableOnTgcTrigger=false, TomChannelEnable=AT_START
                TomChannelInterrupt: TomIntEnableOnDutyCycleMatchCcu1=false, TomIntEnableOnPeriodMatchCcu0=false, TomInterruptMode=GTM_INTERRUPT_LEVEL_MODE, TomNotification=NULL_PTR
                TomChannelOutput:
                  TomChOutputDisableOnTgcTrig = false
                  TomChannelOutputControl = DONT_ENABLE_CHANNEL_OUTPUT
                  TomChannelOutputSignalLevel = LOW
                  TomChannelPortPinSelect = TOUT103_SELB_PORT10_PIN1
                TomChannelTimerParameters:
                  TomChDCycCompareShadowValSr1 = 0
                  TomChEnableForceUpdate = false
                  TomChPeriodCompareShadowValSr0 = 0
                  TomChResetCn0OnForceUpdate = false
                  TomChUpdateEnableOnCn0Reset = false
                  TomChannelBitReversalMode = false
                  TomChannelClockSelect = GTM_FIXED_CLOCK_0
                  TomChannelCounterCn0Reset = ON_COMPARE_MATCH_ON_CHANNEL
                  TomChannelCounterValCn0 = 0
                  TomChannelDutyCycleCompareValCm1 = 0
                  TomChannelGatedCounterMode = false
                  TomChannelOneShotMode = false
                  TomChannelPeriodCompareValCm0 = 0
                  TomChannelSpeMode = false
                  TomChannelTriggerOutput = TRIG_FROM_PREVIOUS_CHANNEL
                TomChannelUsage: TomChannelUsage=USED_BY_OTHER_DRIVERS_OR_UNUSED
            TomTriggersForTgc_0 (TomTriggersForTgc)
              TomTgcInternalTriggerSelect:
                TomTgcIntTriggerFromChannel{0..7} = false
              TomTgcTriggerByTimebase: TomTgcTbuTimebaseSelect=TBU_TS0_TIMEBASE, TomTgcTimeBaseTriggerEnable=false, TomTgcTimebaseMatchValue=0
            TomTriggersForTgc_1 (TomTriggersForTgc)
              TomTgcInternalTriggerSelect:
                TomTgcIntTriggerFromChannel{0..7} = false
              TomTgcTriggerByTimebase: TomTgcTbuTimebaseSelect=TBU_TS0_TIMEBASE, TomTgcTimeBaseTriggerEnable=false, TomTgcTimebaseMatchValue=0
      McuClockSettingConfig_0 (McuClockSettingConfig): McuClockSettingId=0
        McuClockReferencePoint:
          McuASCLINFDivider = 2
          McuASCLINSDivider = 2
          McuBAUD1Divider = 2
          McuBAUD2Divider = 2
          McuBBBDivider = 2
          McuCANDivider = 2
          McuCPU{0..2}Divider = 0
          McuClockASCLINFFrequency = 80000000
          McuClockASCLINSFrequency = 80000000
          McuClockBAUD1Frequency = 80000000
          McuClockBAUD2Frequency = 80000000
          McuClockBBBFrequency = 80000000
          McuClockCANFrequency = 80000000
          McuClockCPU{0..2}Frequency = 160000000
          McuClockErayFrequency = 80000000
          McuClockErayPll2Frequency = 96000000
          McuClockErayPllFrequency = 160000000
          McuClockFSI2Frequency = 160000000
          McuClockFSIFrequency = 80000000
          McuClockGTMFrequency = 80000000
          McuClockMAXFrequency = 160000000
          McuClockReferencePoint2Frequency = 96000000
          McuClockReferencePointFrequency = 160000000
          McuClockSPBFrequency = 80000000
          McuClockSRIFrequency = 160000000
          McuClockSTMFrequency = 80000000
          McuClockSettingMode = NORMAL_MODE
          McuEBUDivider = 0
          McuETHDivider = 1
          McuETHFrequency = 40000000
          McuErayDivider = 2
          McuErayPllK2Divider = 2
          McuErayPllK3Divider = 4
          McuErayPllNDivider = 23
          McuErayPllPDivider = 0
          McuFMPllModAmp = 1.25
          McuFSI2Divider = 1
          McuFSIDivider = 2
          McuGTMDivider = 2
          McuK2DivRampToBackUpConfDelay = 10
          McuK2DivRampToPllConfDelay = 10
          McuK2DivSteps = 4
          McuMAXDivider = 1
          McuPllK1Divider = 1
          McuPllK2Divider = 2
          McuPllK3Divider = 4
          McuPllNDivider = 23
          McuPllPDivider = 0
          McuSPBDivider = 2
          McuSRIDivider = 1
          McuSTMDivider = 2
      McuModeSettingConf_0 (McuModeSettingConf): McuIdleReqAckSeqDisable=false, McuMode=0
        McuStandbySettingConf:
          McuESR0TristateEnable = false
          McuESR1DigitalFilterEnable = false
          McuESR1EdgeDetection = TRIGGER_ANY_EDGE
          McuESR1WakeUpEnable = false
          McuExtSupplyBlankingFilterDelay = T2_5MS
          McuPORSTDigitalFilterEnable = false
          McuPinADigitalFilterEnable = false
          McuPinAEdgeDetection = TRIGGER_ANY_EDGE
          McuPinAWakeUpEnable = false
          McuPinBDigitalFilterEnable = false
          McuPinBEdgeDetection = TRIGGER_ANY_EDGE
          McuPinBWakeUpEnable = false
          McuRARCrcCheckEnable = false
          McuRampToBackupFreqApi = false
          McuSetStandbyWakeupControlApi = false
          McuStandbyRAMSupplyEnable = true
          McuTristateEnable = false
          McuWakeupOnExtSupplyRampUpEnable = false
      McuTriggerReset: ESR0ResetTrigger=0, ESR1ResetTrigger=0, SMUResetTrigger=1, STM0ResetTrigger=0, STM1ResetTrigger=0, STM2ResetTrigger=0
      CcuConfiguration
        Ccu6
          General: Ccu6ModuleUsage=UNUSED
          T12
            General: T12ClkSelection=0, T12PrescalerEnabled=false
            3 x Cc6:
              Cc6: CCChannelInputSelection=CCINA_PORT2_PIN0
              Cc6_1: CCChannelInputSelection=CCINA_PORT2_PIN2
              Cc6_2: CCChannelInputSelection=CCINA_PORT2_PIN4
          T13
            General: T13ClkSelection=0, T13PrescalerEnabled=false
        Ccu6_1 (Ccu6)
          General: Ccu6ModuleUsage=UNUSED
          T12
            General: T12ClkSelection=0, T12PrescalerEnabled=false
            3 x Cc6:
              Cc6: CCChannelInputSelection=CCINA_PORT0_PIN1
              Cc6_1: CCChannelInputSelection=CCINA_PORT0_PIN3
              Cc6_2: CCChannelInputSelection=CCINA_PORT0_PIN5
          T13
            General: T13ClkSelection=0, T13PrescalerEnabled=false
    McuSafety: McuClockMonitoringEnable=true, McuGetModeApi=true, McuInitCheckApi=true, McuSafetyEnable=false
    CommonPublishedInformation:
      ArMajorVersion = 3
      ArMinorVersion = 2
      ArPatchVersion = 0
      ModuleId = 101
      Release = _TRICORE_TC275
      SwMajorVersion = 4
      SwMinorVersion = 9
      SwPatchVersion = 1
      VendorId = 17
