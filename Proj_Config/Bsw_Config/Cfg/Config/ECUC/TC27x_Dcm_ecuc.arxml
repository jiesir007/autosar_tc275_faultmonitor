AUTOSAR XML (schema 00046)
package /ActiveEcuC
  module config Dcm: implementation-config-variant=VARIANT-PRE-COMPILE, module-description=Dcm_Impl
    DcmConfigSet
      DcmDsl
        DcmDslProtocol
          DcmDslProtocolRow_29812fbf (DcmDslProtocolRow):
            DcmDslProtocolEndiannessConvEnabled = false
            DcmDslProtocolID = DCM_UDS_ON_CAN
            DcmDslProtocolPreemptTimeout = 0
            DcmDslProtocolPriority = 0
            DcmSendRespPendOnTransToBoot = true
            DcmTimStrP2ServerAdjust = 0
            DcmTimStrP2StarServerAdjust = 0
            DcmDslProtocolMaximumResponseSize = 4095
            DcmDslProtocolRxBufferID = DcmDslBuffer
            DcmDslProtocolSIDTable = DcmDsdServiceTable
            DcmDslProtocolTxBufferID = DcmDslBuffer
            DcmDemClientRef = DemClient
            DcmDslConnection_b0443a58 (DcmDslConnection)
              DcmDslMainConnection: DcmDslProtocolRxTesterSourceAddr=0, DcmDslProtocolRxConnectionId=0
                Meg_ResDiag_oDBCNetWork_5467f8e5_Tx_024d51d1 (DcmDslProtocolTx): DcmDslTxConfirmationPduId=0, DcmDslProtocolTxPduRef=Meg_ResDiag_oDBCNetWork_5467f8e5_Tx
                Meg_FunDiag_oDBCNetWork_8501a87a_Rx_bf5f7bb7 (DcmDslProtocolRx):
                  DcmDslProtocolRxAddrType = DCM_FUNCTIONAL_TYPE
                  DcmDslProtocolRxPduId = 0
                  DcmDslProtocolRxChannelId = 0
                  DcmDslProtocolRxComMChannelRef = CN_DBCNetWork_05d62413
                  DcmDslProtocolRxPduRef = Meg_FunDiag_oDBCNetWork_8501a87a_Rx
                Meg_PhyDiag_oDBCNetWork_e154eea6_Rx_9bc604ea (DcmDslProtocolRx):
                  DcmDslProtocolRxAddrType = DCM_PHYSICAL_TYPE
                  DcmDslProtocolRxPduId = 1
                  DcmDslProtocolRxChannelId = 0
                  DcmDslProtocolRxComMChannelRef = CN_DBCNetWork_05d62413
                  DcmDslProtocolRxPduRef = Meg_PhyDiag_oDBCNetWork_e154eea6_Rx
        DcmDslDiagResp: DcmDslDiagRespMaxNumRespPend=0, DcmDslDiagRespOnSecondDeclinedRequest=false, DcmDslDiagRespMaxNumOfDeclinedRequests=3
        DcmDslBuffer: DcmDslBufferSize=50
      DcmGeneral:
        DcmDevErrorDetect = false
        DcmRequestManufacturerNotificationEnabled = false
        DcmRequestSupplierNotificationEnabled = false
        DcmRespondAllRequest = true
        DcmTaskTime = 0.005
        DcmVersionInfoApi = false
        DcmDspDataDefaultEndianness = LITTLE_ENDIAN
        DcmSafeBswChecks = false
        DcmSupportedIDCalculationSuppressionEnabled = false
        DcmDtrDataProvisionViaDemEnabled = true
        DcmForeignDiagnosticRequestDetectionEnabled = false
        DcmSuppressResponseOnCanTpFuncMixedAddrRequests = false
        DcmSenderReceiverPRPortsEnabled = false
        DcmDemApiVersion = DCM_DEM_API_4_03_00
      DcmDsd
        DcmDsdServiceTable
          12 x DcmDsdService:
            ReadDtcInfo: DcmDsdSidTabServiceId=25, DcmDsdSidTabSubfuncAvail=true
              5 x DcmDsdSubService:
                RDTCBSM: DcmDsdSubServiceId=2
                RNODTCBSM: DcmDsdSubServiceId=1
                RDTCEDRBDN: DcmDsdSubServiceId=6
                RSUPDTC: DcmDsdSubServiceId=10
                RDTCSSBDTC: DcmDsdSubServiceId=4
            ClearDiagInfo: DcmDsdSidTabServiceId=20, DcmDsdSidTabSubfuncAvail=false
            EcuReset: DcmDsdSidTabServiceId=17, DcmDsdSidTabSubfuncAvail=true
              Soft (DcmDsdSubService): DcmDsdSubServiceId=3
              Hard (DcmDsdSubService): DcmDsdSubServiceId=1
            ControlDtcSetting: DcmDsdSidTabServiceId=133, DcmDsdSidTabSubfuncAvail=true, DcmDsdSidTabSessionLevelRef=DcmDspSession/Programming, DcmDsdSidTabSessionLevelRef=DcmDspSession/Extended
              Disable (DcmDsdSubService): DcmDsdSubServiceId=2, DcmDsdSubServiceSessionLevelRef=DcmDspSession/Programming, DcmDsdSubServiceSessionLevelRef=DcmDspSession/Extended
              Enable (DcmDsdSubService): DcmDsdSubServiceId=1, DcmDsdSubServiceSessionLevelRef=DcmDspSession/Programming, DcmDsdSubServiceSessionLevelRef=DcmDspSession/Extended
            TesterPresent: DcmDsdSidTabServiceId=62, DcmDsdSidTabSubfuncAvail=true
              TesterPresent (DcmDsdSubService): DcmDsdSubServiceId=0
            ReadDataById: DcmDsdSidTabServiceId=34, DcmDsdSidTabSubfuncAvail=false
            CommunicationControl: DcmDsdSidTabServiceId=40, DcmDsdSidTabSubfuncAvail=true, DcmDsdSidTabSessionLevelRef=DcmDspSession/Programming, DcmDsdSidTabSessionLevelRef=DcmDspSession/Extended
              EnableRxAndDisableTx (DcmDsdSubService): DcmDsdSubServiceId=1, DcmDsdSubServiceSessionLevelRef=DcmDspSession/Programming, DcmDsdSubServiceSessionLevelRef=DcmDspSession/Extended
              EnableRxAndTx (DcmDsdSubService): DcmDsdSubServiceId=0, DcmDsdSubServiceSessionLevelRef=DcmDspSession/Programming, DcmDsdSubServiceSessionLevelRef=DcmDspSession/Extended
            RoutineControl: DcmDsdSidTabServiceId=49, DcmDsdSidTabSubfuncAvail=true
            WriteDataById: DcmDsdSidTabServiceId=46, DcmDsdSidTabSubfuncAvail=false
            SecurityAccess: DcmDsdSidTabServiceId=39, DcmDsdSidTabSubfuncAvail=true, DcmDsdSidTabSessionLevelRef=DcmDspSession/Programming, DcmDsdSidTabSessionLevelRef=DcmDspSession/Extended
              SeedLevel1_Request (DcmDsdSubService): DcmDsdSubServiceId=1, DcmDsdSubServiceSessionLevelRef=DcmDspSession/Programming, DcmDsdSubServiceSessionLevelRef=DcmDspSession/Extended
              KeyLevel1_Send (DcmDsdSubService): DcmDsdSubServiceId=2, DcmDsdSubServiceSessionLevelRef=DcmDspSession/Programming, DcmDsdSubServiceSessionLevelRef=DcmDspSession/Extended
            IoControlById: DcmDsdSidTabServiceId=47, DcmDsdSidTabSubfuncAvail=false, DcmDsdSidTabSessionLevelRef=DcmDspSession/Programming, DcmDsdSidTabSessionLevelRef=DcmDspSession/Extended
            DiagSessionControl: DcmDsdSidTabServiceId=16, DcmDsdSidTabSubfuncAvail=true
              3 x DcmDsdSubService:
                Programming: DcmDsdSubServiceId=2, DcmDsdSubServiceSessionLevelRef=DcmDspSession/Programming, DcmDsdSubServiceSessionLevelRef=DcmDspSession/Extended
                Default: DcmDsdSubServiceId=1
                Extended: DcmDsdSubServiceId=3
      DcmDsp: DcmDspMaxDidToRead=1, DcmDspReadDIDReportsNODIByte=false
        ECU_Check (DcmDspRoutine):
          DcmDspRequestResultsRoutineSupported = true
          DcmDspStopRoutineSupported = false
          DcmDspRoutineIdentifier = 256
          DcmDspRoutineFixedLength = false
          DcmDspRoutineUsePort = true
          DcmDspRoutineUsed = true
          DcmDspRoutineInfoRef = RoutineInfo_ECU_Check
        DidInfo_Braking (DcmDspDidInfo)
          DcmDspDidAccess
            DcmDspDidRead
        DataInfo_Braking_Brake_Pedal (DcmDspDataInfo): DcmDspDataFixedLength=true
        RoutineInfo_ECU_Check (DcmDspRoutineInfo)
          DcmDspRoutineRequestResOut
            Out_ECU_Check_status (DcmDspRoutineRequestResOutSignal): DcmDspRoutineSignalLength=8, DcmDspRoutineSignalType=UINT8, DcmDspRoutineSignalPos=0
          DcmDspStartRoutineIn
            In_Start_ECU_Check (DcmDspStartRoutineInSignal): DcmDspRoutineSignalLength=8, DcmDspRoutineSignalType=UINT8, DcmDspRoutineSignalPos=0
          DcmDspRoutineAuthorization
          DcmDspStartRoutineOut
            Out_ECU_Check_is_in_progress (DcmDspStartRoutineOutSignal): DcmDspRoutineSignalLength=8, DcmDspRoutineSignalType=UINT8, DcmDspRoutineSignalPos=0
        DcmDspSession
          3 x DcmDspSessionRow, all with DcmDspSessionP2ServerMax=0.05, DcmDspSessionP2StarServerMax=5, DcmDspSessionForBoot=DCM_NO_BOOT:
            Default: DcmDspSessionLevel=1
            Programming: DcmDspSessionLevel=2
            Extended: DcmDspSessionLevel=3
        Braking (DcmDspDid): DcmDspDidIdentifier=256, DcmDspDidUsed=true, DcmDspDidUsePort=USE_DATA_ELEMENT_SPECIFIC_INTERFACES, DcmDspDidInfoRef=DidInfo_Braking
          7 x DcmDspDidSignal:
            Brake_Pedal: DcmDspDidDataPos=0, DcmDspDidDataRef=Braking_Brake_Pedal
            Valve_Status_RR: DcmDspDidDataPos=40, DcmDspDidDataRef=Braking_Valve_Status_RR
            Valve_Status_FR: DcmDspDidDataPos=24, DcmDspDidDataRef=Braking_Valve_Status_FR
            Status_Hydraulic_Pump: DcmDspDidDataPos=16, DcmDspDidDataRef=Braking_Status_Hydraulic_Pump
            Brake_Pressure: DcmDspDidDataPos=8, DcmDspDidDataRef=Braking_Brake_Pressure
            Valve_Status_RL: DcmDspDidDataPos=48, DcmDspDidDataRef=Braking_Valve_Status_RL
            Valve_Status_FL: DcmDspDidDataPos=32, DcmDspDidDataRef=Braking_Valve_Status_FL
        Braking_Brake_Pedal (DcmDspData): DcmDspDataSize=8, DcmDspDataType=UINT8, DcmDspDataUsePort=USE_DATA_ASYNCH_CLIENT_SERVER, DcmDspDataInfoRef=DataInfo_Braking_Brake_Pedal
        ComControl (DcmDspComControl)
          DspComContolAllChannel (DcmDspComControlAllChannel): DcmDspAllComMChannelRef=CN_DBCNetWork_05d62413
        DcmDspSecurity
          UnlockedL1 (DcmDspSecurityRow):
            DcmDspSecurityKeySize = 4
            DcmDspSecurityLevel = 1
            DcmDspSecuritySeedSize = 4
            DcmDspSecurityAttemptCounterEnabled = false
            DcmDspSecurityDelayTime = 0
            DcmDspSecurityDelayTimeOnBoot = 0
            DcmDspSecurityNumAttDelay = 0
            DcmDspSecurityUsePort = USE_ASYNCH_CLIENT_SERVER
        DidInfo_Fingerprint (DcmDspDidInfo)
          DcmDspDidAccess
            DcmDspDidWrite
            DcmDspDidRead
        DidInfo_Hydraulic_Pump (DcmDspDidInfo)
          DcmDspDidAccess
            DcmDspDidRead
        Software_Supplier_Identification_SoftwareSupplier (DcmDspData):
          DcmDspDataSize = 8
          DcmDspDataType = UINT8
          DcmDspDataUsePort = USE_DATA_ASYNCH_CLIENT_SERVER
          DcmDspDataInfoRef = DataInfo_Software_Supplier_Identification_SoftwareSupplier
        Fingerprint_Serial_number_of_flash_tool (DcmDspData):
          DcmDspDataSize = 64
          DcmDspDataType = UINT8_N
          DcmDspDataUsePort = USE_DATA_ASYNCH_CLIENT_SERVER
          DcmDspDataInfoRef = DataInfo_Fingerprint_Serial_number_of_flash_tool
        3 x DcmDspDataInfo, all with DcmDspDataFixedLength=true:
          DataInfo_Hydro_Unit_Valve_Status_FR
          DataInfo_Brake_Pedal_Valve_Status_RL
          DataInfo_Hydro_Unit_Valve_Status_FL
        Hydro_Unit (DcmDspDid): DcmDspDidIdentifier=268, DcmDspDidUsed=true, DcmDspDidUsePort=USE_DATA_ELEMENT_SPECIFIC_INTERFACES, DcmDspDidInfoRef=DidInfo_Hydro_Unit
          8 x DcmDspDidSignal:
            Valve_Status_RR: DcmDspDidDataPos=48, DcmDspDidDataRef=Hydro_Unit_Valve_Status_RR
            Valve_Voltage_FR: DcmDspDidDataPos=0, DcmDspDidDataRef=Hydro_Unit_Valve_Voltage_FR
            Valve_Status_FR: DcmDspDidDataPos=32, DcmDspDidDataRef=Hydro_Unit_Valve_Status_FR
            Valve_Voltage_RL: DcmDspDidDataPos=24, DcmDspDidDataRef=Hydro_Unit_Valve_Voltage_RL
            Valve_Status_RL: DcmDspDidDataPos=56, DcmDspDidDataRef=Hydro_Unit_Valve_Status_RL
            Valve_Voltage_FL: DcmDspDidDataPos=8, DcmDspDidDataRef=Hydro_Unit_Valve_Voltage_FL
            Valve_Voltage_RR: DcmDspDidDataPos=16, DcmDspDidDataRef=Hydro_Unit_Valve_Voltage_RR
            Valve_Status_FL: DcmDspDidDataPos=40, DcmDspDidDataRef=Hydro_Unit_Valve_Status_FL
        Hardware_Supplier_Identification_HardwareSupplier (DcmDspData):
          DcmDspDataSize = 8
          DcmDspDataType = UINT8
          DcmDspDataUsePort = USE_DATA_ASYNCH_CLIENT_SERVER
          DcmDspDataInfoRef = DataInfo_Hardware_Supplier_Identification_HardwareSupplier
        Switches (DcmDspDid): DcmDspDidIdentifier=272, DcmDspDidUsed=true, DcmDspDidUsePort=USE_DATA_ELEMENT_SPECIFIC_INTERFACES, DcmDspDidInfoRef=DidInfo_Switches
          3 x DcmDspDidSignal:
            Brake_Switch: DcmDspDidDataPos=0, DcmDspDidDataRef=Switches_Brake_Switch
            Parking_Brake_Switch: DcmDspDidDataPos=8, DcmDspDidDataRef=Switches_Parking_Brake_Switch
            Rear_Gear_Switch: DcmDspDidDataPos=16, DcmDspDidDataRef=Switches_Rear_Gear_Switch
        DidInfo_VIN (DcmDspDidInfo)
          DcmDspDidAccess
            DcmDspDidWrite
            DcmDspDidRead
        DataInfo_Serial_Number_SerialNumber (DcmDspDataInfo): DcmDspDataFixedLength=true
        DidInfo_Service_Information (DcmDspDidInfo)
          DcmDspDidAccess
            DcmDspDidWrite
            DcmDspDidRead
        Acceleration_Sensor_Acceleration (DcmDspData):
          DcmDspDataSize = 8
          DcmDspDataType = UINT8
          DcmDspDataUsePort = USE_DATA_ASYNCH_CLIENT_SERVER
          DcmDspDataInfoRef = DataInfo_Acceleration_Sensor_Acceleration
        Fingerprint_Programming_Date (DcmDspData):
          DcmDspDataSize = 64
          DcmDspDataType = UINT8_N
          DcmDspDataUsePort = USE_DATA_ASYNCH_CLIENT_SERVER
          DcmDspDataInfoRef = DataInfo_Fingerprint_Programming_Date
        DataInfo_Brake_Pedal_Valve_Status_RR (DcmDspDataInfo): DcmDspDataFixedLength=true
        Service_Information_Remaining_Service_Time_Left (DcmDspData):
          DcmDspDataSize = 16
          DcmDspDataType = UINT16
          DcmDspDataUsePort = USE_DATA_ASYNCH_CLIENT_SERVER
          DcmDspDataInfoRef = DataInfo_Service_Information_Remaining_Service_Time_Left
        Service_Information (DcmDspDid): DcmDspDidIdentifier=274, DcmDspDidUsed=true, DcmDspDidUsePort=USE_DATA_ELEMENT_SPECIFIC_INTERFACES, DcmDspDidInfoRef=DidInfo_Service_Information
          Remaining_Service_Brake_Fluid_Life (DcmDspDidSignal): DcmDspDidDataPos=0, DcmDspDidDataRef=Service_Information_Remaining_Service_Brake_Fluid_Life
          Remaining_Service_Time_Left (DcmDspDidSignal): DcmDspDidDataPos=8, DcmDspDidDataRef=Service_Information_Remaining_Service_Time_Left
        DidInfo_Acceleration_Sensor (DcmDspDidInfo)
          DcmDspDidAccess
            DcmDspDidRead
        Hydraulic_Pump_Status_Hydraulic_Pump (DcmDspData):
          DcmDspDataSize = 8
          DcmDspDataType = UINT8
          DcmDspDataUsePort = USE_DATA_ASYNCH_CLIENT_SERVER
          DcmDspDataInfoRef = DataInfo_Hydraulic_Pump_Status_Hydraulic_Pump
        Hydraulic_Pump_Hydraulic_Pump_Voltage (DcmDspData):
          DcmDspDataSize = 8
          DcmDspDataType = UINT8
          DcmDspDataUsePort = USE_DATA_ASYNCH_CLIENT_SERVER
          DcmDspDataInfoRef = DataInfo_Hydraulic_Pump_Hydraulic_Pump_Voltage
        DataInfo_Switches_Parking_Brake_Switch (DcmDspDataInfo): DcmDspDataFixedLength=true
        Acceleration_Sensor_Voltage (DcmDspData): DcmDspDataSize=8, DcmDspDataType=UINT8, DcmDspDataUsePort=USE_DATA_ASYNCH_CLIENT_SERVER, DcmDspDataInfoRef=DataInfo_Acceleration_Sensor_Voltage
        DataInfo_Wheel_Speed_Wheel_Speed_RR (DcmDspDataInfo): DcmDspDataFixedLength=true
        DidInfo_Software_Version (DcmDspDidInfo)
          DcmDspDidAccess
            DcmDspDidWrite
            DcmDspDidRead
        Hydraulic_Pump (DcmDspDid): DcmDspDidIdentifier=271, DcmDspDidUsed=true, DcmDspDidUsePort=USE_DATA_ELEMENT_SPECIFIC_INTERFACES, DcmDspDidInfoRef=DidInfo_Hydraulic_Pump
          3 x DcmDspDidSignal:
            Status_Hydraulic_Pump: DcmDspDidDataPos=8, DcmDspDidDataRef=Hydraulic_Pump_Status_Hydraulic_Pump
            Hydraulic_Pump_Voltage: DcmDspDidDataPos=0, DcmDspDidDataRef=Hydraulic_Pump_Hydraulic_Pump_Voltage
            Hydraulic_Pump_Performance: DcmDspDidDataPos=16, DcmDspDidDataRef=Hydraulic_Pump_Hydraulic_Pump_Performance
        DataInfo_Wheel_Speed_Wheel_Speed_RL (DcmDspDataInfo): DcmDspDataFixedLength=true
        Hydro_Unit_Valve_Status_RL (DcmDspData): DcmDspDataSize=8, DcmDspDataType=UINT8, DcmDspDataUsePort=USE_DATA_ASYNCH_CLIENT_SERVER, DcmDspDataInfoRef=DataInfo_Hydro_Unit_Valve_Status_RL
        DidInfo_Serial_Number (DcmDspDidInfo)
          DcmDspDidAccess
            DcmDspDidWrite
            DcmDspDidRead
        DataInfo_Inflation_Pressure_Inflation_Pressure_FR (DcmDspDataInfo): DcmDspDataFixedLength=true
        Hydro_Unit_Valve_Status_RR (DcmDspData): DcmDspDataSize=8, DcmDspDataType=UINT8, DcmDspDataUsePort=USE_DATA_ASYNCH_CLIENT_SERVER, DcmDspDataInfoRef=DataInfo_Hydro_Unit_Valve_Status_RR
        DataInfo_Inflation_Pressure_Inflation_Pressure_RR (DcmDspDataInfo): DcmDspDataFixedLength=true
        Brake_Pedal_Valve_Status_FR (DcmDspData): DcmDspDataSize=8, DcmDspDataType=UINT8, DcmDspDataUsePort=USE_DATA_ASYNCH_CLIENT_SERVER, DcmDspDataInfoRef=DataInfo_Brake_Pedal_Valve_Status_FR
        Brake_Pedal_Valve_Voltage_RR (DcmDspData): DcmDspDataSize=8, DcmDspDataType=UINT8, DcmDspDataUsePort=USE_DATA_ASYNCH_CLIENT_SERVER, DcmDspDataInfoRef=DataInfo_Brake_Pedal_Valve_Voltage_RR
        Wheel_Type (DcmDspDid): DcmDspDidIdentifier=265, DcmDspDidUsed=true, DcmDspDidUsePort=USE_DATA_ELEMENT_SPECIFIC_INTERFACES, DcmDspDidInfoRef=DidInfo_Wheel_Type
          Wheel_type (DcmDspDidSignal): DcmDspDidDataPos=0, DcmDspDidDataRef=Wheel_Type_Wheel_type
        3 x DcmDspDataInfo, all with DcmDspDataFixedLength=true:
          DataInfo_Inflation_Pressure_Inflation_Pressure_RL
          DataInfo_Service_Information_Remaining_Service_Brake_Fluid_Life
          DataInfo_Wheel_Speed_Wheel_Voltage_FL
        Wheel_Speed_Wheel_Speed_FR (DcmDspData): DcmDspDataSize=8, DcmDspDataType=UINT8, DcmDspDataUsePort=USE_DATA_ASYNCH_CLIENT_SERVER, DcmDspDataInfoRef=DataInfo_Wheel_Speed_Wheel_Speed_FR
        DidInfo_Hardware_Supplier_Identification (DcmDspDidInfo)
          DcmDspDidAccess
            DcmDspDidWrite
            DcmDspDidRead
        Hardware_Supplier_Identification (DcmDspDid):
          DcmDspDidIdentifier = 61842
          DcmDspDidUsed = true
          DcmDspDidUsePort = USE_DATA_ELEMENT_SPECIFIC_INTERFACES
          DcmDspDidInfoRef = DidInfo_Hardware_Supplier_Identification
          HardwareSupplier (DcmDspDidSignal): DcmDspDidDataPos=0, DcmDspDidDataRef=Hardware_Supplier_Identification_HardwareSupplier
        Brake_Pedal_Valve_Voltage_RL (DcmDspData): DcmDspDataSize=8, DcmDspDataType=UINT8, DcmDspDataUsePort=USE_DATA_ASYNCH_CLIENT_SERVER, DcmDspDataInfoRef=DataInfo_Brake_Pedal_Valve_Voltage_RL
        VIN_VIN (DcmDspData): DcmDspDataSize=136, DcmDspDataType=UINT8_N, DcmDspDataUsePort=USE_DATA_ASYNCH_CLIENT_SERVER, DcmDspDataInfoRef=DataInfo_VIN_VIN
        3 x DcmDspDataInfo, all with DcmDspDataFixedLength=true:
          DataInfo_Brake_Pedal_Valve_Voltage_FR
          DataInfo_Brake_Pedal_Valve_Voltage_FL
          DataInfo_Switches_Brake_Switch
        3 x DcmDspData, all with DcmDspDataSize=8, DcmDspDataType=UINT8, DcmDspDataUsePort=USE_DATA_ASYNCH_CLIENT_SERVER:
          Wheel_Speed_Wheel_Voltage_RL: DcmDspDataInfoRef=DataInfo_Wheel_Speed_Wheel_Voltage_RL
          Brake_Pedal_Valve_Status_FL: DcmDspDataInfoRef=DataInfo_Brake_Pedal_Valve_Status_FL
          Wheel_Speed_Wheel_Voltage_RR: DcmDspDataInfoRef=DataInfo_Wheel_Speed_Wheel_Voltage_RR
        DidInfo_Inflation_Pressure (DcmDspDidInfo)
          DcmDspDidAccess
            DcmDspDidRead
        Braking_Valve_Status_FR (DcmDspData): DcmDspDataSize=8, DcmDspDataType=UINT8, DcmDspDataUsePort=USE_DATA_ASYNCH_CLIENT_SERVER, DcmDspDataInfoRef=DataInfo_Braking_Valve_Status_FR
        DataInfo_Hydro_Unit_Valve_Voltage_FR (DcmDspDataInfo): DcmDspDataFixedLength=true
        Braking_Brake_Pressure (DcmDspData): DcmDspDataSize=8, DcmDspDataType=UINT8, DcmDspDataUsePort=USE_DATA_ASYNCH_CLIENT_SERVER, DcmDspDataInfoRef=DataInfo_Braking_Brake_Pressure
        Braking_Valve_Status_FL (DcmDspData): DcmDspDataSize=8, DcmDspDataType=UINT8, DcmDspDataUsePort=USE_DATA_ASYNCH_CLIENT_SERVER, DcmDspDataInfoRef=DataInfo_Braking_Valve_Status_FL
        Serial_Number (DcmDspDid): DcmDspDidIdentifier=61836, DcmDspDidUsed=true, DcmDspDidUsePort=USE_DATA_ELEMENT_SPECIFIC_INTERFACES, DcmDspDidInfoRef=DidInfo_Serial_Number
          SerialNumber (DcmDspDidSignal): DcmDspDidDataPos=0, DcmDspDidDataRef=Serial_Number_SerialNumber
        4 x DcmDspDataInfo, all with DcmDspDataFixedLength=true:
          DataInfo_Braking_Valve_Status_RL
          DataInfo_Supply_Voltage_ECU_Voltage_ECU
          DataInfo_Service_Information_Remaining_Service_Time_Left
          DataInfo_Braking_Valve_Status_RR
        Switches_Parking_Brake_Switch (DcmDspData):
          DcmDspDataConditionCheckReadFncUsed = false
          DcmDspDataSize = 8
          DcmDspDataType = UINT8
          DcmDspDataUsePort = USE_DATA_ASYNCH_CLIENT_SERVER
          DcmDspDataInfoRef = DataInfo_Switches_Parking_Brake_Switch
        Service_Information_Remaining_Service_Brake_Fluid_Life (DcmDspData):
          DcmDspDataSize = 8
          DcmDspDataType = UINT8
          DcmDspDataUsePort = USE_DATA_ASYNCH_CLIENT_SERVER
          DcmDspDataInfoRef = DataInfo_Service_Information_Remaining_Service_Brake_Fluid_Life
        VIN (DcmDspDid): DcmDspDidIdentifier=61840, DcmDspDidUsed=true, DcmDspDidUsePort=USE_DATA_ELEMENT_SPECIFIC_INTERFACES, DcmDspDidInfoRef=DidInfo_VIN
          VIN (DcmDspDidSignal): DcmDspDidDataPos=0, DcmDspDidDataRef=VIN_VIN
        Supply_Voltage_ECU_Voltage_ECU (DcmDspData): DcmDspDataSize=8, DcmDspDataType=UINT8, DcmDspDataUsePort=USE_DATA_ASYNCH_CLIENT_SERVER, DcmDspDataInfoRef=DataInfo_Supply_Voltage_ECU_Voltage_ECU
        Hydro_Unit_Valve_Voltage_FL (DcmDspData): DcmDspDataSize=8, DcmDspDataType=UINT8, DcmDspDataUsePort=USE_DATA_ASYNCH_CLIENT_SERVER, DcmDspDataInfoRef=DataInfo_Hydro_Unit_Valve_Voltage_FL
        DataInfo_Wheel_Speed_Wheel_Voltage_FR (DcmDspDataInfo): DcmDspDataFixedLength=true
        Wheel_Speed_Wheel_Speed_FL (DcmDspData): DcmDspDataSize=8, DcmDspDataType=UINT8, DcmDspDataUsePort=USE_DATA_ASYNCH_CLIENT_SERVER, DcmDspDataInfoRef=DataInfo_Wheel_Speed_Wheel_Speed_FL
        DataInfo_Hydro_Unit_Valve_Voltage_FL (DcmDspDataInfo): DcmDspDataFixedLength=true
        Software_Version (DcmDspDid): DcmDspDidIdentifier=61833, DcmDspDidUsed=true, DcmDspDidUsePort=USE_DATA_ELEMENT_SPECIFIC_INTERFACES, DcmDspDidInfoRef=DidInfo_Software_Version
          SoftwareVersion (DcmDspDidSignal): DcmDspDidDataPos=0, DcmDspDidDataRef=Software_Version_SoftwareVersion
        3 x DcmDspData, all with DcmDspDataUsePort=USE_DATA_ASYNCH_CLIENT_SERVER:
          Hydro_Unit_Valve_Voltage_FR: DcmDspDataSize=8, DcmDspDataType=UINT8, DcmDspDataInfoRef=DataInfo_Hydro_Unit_Valve_Voltage_FR
          Hardware_Part_Number_PartNumber: DcmDspDataSize=104, DcmDspDataType=UINT8_N, DcmDspDataInfoRef=DataInfo_Hardware_Part_Number_PartNumber
          Inflation_Pressure_Inflation_Pressure_FR: DcmDspDataSize=8, DcmDspDataType=UINT8, DcmDspDataInfoRef=DataInfo_Inflation_Pressure_Inflation_Pressure_FR
        DataInfo_Brake_Pedal_Valve_Status_FL (DcmDspDataInfo): DcmDspDataFixedLength=true
        DataInfo_Hydro_Unit_Valve_Status_RL (DcmDspDataInfo): DcmDspDataFixedLength=true
        Inflation_Pressure_Inflation_Pressure_FL (DcmDspData):
          DcmDspDataSize = 8
          DcmDspDataType = UINT8
          DcmDspDataUsePort = USE_DATA_ASYNCH_CLIENT_SERVER
          DcmDspDataInfoRef = DataInfo_Inflation_Pressure_Inflation_Pressure_FL
        DataInfo_Brake_Pedal_Valve_Status_FR (DcmDspDataInfo): DcmDspDataFixedLength=true
        Software_Version_SoftwareVersion (DcmDspData):
          DcmDspDataSize = 40
          DcmDspDataType = UINT8_N
          DcmDspDataUsePort = USE_DATA_ASYNCH_CLIENT_SERVER
          DcmDspDataInfoRef = DataInfo_Software_Version_SoftwareVersion
        4 x DcmDspDataInfo, all with DcmDspDataFixedLength=true:
          DataInfo_Hydraulic_Pump_Hydraulic_Pump_Voltage
          DataInfo_Hydro_Unit_Valve_Voltage_RL
          DataInfo_Hydro_Unit_Valve_Status_RR
          DataInfo_Fingerprint_Repair_Shop_Identification
        Brake_Pressure_Brake_Pressure (DcmDspData): DcmDspDataSize=8, DcmDspDataType=UINT8, DcmDspDataUsePort=USE_DATA_ASYNCH_CLIENT_SERVER, DcmDspDataInfoRef=DataInfo_Brake_Pressure_Brake_Pressure
        DataInfo_Switches_Rear_Gear_Switch (DcmDspDataInfo): DcmDspDataFixedLength=true
        Wheel_Speed (DcmDspDid): DcmDspDidIdentifier=266, DcmDspDidUsed=true, DcmDspDidUsePort=USE_DATA_ELEMENT_SPECIFIC_INTERFACES, DcmDspDidInfoRef=DidInfo_Wheel_Speed
          9 x DcmDspDidSignal:
            Wheel_Speed_RR: DcmDspDidDataPos=16, DcmDspDidDataRef=Wheel_Speed_Wheel_Speed_RR
            Wheel_Voltage_RR: DcmDspDidDataPos=48, DcmDspDidDataRef=Wheel_Speed_Wheel_Voltage_RR
            Wheel_Speed_FR: DcmDspDidDataPos=0, DcmDspDidDataRef=Wheel_Speed_Wheel_Speed_FR
            Wheel_Voltage_RL: DcmDspDidDataPos=56, DcmDspDidDataRef=Wheel_Speed_Wheel_Voltage_RL
            Wheel_Voltage_FR: DcmDspDidDataPos=32, DcmDspDidDataRef=Wheel_Speed_Wheel_Voltage_FR
            Direction_of_rotation: DcmDspDidDataPos=64, DcmDspDidDataRef=Wheel_Speed_Direction_of_rotation
            Wheel_Voltage_FL: DcmDspDidDataPos=40, DcmDspDidDataRef=Wheel_Speed_Wheel_Voltage_FL
            Wheel_Speed_RL: DcmDspDidDataPos=24, DcmDspDidDataRef=Wheel_Speed_Wheel_Speed_RL
            Wheel_Speed_FL: DcmDspDidDataPos=8, DcmDspDidDataRef=Wheel_Speed_Wheel_Speed_FL
        DidInfo_Brake_Pedal (DcmDspDidInfo)
          DcmDspDidAccess
            DcmDspDidRead
        DataInfo_Wheel_Speed_Wheel_Speed_FR (DcmDspDataInfo): DcmDspDataFixedLength=true
        DataInfo_Hardware_Part_Number_PartNumber (DcmDspDataInfo): DcmDspDataFixedLength=true
        Hydro_Unit_Valve_Status_FL (DcmDspData): DcmDspDataSize=8, DcmDspDataType=UINT8, DcmDspDataUsePort=USE_DATA_ASYNCH_CLIENT_SERVER, DcmDspDataInfoRef=DataInfo_Hydro_Unit_Valve_Status_FL
        DidInfo_Switches (DcmDspDidInfo)
          DcmDspDidAccess
            DcmDspDidControl:
              DcmDspDidFreezeCurrentState = false
              DcmDspDidResetToDefault = true
              DcmDspDidReturnControlToEcu = false
              DcmDspDidShortTermAdjustment = true
              DcmDspDidControlMask = DCM_CONTROLMASK_INTERNAL
              DcmDspDidControlSessionRef = DcmDspSession/Programming
              DcmDspDidControlSessionRef = DcmDspSession/Extended
            DcmDspDidRead
        3 x DcmDspDataInfo, all with DcmDspDataFixedLength=true:
          DataInfo_Fingerprint_Programming_Date
          DataInfo_Hydraulic_Pump_Hydraulic_Pump_Performance
          DataInfo_Wheel_Speed_Wheel_Speed_FL
        DidInfo_Supply_Voltage_ECU (DcmDspDidInfo)
          DcmDspDidAccess
            DcmDspDidRead
        Hydro_Unit_Valve_Status_FR (DcmDspData): DcmDspDataSize=8, DcmDspDataType=UINT8, DcmDspDataUsePort=USE_DATA_ASYNCH_CLIENT_SERVER, DcmDspDataInfoRef=DataInfo_Hydro_Unit_Valve_Status_FR
        DidInfo_Brake_Pressure (DcmDspDidInfo)
          DcmDspDidAccess
            DcmDspDidRead
        DidInfo_Hardware_Part_Number (DcmDspDidInfo)
          DcmDspDidAccess
            DcmDspDidWrite
            DcmDspDidRead
        Inflation_Pressure (DcmDspDid): DcmDspDidIdentifier=273, DcmDspDidUsed=true, DcmDspDidUsePort=USE_DATA_ELEMENT_SPECIFIC_INTERFACES, DcmDspDidInfoRef=DidInfo_Inflation_Pressure
          4 x DcmDspDidSignal:
            Inflation_Pressure_FR: DcmDspDidDataPos=0, DcmDspDidDataRef=Inflation_Pressure_Inflation_Pressure_FR
            Inflation_Pressure_RR: DcmDspDidDataPos=16, DcmDspDidDataRef=Inflation_Pressure_Inflation_Pressure_RR
            Inflation_Pressure_FL: DcmDspDidDataPos=8, DcmDspDidDataRef=Inflation_Pressure_Inflation_Pressure_FL
            Inflation_Pressure_RL: DcmDspDidDataPos=24, DcmDspDidDataRef=Inflation_Pressure_Inflation_Pressure_RL
        3 x DcmDspDataInfo, all with DcmDspDataFixedLength=true:
          DataInfo_Software_Supplier_Identification_SoftwareSupplier
          DataInfo_Hydraulic_Pump_Status_Hydraulic_Pump
          DataInfo_Wheel_Speed_Direction_of_rotation
        Hardware_Part_Number (DcmDspDid):
          DcmDspDidIdentifier = 61841
          DcmDspDidUsed = true
          DcmDspDidUsePort = USE_DATA_ELEMENT_SPECIFIC_INTERFACES
          DcmDspDidInfoRef = DidInfo_Hardware_Part_Number
          PartNumber (DcmDspDidSignal): DcmDspDidDataPos=0, DcmDspDidDataRef=Hardware_Part_Number_PartNumber
        3 x DcmDspDataInfo, all with DcmDspDataFixedLength=true:
          DataInfo_Fingerprint_Serial_number_of_flash_tool
          DataInfo_Wheel_Type_Wheel_type
          DataInfo_Wheel_Speed_Wheel_Voltage_RL
        Serial_Number_SerialNumber (DcmDspData): DcmDspDataSize=104, DcmDspDataType=UINT8_N, DcmDspDataUsePort=USE_DATA_ASYNCH_CLIENT_SERVER, DcmDspDataInfoRef=DataInfo_Serial_Number_SerialNumber
        DataInfo_Braking_Brake_Pressure (DcmDspDataInfo): DcmDspDataFixedLength=true
        Brake_Pedal_Valve_Voltage_FL (DcmDspData): DcmDspDataSize=8, DcmDspDataType=UINT8, DcmDspDataUsePort=USE_DATA_ASYNCH_CLIENT_SERVER, DcmDspDataInfoRef=DataInfo_Brake_Pedal_Valve_Voltage_FL
        Acceleration_Sensor (DcmDspDid): DcmDspDidIdentifier=267, DcmDspDidUsed=true, DcmDspDidUsePort=USE_DATA_ELEMENT_SPECIFIC_INTERFACES, DcmDspDidInfoRef=DidInfo_Acceleration_Sensor
          Voltage (DcmDspDidSignal): DcmDspDidDataPos=0, DcmDspDidDataRef=Acceleration_Sensor_Voltage
          Acceleration (DcmDspDidSignal): DcmDspDidDataPos=8, DcmDspDidDataRef=Acceleration_Sensor_Acceleration
        DataInfo_Inflation_Pressure_Inflation_Pressure_FL (DcmDspDataInfo): DcmDspDataFixedLength=true
        Fingerprint (DcmDspDid): DcmDspDidIdentifier=61848, DcmDspDidUsed=true, DcmDspDidUsePort=USE_DATA_ELEMENT_SPECIFIC_INTERFACES, DcmDspDidInfoRef=DidInfo_Fingerprint
          3 x DcmDspDidSignal:
            Repair_Shop_Identification: DcmDspDidDataPos=64, DcmDspDidDataRef=Fingerprint_Repair_Shop_Identification
            Serial_number_of_flash_tool: DcmDspDidDataPos=0, DcmDspDidDataRef=Fingerprint_Serial_number_of_flash_tool
            Programming_Date: DcmDspDidDataPos=72, DcmDspDidDataRef=Fingerprint_Programming_Date
        Hydro_Unit_Valve_Voltage_RL (DcmDspData): DcmDspDataSize=8, DcmDspDataType=UINT8, DcmDspDataUsePort=USE_DATA_ASYNCH_CLIENT_SERVER, DcmDspDataInfoRef=DataInfo_Hydro_Unit_Valve_Voltage_RL
        DataInfo_Wheel_Speed_Wheel_Voltage_RR (DcmDspDataInfo): DcmDspDataFixedLength=true
        Hydro_Unit_Valve_Voltage_RR (DcmDspData): DcmDspDataSize=8, DcmDspDataType=UINT8, DcmDspDataUsePort=USE_DATA_ASYNCH_CLIENT_SERVER, DcmDspDataInfoRef=DataInfo_Hydro_Unit_Valve_Voltage_RR
        Brake_Pedal (DcmDspDid): DcmDspDidIdentifier=269, DcmDspDidUsed=true, DcmDspDidUsePort=USE_DATA_ELEMENT_SPECIFIC_INTERFACES, DcmDspDidInfoRef=DidInfo_Brake_Pedal
          8 x DcmDspDidSignal:
            Valve_Status_RR: DcmDspDidDataPos=48, DcmDspDidDataRef=Brake_Pedal_Valve_Status_RR
            Valve_Voltage_FR: DcmDspDidDataPos=0, DcmDspDidDataRef=Brake_Pedal_Valve_Voltage_FR
            Valve_Status_FR: DcmDspDidDataPos=32, DcmDspDidDataRef=Brake_Pedal_Valve_Status_FR
            Valve_Voltage_RL: DcmDspDidDataPos=24, DcmDspDidDataRef=Brake_Pedal_Valve_Voltage_RL
            Valve_Status_RL: DcmDspDidDataPos=56, DcmDspDidDataRef=Brake_Pedal_Valve_Status_RL
            Valve_Voltage_FL: DcmDspDidDataPos=8, DcmDspDidDataRef=Brake_Pedal_Valve_Voltage_FL
            Valve_Voltage_RR: DcmDspDidDataPos=16, DcmDspDidDataRef=Brake_Pedal_Valve_Voltage_RR
            Valve_Status_FL: DcmDspDidDataPos=40, DcmDspDidDataRef=Brake_Pedal_Valve_Status_FL
        Brake_Pedal_Valve_Status_RL (DcmDspData): DcmDspDataSize=8, DcmDspDataType=UINT8, DcmDspDataUsePort=USE_DATA_ASYNCH_CLIENT_SERVER, DcmDspDataInfoRef=DataInfo_Brake_Pedal_Valve_Status_RL
        DataInfo_VIN_VIN (DcmDspDataInfo): DcmDspDataFixedLength=true
        DataInfo_Acceleration_Sensor_Voltage (DcmDspDataInfo): DcmDspDataFixedLength=true
        3 x DcmDspData, all with DcmDspDataSize=8, DcmDspDataType=UINT8, DcmDspDataUsePort=USE_DATA_ASYNCH_CLIENT_SERVER:
          Wheel_Speed_Direction_of_rotation: DcmDspDataInfoRef=DataInfo_Wheel_Speed_Direction_of_rotation
          Hydraulic_Pump_Hydraulic_Pump_Performance: DcmDspDataInfoRef=DataInfo_Hydraulic_Pump_Hydraulic_Pump_Performance
          Brake_Pedal_Valve_Status_RR: DcmDspDataInfoRef=DataInfo_Brake_Pedal_Valve_Status_RR
        DataInfo_Braking_Status_Hydraulic_Pump (DcmDspDataInfo): DcmDspDataFixedLength=true
        DidInfo_Software_Supplier_Identification (DcmDspDidInfo)
          DcmDspDidAccess
            DcmDspDidWrite
            DcmDspDidRead
        Software_Supplier_Identification (DcmDspDid):
          DcmDspDidIdentifier = 61844
          DcmDspDidUsed = true
          DcmDspDidUsePort = USE_DATA_ELEMENT_SPECIFIC_INTERFACES
          DcmDspDidInfoRef = DidInfo_Software_Supplier_Identification
          SoftwareSupplier (DcmDspDidSignal): DcmDspDidDataPos=0, DcmDspDidDataRef=Software_Supplier_Identification_SoftwareSupplier
        Brake_Pedal_Valve_Voltage_FR (DcmDspData): DcmDspDataSize=8, DcmDspDataType=UINT8, DcmDspDataUsePort=USE_DATA_ASYNCH_CLIENT_SERVER, DcmDspDataInfoRef=DataInfo_Brake_Pedal_Valve_Voltage_FR
        DataInfo_Brake_Pedal_Valve_Voltage_RR (DcmDspDataInfo): DcmDspDataFixedLength=true
        Brake_Pressure (DcmDspDid): DcmDspDidIdentifier=270, DcmDspDidUsed=true, DcmDspDidUsePort=USE_DATA_ELEMENT_SPECIFIC_INTERFACES, DcmDspDidInfoRef=DidInfo_Brake_Pressure
          Brake_Pressure (DcmDspDidSignal): DcmDspDidDataPos=0, DcmDspDidDataRef=Brake_Pressure_Brake_Pressure
        3 x DcmDspData, all with DcmDspDataSize=8, DcmDspDataType=UINT8, DcmDspDataUsePort=USE_DATA_ASYNCH_CLIENT_SERVER:
          Wheel_Type_Wheel_type: DcmDspDataInfoRef=DataInfo_Wheel_Type_Wheel_type
          Wheel_Speed_Wheel_Speed_RL: DcmDspDataInfoRef=DataInfo_Wheel_Speed_Wheel_Speed_RL
          Braking_Status_Hydraulic_Pump: DcmDspDataInfoRef=DataInfo_Braking_Status_Hydraulic_Pump
        DataInfo_Brake_Pedal_Valve_Voltage_RL (DcmDspDataInfo): DcmDspDataFixedLength=true
        Wheel_Speed_Wheel_Voltage_FL (DcmDspData): DcmDspDataSize=8, DcmDspDataType=UINT8, DcmDspDataUsePort=USE_DATA_ASYNCH_CLIENT_SERVER, DcmDspDataInfoRef=DataInfo_Wheel_Speed_Wheel_Voltage_FL
        DidInfo_Wheel_Speed (DcmDspDidInfo)
          DcmDspDidAccess
            DcmDspDidRead
        DataInfo_Brake_Pressure_Brake_Pressure (DcmDspDataInfo): DcmDspDataFixedLength=true
        Wheel_Speed_Wheel_Voltage_FR (DcmDspData): DcmDspDataSize=8, DcmDspDataType=UINT8, DcmDspDataUsePort=USE_DATA_ASYNCH_CLIENT_SERVER, DcmDspDataInfoRef=DataInfo_Wheel_Speed_Wheel_Voltage_FR
        Supply_Voltage_ECU (DcmDspDid): DcmDspDidIdentifier=263, DcmDspDidUsed=true, DcmDspDidUsePort=USE_DATA_ELEMENT_SPECIFIC_INTERFACES, DcmDspDidInfoRef=DidInfo_Supply_Voltage_ECU
          Voltage_ECU (DcmDspDidSignal): DcmDspDidDataPos=0, DcmDspDidDataRef=Supply_Voltage_ECU_Voltage_ECU
        Fingerprint_Repair_Shop_Identification (DcmDspData):
          DcmDspDataSize = 8
          DcmDspDataType = UINT8
          DcmDspDataUsePort = USE_DATA_ASYNCH_CLIENT_SERVER
          DcmDspDataInfoRef = DataInfo_Fingerprint_Repair_Shop_Identification
        DataInfo_Hardware_Supplier_Identification_HardwareSupplier (DcmDspDataInfo): DcmDspDataFixedLength=true
        3 x DcmDspData, all with DcmDspDataSize=8, DcmDspDataType=UINT8, DcmDspDataUsePort=USE_DATA_ASYNCH_CLIENT_SERVER:
          Braking_Valve_Status_RL: DcmDspDataInfoRef=DataInfo_Braking_Valve_Status_RL
          Inflation_Pressure_Inflation_Pressure_RR: DcmDspDataInfoRef=DataInfo_Inflation_Pressure_Inflation_Pressure_RR
          Switches_Brake_Switch: DcmDspDataConditionCheckReadFncUsed=false, DcmDspDataInfoRef=DataInfo_Switches_Brake_Switch
        4 x DcmDspDataInfo, all with DcmDspDataFixedLength=true:
          DataInfo_Braking_Valve_Status_FL
          DataInfo_Hydro_Unit_Valve_Voltage_RR
          DataInfo_Software_Version_SoftwareVersion
          DataInfo_Acceleration_Sensor_Acceleration
        Wheel_Speed_Wheel_Speed_RR (DcmDspData): DcmDspDataSize=8, DcmDspDataType=UINT8, DcmDspDataUsePort=USE_DATA_ASYNCH_CLIENT_SERVER, DcmDspDataInfoRef=DataInfo_Wheel_Speed_Wheel_Speed_RR
        DataInfo_Braking_Valve_Status_FR (DcmDspDataInfo): DcmDspDataFixedLength=true
        Switches_Rear_Gear_Switch (DcmDspData):
          DcmDspDataConditionCheckReadFncUsed = false
          DcmDspDataSize = 8
          DcmDspDataType = UINT8
          DcmDspDataUsePort = USE_DATA_ASYNCH_CLIENT_SERVER
          DcmDspDataInfoRef = DataInfo_Switches_Rear_Gear_Switch
        Braking_Valve_Status_RR (DcmDspData): DcmDspDataSize=8, DcmDspDataType=UINT8, DcmDspDataUsePort=USE_DATA_ASYNCH_CLIENT_SERVER, DcmDspDataInfoRef=DataInfo_Braking_Valve_Status_RR
        DidInfo_Hydro_Unit (DcmDspDidInfo)
          DcmDspDidAccess
            DcmDspDidRead
        DidInfo_Wheel_Type (DcmDspDidInfo)
          DcmDspDidAccess
            DcmDspDidWrite
            DcmDspDidRead
        Inflation_Pressure_Inflation_Pressure_RL (DcmDspData):
          DcmDspDataSize = 8
          DcmDspDataType = UINT8
          DcmDspDataUsePort = USE_DATA_ASYNCH_CLIENT_SERVER
          DcmDspDataInfoRef = DataInfo_Inflation_Pressure_Inflation_Pressure_RL
      DcmPageBufferCfg: DcmPagedBufferEnabled=true
