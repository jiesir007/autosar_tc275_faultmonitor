AUTOSAR XML (schema 00046)
package /Dio
  module config Dio: implementation-config-variant=VARIANT-POST-BUILD-LOADABLE, module-description=Dio_Impl
    DioConfig_0 (DioConfig)
      5 x DioPort:
        DioPort_0: DioPortId=0
        DioPort_14: DioPortId=14
          3 x DioChannel:
            Button3: DioChannelId=7
            Button4: DioChannelId=8
            TJA1043_RXD: DioChannelId=1
        DioPort_15: DioPortId=15
          9 x DioChannel:
            Button1: DioChannelId=4
            Button2: DioChannelId=5
            LED1: DioChannelId=0
            LED2: DioChannelId=1
            LED3: DioChannelId=2
            LED4: DioChannelId=3
            TJA1043_EN: DioChannelId=7
            TJA1043_ERR: DioChannelId=6
            TJA1043_STB: DioChannelId=8
        DioPort_20: DioPortId=20
          DioChannel_CAN0_NEN (DioChannel): DioChannelId=6
          DioChannel_CAN0_RXD (DioChannel): DioChannelId=7
        DioPort_33: DioPortId=33
          KL15 (DioChannel): DioChannelId=0
    DioGeneral:
      DioDevErrorDetect = false
      DioFlipChannelApi = true
      DioPBFixedAddress = false
      DioRunningInUser0Mode = false
      DioUserModeInitApiEnable = false
      DioUserModeRuntimeApiEnable = false
      DioVersionInfoApi = false
    DioSafety: DioInitCheckApi=false, DioSafetyEnable=false
    CommonPublishedInformation:
      ArMajorVersion = 2
      ArMinorVersion = 5
      ArPatchVersion = 0
      ModuleId = 120
      Release = _TRICORE_TC275
      SwMajorVersion = 3
      SwMinorVersion = 3
      SwPatchVersion = 0
      VendorId = 17
