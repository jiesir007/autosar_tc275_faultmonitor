AUTOSAR XML (schema 00046)
package /ActiveEcuC
  module config CanNm: implementation-config-variant=VARIANT-PRE-COMPILE, module-description=CanNm_Impl
    CanNmGlobalConfig:
      CanNmBusSynchronizationEnabled = false
      CanNmPassiveModeEnabled = false
      CanNmPnEiraCalcEnabled = false
      CanNmRemoteSleepIndEnabled = false
      CanNmUserDataEnabled = true
      CanNmBusLoadReductionEnabled = false
      CanNmComUserDataSupport = false
      CanNmCoordinatorSyncSupport = false
      CanNmDevErrorDetect = false
      CanNmImmediateTxconfEnabled = false
      CanNmMainFunctionPeriod = 0.005
      CanNmPduRxIndicationEnabled = false
      CanNmStateChangeIndEnabled = true
      CanNmVersionInfoApi = false
      CanNmDisableTxErrReport = false
      CanNmApiOptimization = false
      CanNmCanIfRangeConfigDLCCheck = true
      CanNmRuntimeMeasurementSupport = false
      CanNmSafeBswChecks = false
      CanNmNodeDetectionEnabled = true
      CanNmGeneration: CanNmOutOfBoundsWriteSanitizer=false, CanNmOutOfBoundsReadSanitizer=false, CanNmInterfacesForDeactivatedData=false
      DBCNetWork_CAN_9b3bc41d (CanNmChannelConfig):
        CanNmNodeId = 1
        CanNmTimeoutTime = 2
        CanNmUserDataLength = 6
        CanNmWaitBusSleepTime = 2
        CanNmBusLoadReductionActive = false
        CanNmCarWakeUpRxEnabled = false
        CanNmImmediateNmTransmissions = 5
        CanNmMsgCycleOffset = 0
        CanNmMsgCycleTime = 0.5
        CanNmMsgReducedTime = 0.08
        CanNmMsgTimeoutTime = 0.06
        CanNmPduCbvPosition = CANNM_PDU_BYTE_1
        CanNmPduNidPosition = CANNM_PDU_BYTE_0
        CanNmRemoteSleepIndTime = 0.5
        CanNmRepeatMessageTime = 1.6
        CanNmActiveWakeupBitEnabled = true
        CanNmNodeIdEnabled = true
        CanNmNodeDetectionEnabled = true
        CanNmRepeatMsgIndEnabled = false
        CanNmImmediateRestartEnabled = false
        CanNmComControlEnabled = false
        CanNmCriBitAlwaysEnabled = false
        CanNmImmediateNmCycleTime = 0.02
        CanNmComMNetworkHandleRef = CN_DBCNetWork_05d62413
        DBCNetWork_CAN_9b3bc41d_Rx (CanNmRxPdu): CanNmRxPduId=0, CanNmRxPduRef=XB_SUP_F_7e0db49d_Rx
        Meg_NmTx_oDBCNetWork_5d9e34f5_Tx (CanNmTxPdu): CanNmTxConfirmationPduId=0, CanNmTxPduRef=Meg_NmTx_oDBCNetWork_5d9e34f5_Tx
