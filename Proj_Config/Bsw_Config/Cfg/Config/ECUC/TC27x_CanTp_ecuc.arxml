AUTOSAR XML (schema 00046)
package /ActiveEcuC
  module config CanTp: implementation-config-variant=VARIANT-PRE-COMPILE, module-description=CanTp_Impl
    CanTpGeneral:
      CanTpChangeParameterApi = false
      CanTpDevErrorDetect = false
      CanTpPaddingByte = 255
      CanTpReadParameterApi = false
      CanTpVersionInfoApi = false
      CanTpPaddingActive = true
      CanTpHavePaddingByte = true
      CanTpNumRxChannels = 0
      CanTpNumTxChannels = 0
      CanTpEnableSplitMainFunction = false
      CanTpSupportStandardAddressing = true
      CanTpSupportExtendedAddressing = true
      CanTpSupportMixed11Addressing = true
      CanTpSupportMixed29Addressing = true
      CanTpSupportNormalFixedAddressing = true
      CanTpOnlyNotifyInformedAppl = true
      CanTpRc = false
      CanTpTc = false
      CanTpSafeBswChecks = false
      CanTpEnableConstantBS = true
      CanTpEnableTransmitQueue = false
      CanTpUseOnlyFirstFc = true
      CanTpEnableSynchronousTransmit = true
    CanTpConfig: CanTpMainFunctionPeriod=0.005
      TPCH_931c9575 (CanTpChannel): CanTpChannelMode=CANTP_MODE_FULL_DUPLEX
        CanTpRxNSdu_f9627aff (CanTpRxNSdu):
          CanTpRxAddressingFormat = CANTP_STANDARD
          CanTpRxDl = 8
          CanTpRxTaType = CANTP_FUNCTIONAL
          CanTpNbr = 0.1
          CanTpRxNSduId = 0
          CanTpRxPaddingActivation = CANTP_ON
          CanTpRxNSduRef = Meg_FunDiag_oDBCNetWork_245e23dc_Rx
          CanTpRxNPdu_d5fea8ba (CanTpRxNPdu): CanTpRxNPduId=1, CanTpRxNPduRef=Meg_FunDiag_Tp_oDBCNetWork_1b821788_Rx
      TPCH_a9c0396d (CanTpChannel): CanTpChannelMode=CANTP_MODE_FULL_DUPLEX
        CanTpRxNSdu_86f49806 (CanTpRxNSdu):
          CanTpRxAddressingFormat = CANTP_STANDARD
          CanTpRxDl = 8
          CanTpRxTaType = CANTP_PHYSICAL
          CanTpNbr = 0.1
          CanTpRxNSduId = 1
          CanTpRxPaddingActivation = CANTP_ON
          CanTpBs = 8
          CanTpNar = 0.025
          CanTpNcr = 0.025
          CanTpRxWftMax = 1
          CanTpSTmin = 0.02
          CanTpRxNSduRef = Meg_PhyDiag_oDBCNetWork_e94a8f4d_Rx
          CanTpTxFcNPdu_e1197e80 (CanTpTxFcNPdu): CanTpTxFcNPduConfirmationPduId=0, CanTpTxFcNPduRef=Meg_ResDiag_Tp_oDBCNetWork_4a610c1c_Tx
          CanTpRxNPdu_e1197e80 (CanTpRxNPdu): CanTpRxNPduId=0, CanTpRxNPduRef=Meg_PhyDiag_Tp_oDBCNetWork_ff3be21a_Rx
        CanTpTxNSdu_86f49806 (CanTpTxNSdu):
          CanTpTxAddressingFormat = CANTP_STANDARD
          CanTpTxDl = 8
          CanTpTxTaType = CANTP_PHYSICAL
          CanTpNas = 0.1
          CanTpNcs = 0.2
          CanTpTc = false
          CanTpTxNSduId = 0
          CanTpTxPaddingActivation = CANTP_ON
          CanTpNbs = 0.025
          CanTpTxNSduRef = Meg_ResDiag_oDBCNetWork_1336e721_Tx
          CanTpRxFcNPdu_c3e3aa72 (CanTpRxFcNPdu): CanTpRxFcNPduId=0, CanTpRxFcNPduRef=Meg_PhyDiag_Tp_oDBCNetWork_ff3be21a_Rx
          CanTpTxNPdu_c3e3aa72 (CanTpTxNPdu): CanTpTxNPduConfirmationPduId=0, CanTpTxNPduRef=Meg_ResDiag_Tp_oDBCNetWork_4a610c1c_Tx
