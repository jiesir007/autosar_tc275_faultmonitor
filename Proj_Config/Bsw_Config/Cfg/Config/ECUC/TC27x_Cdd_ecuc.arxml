AUTOSAR XML (schema 00046)
package /ActiveEcuC
  module config Cdd: implementation-config-variant=VARIANT-PRE-COMPILE, module-description=Cdd_Impl
    CddComStackContribution
      CddComIfUpperLayerContribution
        CddComIfUpperLayerRxPdu: CddComIfHandleId=0, CddComIfPduRef=INTER_RECEIVE_oDBCNetWork_INTER1_12d35b51_Rx
        CddComIfUpperLayerTxPdu: CddComIfHandleId=0, CddComIfPduRef=INTER_SEND_oDBCNetWork_INTER1_c9dc7871_Tx
