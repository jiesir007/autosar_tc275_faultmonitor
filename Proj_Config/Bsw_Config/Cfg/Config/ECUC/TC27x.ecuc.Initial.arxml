AUTOSAR XML (schema 00046)
package /InitialEcuC
  ecuc value collection InitialEcuC: ecuc-values=[Can, CanIf, CanNm, CanSM, CanTp, Com, ComM, Dcm, Dem, EcuC, EcuM, Nm, PduR]
  module config Can
    CanConfigSet
      CT_DBCNetWork_INTER1_f93f8858 (CanController):
        CanControllerActivation = true
        CanControllerDefaultBaudrate = CT_DBCNetWork_INTER1_f93f8858/CanControllerBaudrateConfig
        CanControllerSystemRef = CT_DBCNetWork_INTER1
        CanWakeupSourceRef = EcuMCommonConfiguration/CN_DBCNetWork_INTER1_9768a826
        CanControllerBaudrateConfig: CanControllerBaudRate=500
      CT_DBCNetWork_e3f9218e (CanController):
        CanControllerActivation = true
        CanControllerDefaultBaudrate = CT_DBCNetWork_e3f9218e/CanControllerBaudrateConfig
        CanControllerSystemRef = CT_DBCNetWork
        CanWakeupSourceRef = EcuMCommonConfiguration/CN_DBCNetWork_05d62413
        CanControllerBaudrateConfig: CanControllerBaudRate=500
      4 x CanHardwareObject, all with CanHandleType=BASIC, CanIdValue=0:
        CN_DBCNetWork_05d62413_Tx: CanObjectType=TRANSMIT, CanControllerRef=CanConfigSet/CT_DBCNetWork_e3f9218e
        CN_DBCNetWork_88abbb7f_Rx: CanIdType=STANDARD, CanObjectType=RECEIVE, CanControllerRef=CanConfigSet/CT_DBCNetWork_e3f9218e
        CN_DBCNetWork_INTER1_9768a826_Tx: CanObjectType=TRANSMIT, CanControllerRef=CanConfigSet/CT_DBCNetWork_INTER1_f93f8858
        CN_DBCNetWork_INTER1_c87d2dc2_Rx: CanIdType=STANDARD, CanObjectType=RECEIVE, CanControllerRef=CanConfigSet/CT_DBCNetWork_INTER1_f93f8858
    CanGeneral: CanIndex=0
  module config CanIf
    CanIfCtrlDrvCfg_7d254554 (CanIfCtrlDrvCfg): CanIfCtrlDrvInitHohConfigRef=CanIfInitHohCfg, CanIfCtrlDrvNameRef=CanGeneral
      CT_DBCNetWork_INTER1_f93f8858 (CanIfCtrlCfg): CanIfCtrlCanCtrlRef=CanConfigSet/CT_DBCNetWork_INTER1_f93f8858
      CT_DBCNetWork_e3f9218e (CanIfCtrlCfg): CanIfCtrlCanCtrlRef=CanConfigSet/CT_DBCNetWork_e3f9218e
    CanIfInitCfg
      CHNL_50204034 (CanIfBufferCfg): CanIfBufferSize=0, CanIfBufferHthRef=CanIfInitHohCfg/CN_DBCNetWork_05d62413_Tx
      CHNL_f7cbdede (CanIfBufferCfg): CanIfBufferSize=0, CanIfBufferHthRef=CanIfInitHohCfg/CN_DBCNetWork_INTER1_9768a826_Tx
      CanIfInitHohCfg: CanIfInitRefCfgSet=CanConfigSet
        CN_DBCNetWork_88abbb7f_Rx (CanIfHrhCfg): CanIfHrhCanCtrlIdRef=CanIfCtrlDrvCfg_7d254554/CT_DBCNetWork_e3f9218e, CanIfHrhIdSymRef=CanConfigSet/CN_DBCNetWork_88abbb7f_Rx
        CN_DBCNetWork_INTER1_c87d2dc2_Rx (CanIfHrhCfg): CanIfHrhCanCtrlIdRef=CanIfCtrlDrvCfg_7d254554/CT_DBCNetWork_INTER1_f93f8858, CanIfHrhIdSymRef=CanConfigSet/CN_DBCNetWork_INTER1_c87d2dc2_Rx
        CN_DBCNetWork_05d62413_Tx (CanIfHthCfg): CanIfHthCanCtrlIdRef=CanIfCtrlDrvCfg_7d254554/CT_DBCNetWork_e3f9218e, CanIfHthIdSymRef=CanConfigSet/CN_DBCNetWork_05d62413_Tx
        CN_DBCNetWork_INTER1_9768a826_Tx (CanIfHthCfg): CanIfHthCanCtrlIdRef=CanIfCtrlDrvCfg_7d254554/CT_DBCNetWork_INTER1_f93f8858, CanIfHthIdSymRef=CanConfigSet/CN_DBCNetWork_INTER1_9768a826_Tx
      8 x CanIfRxPduCfg, all with CanIfRxPduCanIdType=STANDARD_CAN, CanIfRxPduDlc=8:
        INTER_RECEIVE_oDBCNetWork_INTER1_e9ebf6ca_Rx: CanIfRxPduCanId=512, CanIfRxPduHrhIdRef=CanIfInitHohCfg/CN_DBCNetWork_INTER1_c87d2dc2_Rx, CanIfRxPduRef=INTER_RECEIVE_oDBCNetWork_INTER1_12d35b51_Rx
        Meg_FunDiag_Tp_oDBCNetWork_c3b25a60_Rx: CanIfRxPduCanId=2015, CanIfRxPduUserRxIndicationName=CanTp_RxIndication, CanIfRxPduUserRxIndicationType=PDUID_PDUINFOPTR, CanIfRxPduUserRxIndicationUL=CAN_TP, CanIfRxPduHrhIdRef=CanIfInitHohCfg/CN_DBCNetWork_88abbb7f_Rx, CanIfRxPduRef=Meg_FunDiag_Tp_oDBCNetWork_1b821788_Rx
        Meg_PhyDiag_Tp_oDBCNetWork_a8746177_Rx: CanIfRxPduCanId=1793, CanIfRxPduUserRxIndicationName=CanTp_RxIndication, CanIfRxPduUserRxIndicationType=PDUID_PDUINFOPTR, CanIfRxPduUserRxIndicationUL=CAN_TP, CanIfRxPduHrhIdRef=CanIfInitHohCfg/CN_DBCNetWork_88abbb7f_Rx, CanIfRxPduRef=Meg_PhyDiag_Tp_oDBCNetWork_ff3be21a_Rx
        SupD_Button_Control_oDBCNetWork_756613f9_Rx: CanIfRxPduCanId=769, CanIfRxPduDataChecksumPdu=false, CanIfRxPduUserRxIndicationName=PduR_CanIfRxIndication, CanIfRxPduUserRxIndicationUL=PDUR, CanIfRxPduHrhIdRef=CanIfInitHohCfg/CN_DBCNetWork_88abbb7f_Rx, CanIfRxPduRef=EcucPduCollection/SupD_Button_Control_oDBCNetWork_2fe6ff3f_Rx
        SupD_Led_Control_oDBCNetWork_060f240d_Rx: CanIfRxPduCanId=768, CanIfRxPduDataChecksumPdu=false, CanIfRxPduUserRxIndicationName=PduR_CanIfRxIndication, CanIfRxPduUserRxIndicationUL=PDUR, CanIfRxPduHrhIdRef=CanIfInitHohCfg/CN_DBCNetWork_88abbb7f_Rx, CanIfRxPduRef=EcucPduCollection/SupD_Led_Control_oDBCNetWork_36fcc7ec_Rx
        SupD_Led_CtrlMode_oDBCNetWork_fed16f5e_Rx: CanIfRxPduCanId=772, CanIfRxPduDataChecksumPdu=false, CanIfRxPduUserRxIndicationName=PduR_CanIfRxIndication, CanIfRxPduUserRxIndicationUL=PDUR, CanIfRxPduHrhIdRef=CanIfInitHohCfg/CN_DBCNetWork_88abbb7f_Rx, CanIfRxPduRef=EcucPduCollection/SupD_Led_CtrlMode_oDBCNetWork_8feda945_Rx
        SupE_Function_1_oDBCNetWork_3b86b9e4_Rx: CanIfRxPduCanId=770, CanIfRxPduDataChecksumPdu=false, CanIfRxPduUserRxIndicationName=PduR_CanIfRxIndication, CanIfRxPduUserRxIndicationUL=PDUR, CanIfRxPduHrhIdRef=CanIfInitHohCfg/CN_DBCNetWork_88abbb7f_Rx, CanIfRxPduRef=EcucPduCollection/SupE_Function_1_oDBCNetWork_b8177f3a_Rx
        XB_SUP_F_32c7cbd9_Rx: CanIfRxPduUserRxIndicationName=CanNm_RxIndication, CanIfRxPduUserRxIndicationUL=CAN_NM, CanIfRxPduHrhIdRef=CanIfInitHohCfg/CN_DBCNetWork_88abbb7f_Rx, CanIfRxPduRef=XB_SUP_F_7e0db49d_Rx
          CHNL_600db530 (CanIfRxPduCanIdRange): CanIfRxPduCanIdRangeLowerCanId=1536, CanIfRxPduCanIdRangeUpperCanId=1791
      9 x CanIfTxPduCfg, all with CanIfTxPduCanIdType=STANDARD_CAN, CanIfTxPduDlc=8:
        INTER_SEND_oDBCNetWork_INTER1_c4764d88_Tx: CanIfTxPduCanId=256, CanIfTxPduBufferRef=CanIfInitCfg/CHNL_f7cbdede, CanIfTxPduRef=INTER_SEND_oDBCNetWork_INTER1_c9dc7871_Tx
        Meg_NmTx_oDBCNetWork_c0e25960_Tx: CanIfTxPduCanId=1537, CanIfTxPduUserTxConfirmationName=CanNm_TxConfirmation, CanIfTxPduUserTxConfirmationUL=CAN_NM, CanIfTxPduBufferRef=CanIfInitCfg/CHNL_50204034, CanIfTxPduRef=EcucPduCollection/Meg_NmTx_oDBCNetWork_5d9e34f5_Tx
        Meg_ResDiag_Tp_oDBCNetWork_d97dd71a_Tx: CanIfTxPduCanId=1873, CanIfTxPduUserTxConfirmationName=CanTp_TxConfirmation, CanIfTxPduUserTxConfirmationUL=CAN_TP, CanIfTxPduBufferRef=CanIfInitCfg/CHNL_50204034, CanIfTxPduRef=Meg_ResDiag_Tp_oDBCNetWork_4a610c1c_Tx
        SupF_Angle_oDBCNetWork_60dbbe7b_Tx: CanIfTxPduCanId=531, CanIfTxPduDataChecksumPdu=false, CanIfTxPduUserTxConfirmationName=PduR_CanIfTxConfirmation, CanIfTxPduUserTxConfirmationUL=PDUR, CanIfTxPduBufferRef=CanIfInitCfg/CHNL_50204034, CanIfTxPduRef=EcucPduCollection/SupF_Angle_oDBCNetWork_73452188_Tx
        SupF_Button_State_oDBCNetWork_57b80545_Tx: CanIfTxPduCanId=529, CanIfTxPduDataChecksumPdu=false, CanIfTxPduUserTxConfirmationName=PduR_CanIfTxConfirmation, CanIfTxPduUserTxConfirmationUL=PDUR, CanIfTxPduBufferRef=CanIfInitCfg/CHNL_50204034, CanIfTxPduRef=EcucPduCollection/SupF_Button_State_oDBCNetWork_4aab92e3_Tx
        SupF_ComError_oDBCNetWork_bd5132c4_Tx: CanIfTxPduCanId=534, CanIfTxPduDataChecksumPdu=false, CanIfTxPduUserTxConfirmationName=PduR_CanIfTxConfirmation, CanIfTxPduUserTxConfirmationUL=PDUR, CanIfTxPduBufferRef=CanIfInitCfg/CHNL_50204034, CanIfTxPduRef=EcucPduCollection/SupF_ComError_oDBCNetWork_d2a44cd7_Tx
        SupF_Function_1_oDBCNetWork_e35ec372_Tx: CanIfTxPduCanId=532, CanIfTxPduDataChecksumPdu=false, CanIfTxPduUserTxConfirmationName=PduR_CanIfTxConfirmation, CanIfTxPduUserTxConfirmationUL=PDUR, CanIfTxPduBufferRef=CanIfInitCfg/CHNL_50204034, CanIfTxPduRef=EcucPduCollection/SupF_Function_1_oDBCNetWork_c66f379c_Tx
        SupF_Led_State_oDBCNetWork_fa0e29c4_Tx: CanIfTxPduCanId=528, CanIfTxPduDataChecksumPdu=false, CanIfTxPduUserTxConfirmationName=PduR_CanIfTxConfirmation, CanIfTxPduUserTxConfirmationUL=PDUR, CanIfTxPduBufferRef=CanIfInitCfg/CHNL_50204034, CanIfTxPduRef=EcucPduCollection/SupF_Led_State_oDBCNetWork_e9fc4e73_Tx
        SupF_PowerMode_oDBCNetWork_d7c50fc1_Tx: CanIfTxPduCanId=530, CanIfTxPduDataChecksumPdu=false, CanIfTxPduUserTxConfirmationName=PduR_CanIfTxConfirmation, CanIfTxPduUserTxConfirmationUL=PDUR, CanIfTxPduBufferRef=CanIfInitCfg/CHNL_50204034, CanIfTxPduRef=EcucPduCollection/SupF_PowerMode_oDBCNetWork_9f0609f7_Tx
    CanIfPrivateCfg: CanIfPrivateSoftwareFilterType=LINEAR
    CanIfPublicCfg: CanIfPublicPnSupport=false
  module config CanNm
    CanNmGlobalConfig:
      CanNmBusSynchronizationEnabled = false
      CanNmPassiveModeEnabled = true
      CanNmPnEiraCalcEnabled = false
      CanNmRemoteSleepIndEnabled = false
      CanNmUserDataEnabled = true
      DBCNetWork_CAN_9b3bc41d (CanNmChannelConfig): CanNmNodeId=1, CanNmTimeoutTime=2, CanNmUserDataLength=6, CanNmWaitBusSleepTime=2, CanNmComMNetworkHandleRef=ComMConfigSet/CN_DBCNetWork_05d62413
        DBCNetWork_CAN_9b3bc41d_Rx (CanNmRxPdu): CanNmRxPduRef=XB_SUP_F_7e0db49d_Rx
        Meg_NmTx_oDBCNetWork_5d9e34f5_Tx (CanNmTxPdu): CanNmTxPduRef=EcucPduCollection/Meg_NmTx_oDBCNetWork_5d9e34f5_Tx
      DBCNetWork_INTER1_CAN_daccbfb1 (CanNmChannelConfig):
        CanNmNodeId = 1
        CanNmTimeoutTime = 2
        CanNmUserDataLength = 6
        CanNmWaitBusSleepTime = 2
        CanNmComMNetworkHandleRef = ComMConfigSet/CN_DBCNetWork_INTER1_9768a826
        DBCNetWork_INTER1_CAN_daccbfb1_Rx (CanNmRxPdu)
  module config CanSM
    CanSMConfiguration
      CHNL_50204034 (CanSMManagerNetwork): CanSMComMNetworkHandleRef=ComMConfigSet/CN_DBCNetWork_05d62413
        CT_DBCNetWork_2c015711 (CanSMController): CanSMControllerId=CanIfCtrlDrvCfg_7d254554/CT_DBCNetWork_e3f9218e
      CHNL_f7cbdede (CanSMManagerNetwork): CanSMComMNetworkHandleRef=ComMConfigSet/CN_DBCNetWork_INTER1_9768a826
        CT_DBCNetWork_INTER1_4c123fd4 (CanSMController): CanSMControllerId=CanIfCtrlDrvCfg_7d254554/CT_DBCNetWork_INTER1_f93f8858
  module config CanTp
    CanTpConfig: CanTpMainFunctionPeriod=0.005
      TPCH_931c9575 (CanTpChannel): CanTpChannelMode=CANTP_MODE_FULL_DUPLEX
        CanTpRxNSdu_f9627aff (CanTpRxNSdu):
          CanTpRxAddressingFormat = CANTP_STANDARD
          CanTpRxDl = 8
          CanTpRxTaType = CANTP_FUNCTIONAL
          CanTpRxNSduRef = EcucPduCollection/Meg_FunDiag_oDBCNetWork_245e23dc_Rx
          CanTpRxNPdu_d5fea8ba (CanTpRxNPdu): CanTpRxNPduRef=Meg_FunDiag_Tp_oDBCNetWork_1b821788_Rx
      TPCH_a9c0396d (CanTpChannel): CanTpChannelMode=CANTP_MODE_FULL_DUPLEX
        CanTpRxNSdu_86f49806 (CanTpRxNSdu):
          CanTpRxAddressingFormat = CANTP_STANDARD
          CanTpRxDl = 8
          CanTpRxTaType = CANTP_PHYSICAL
          CanTpRxNSduRef = EcucPduCollection/Meg_PhyDiag_oDBCNetWork_e94a8f4d_Rx
          CanTpRxNPdu_e1197e80 (CanTpRxNPdu): CanTpRxNPduRef=Meg_PhyDiag_Tp_oDBCNetWork_ff3be21a_Rx
          CanTpTxFcNPdu_e1197e80 (CanTpTxFcNPdu): CanTpTxFcNPduRef=Meg_ResDiag_Tp_oDBCNetWork_4a610c1c_Tx
        CanTpTxNSdu_86f49806 (CanTpTxNSdu):
          CanTpTxAddressingFormat = CANTP_STANDARD
          CanTpTxDl = 8
          CanTpTxTaType = CANTP_PHYSICAL
          CanTpTxNSduRef = EcucPduCollection/Meg_ResDiag_oDBCNetWork_1336e721_Tx
          CanTpRxFcNPdu_c3e3aa72 (CanTpRxFcNPdu): CanTpRxFcNPduRef=Meg_PhyDiag_Tp_oDBCNetWork_ff3be21a_Rx
          CanTpTxNPdu_c3e3aa72 (CanTpTxNPdu): CanTpTxNPduRef=Meg_ResDiag_Tp_oDBCNetWork_4a610c1c_Tx
  module config Com
    ComConfig
      10 x ComIPdu, all with ComIPduType=NORMAL:
        SupD_Button_Control_oDBCNetWork_09fc4743_Rx: ComIPduDirection=RECEIVE, ComIPduGroupRef=XB_SUP_F_oDBCNetWork_Rx_2e39ec3a, ComIPduSignalGroupRef=SG_Sig_Grp_0x301_oSupD_Button_Control_oDBCNetWork_188cbd42_Rx, ComPduIdRef=EcucPduCollection/SupD_Button_Control_oDBCNetWork_09fc4743_Rx
        SupD_Led_Control_oDBCNetWork_80cdf82b_Rx: ComIPduDirection=RECEIVE, ComIPduGroupRef=XB_SUP_F_oDBCNetWork_Rx_2e39ec3a, ComIPduSignalGroupRef=SG_Sig_Grp_0x300_oSupD_Led_Control_oDBCNetWork_89733210_Rx, ComPduIdRef=EcucPduCollection/SupD_Led_Control_oDBCNetWork_80cdf82b_Rx
        SupD_Led_CtrlMode_oDBCNetWork_a6b9686f_Rx: ComIPduDirection=RECEIVE, ComIPduGroupRef=XB_SUP_F_oDBCNetWork_Rx_2e39ec3a, ComIPduSignalGroupRef=SG_Sig_Grp_0x304_oSupD_Led_CtrlMode_oDBCNetWork_663125ab_Rx, ComPduIdRef=EcucPduCollection/SupD_Led_CtrlMode_oDBCNetWork_a6b9686f_Rx
        SupE_Function_1_oDBCNetWork_582198e2_Rx: ComIPduDirection=RECEIVE, ComIPduGroupRef=XB_SUP_F_oDBCNetWork_Rx_2e39ec3a, ComIPduSignalGroupRef=SG_Sig_Grp_0x302_oSupE_Function_1_oDBCNetWork_28664efe_Rx, ComPduIdRef=EcucPduCollection/SupE_Function_1_oDBCNetWork_582198e2_Rx
        SupF_Angle_oDBCNetWork_afae1504_Tx: ComIPduDirection=SEND, ComIPduGroupRef=XB_SUP_F_oDBCNetWork_Tx_78634bbc, ComIPduSignalGroupRef=SG_Sig_Grp_0x213_oSupF_Angle_oDBCNetWork_3c68f302_Tx, ComPduIdRef=EcucPduCollection/SupF_Angle_oDBCNetWork_afae1504_Tx
          ComTxIPdu: ComMinimumDelayTime=0, ComTxIPduUnusedAreasDefault=0
            ComTxModeFalse
              ComTxMode: ComTxModeMode=PERIODIC, ComTxModeTimeOffset=0, ComTxModeTimePeriod=0.01
            ComTxModeTrue
              ComTxMode: ComTxModeMode=PERIODIC, ComTxModeTimeOffset=0, ComTxModeTimePeriod=0.01
        SupF_Button_State_oDBCNetWork_e1c0e29d_Tx: ComIPduDirection=SEND, ComIPduGroupRef=XB_SUP_F_oDBCNetWork_Tx_78634bbc, ComIPduSignalGroupRef=SG_Sig_Grp_0x211_oSupF_Button_State_oDBCNetWork_b368711c_Tx, ComPduIdRef=EcucPduCollection/SupF_Button_State_oDBCNetWork_e1c0e29d_Tx
          ComTxIPdu: ComMinimumDelayTime=0, ComTxIPduUnusedAreasDefault=0
            ComTxModeFalse
              ComTxMode: ComTxModeMode=PERIODIC, ComTxModeTimeOffset=0, ComTxModeTimePeriod=0.05
            ComTxModeTrue
              ComTxMode: ComTxModeMode=PERIODIC, ComTxModeTimeOffset=0, ComTxModeTimePeriod=0.05
        SupF_ComError_oDBCNetWork_f4af97d3_Tx: ComIPduDirection=SEND, ComIPduGroupRef=XB_SUP_F_oDBCNetWork_Tx_78634bbc, ComIPduSignalGroupRef=SG_Sig_Grp_0x216_oSupF_ComError_oDBCNetWork_8d63d174_Tx, ComPduIdRef=EcucPduCollection/SupF_ComError_oDBCNetWork_f4af97d3_Tx
          ComTxIPdu: ComMinimumDelayTime=0, ComTxIPduUnusedAreasDefault=0
            ComTxModeFalse
              ComTxMode: ComTxModeMode=PERIODIC, ComTxModeTimeOffset=0, ComTxModeTimePeriod=0.01
            ComTxModeTrue
              ComTxMode: ComTxModeMode=PERIODIC, ComTxModeTimeOffset=0, ComTxModeTimePeriod=0.01
        SupF_Function_1_oDBCNetWork_003f31ca_Tx: ComIPduDirection=SEND, ComIPduGroupRef=XB_SUP_F_oDBCNetWork_Tx_78634bbc, ComIPduSignalGroupRef=SG_Sig_Grp_0x214_oSupF_Function_1_oDBCNetWork_0607409d_Tx, ComPduIdRef=EcucPduCollection/SupF_Function_1_oDBCNetWork_003f31ca_Tx
          ComTxIPdu: ComMinimumDelayTime=0, ComTxIPduUnusedAreasDefault=0
            ComTxModeFalse
              ComTxMode: ComTxModeMode=PERIODIC, ComTxModeTimeOffset=0, ComTxModeTimePeriod=0.02
            ComTxModeTrue
              ComTxMode: ComTxModeMode=PERIODIC, ComTxModeTimeOffset=0, ComTxModeTimePeriod=0.02
        SupF_Led_State_oDBCNetWork_35eef7d2_Tx: ComIPduDirection=SEND, ComIPduGroupRef=XB_SUP_F_oDBCNetWork_Tx_78634bbc, ComIPduSignalGroupRef=SG_Sig_Grp_0x210_oSupF_Led_State_oDBCNetWork_ec44dd46_Tx, ComPduIdRef=EcucPduCollection/SupF_Led_State_oDBCNetWork_35eef7d2_Tx
          ComTxIPdu: ComMinimumDelayTime=0, ComTxIPduUnusedAreasDefault=0
            ComTxModeFalse
              ComTxMode: ComTxModeMode=PERIODIC, ComTxModeTimeOffset=0, ComTxModeTimePeriod=0.1
            ComTxModeTrue
              ComTxMode: ComTxModeMode=PERIODIC, ComTxModeTimeOffset=0, ComTxModeTimePeriod=0.1
        SupF_PowerMode_oDBCNetWork_c1c74254_Tx: ComIPduDirection=SEND, ComIPduGroupRef=XB_SUP_F_oDBCNetWork_Tx_78634bbc, ComIPduSignalGroupRef=SG_Sig_Grp_0x212_oSupF_PowerMode_oDBCNetWork_de62da88_Tx, ComPduIdRef=EcucPduCollection/SupF_PowerMode_oDBCNetWork_c1c74254_Tx
          ComTxIPdu: ComMinimumDelayTime=0, ComTxIPduUnusedAreasDefault=0
            ComTxModeFalse
              ComTxMode: ComTxModeMode=PERIODIC, ComTxModeTimeOffset=0, ComTxModeTimePeriod=0.1
            ComTxModeTrue
              ComTxMode: ComTxModeMode=PERIODIC, ComTxModeTimeOffset=0, ComTxModeTimePeriod=0.1
      XB_SUP_F_oDBCNetWork_Rx_2e39ec3a (ComIPduGroup)
      XB_SUP_F_oDBCNetWork_Tx_78634bbc (ComIPduGroup)
      10 x ComSignalGroup, all with ComTransferProperty=PENDING:
        SG_Sig_Grp_0x210_oSupF_Led_State_oDBCNetWork_ec44dd46_Tx: ComSystemTemplateSignalGroupRef=SG_Sig_Grp_0x210
          4 x ComGroupSignal, all with ComBitSize=2, ComSignalEndianness=BIG_ENDIAN, ComSignalInitValue=0, ComSignalType=UINT8, ComTransferProperty=PENDING:
            F_Led1_State_oSupF_Led_State_oDBCNetWork_8a0569d2_Tx: ComBitPosition=1, ComSystemTemplateSystemSignalRef=F_Led1_State
            F_Led2_State_oSupF_Led_State_oDBCNetWork_01d657cb_Tx: ComBitPosition=9, ComSystemTemplateSystemSignalRef=F_Led2_State
            F_Led3_State_oSupF_Led_State_oDBCNetWork_ce484003_Tx: ComBitPosition=17, ComSystemTemplateSystemSignalRef=F_Led3_State
            F_Led4_State_oSupF_Led_State_oDBCNetWork_cd012db8_Tx: ComBitPosition=25, ComSystemTemplateSystemSignalRef=F_Led4_State
        SG_Sig_Grp_0x211_oSupF_Button_State_oDBCNetWork_b368711c_Tx: ComSystemTemplateSignalGroupRef=SG_Sig_Grp_0x211
          4 x ComGroupSignal, all with ComBitSize=3, ComSignalEndianness=BIG_ENDIAN, ComSignalInitValue=0, ComSignalType=UINT8, ComTransferProperty=PENDING:
            F_Button1_State_oSupF_Button_State_oDBCNetWork_ab1ba929_Tx: ComBitPosition=2, ComSystemTemplateSystemSignalRef=F_Button1_State
            F_Button2_State_oSupF_Button_State_oDBCNetWork_e6f3a94e_Tx: ComBitPosition=5, ComSystemTemplateSystemSignalRef=F_Button2_State
            F_Button3_State_oSupF_Button_State_oDBCNetWork_6b7b54ac_Tx: ComBitPosition=13, ComSystemTemplateSystemSignalRef=F_Button3_State
            F_Button4_State_oSupF_Button_State_oDBCNetWork_7d23a980_Tx: ComBitPosition=21, ComSystemTemplateSystemSignalRef=F_Button4_State
        SG_Sig_Grp_0x212_oSupF_PowerMode_oDBCNetWork_de62da88_Tx: ComSystemTemplateSignalGroupRef=SG_Sig_Grp_0x212
          3 x ComGroupSignal, all with ComSignalEndianness=BIG_ENDIAN, ComSignalInitValue=0, ComSignalType=UINT8, ComTransferProperty=PENDING:
            F_PowerMode_oSupF_PowerMode_oDBCNetWork_16d1a370_Tx: ComBitPosition=19, ComBitSize=4, ComSystemTemplateSystemSignalRef=F_PowerMode
            SupF_Checksum_0x212_oSupF_PowerMode_oDBCNetWork_8c3e64a3_Tx: ComBitPosition=7, ComBitSize=8, ComSystemTemplateSystemSignalRef=SupF_Checksum_0x212
            SupF_Counter_0x212_oSupF_PowerMode_oDBCNetWork_35c7002c_Tx: ComBitPosition=59, ComBitSize=4, ComSystemTemplateSystemSignalRef=SupF_Counter_0x212
        SG_Sig_Grp_0x213_oSupF_Angle_oDBCNetWork_3c68f302_Tx: ComSystemTemplateSignalGroupRef=SG_Sig_Grp_0x213
          F_AAA_Angle_oSupF_Angle_oDBCNetWork_d35fb591_Tx (ComGroupSignal):
            ComBitPosition = 7
            ComBitSize = 8
            ComSignalEndianness = BIG_ENDIAN
            ComSignalInitValue = 36
            ComSignalType = UINT8
            ComTransferProperty = PENDING
            ComSystemTemplateSystemSignalRef = F_AAA_Angle
        SG_Sig_Grp_0x214_oSupF_Function_1_oDBCNetWork_0607409d_Tx: ComSystemTemplateSignalGroupRef=SG_Sig_Grp_0x214
          4 x ComGroupSignal, all with ComBitSize=16, ComSignalEndianness=BIG_ENDIAN, ComSignalInitValue=0, ComSignalType=UINT16, ComTransferProperty=PENDING:
            F_Sig_0x214_Used_1_oSupF_Function_1_oDBCNetWork_cbe4e15e_Tx: ComBitPosition=7, ComSystemTemplateSystemSignalRef=F_Sig_0x214_Used_1
            F_Sig_0x214_Used_2_oSupF_Function_1_oDBCNetWork_8f45c446_Tx: ComBitPosition=23, ComSystemTemplateSystemSignalRef=F_Sig_0x214_Used_2
            F_Sig_0x214_Used_3_oSupF_Function_1_oDBCNetWork_b325274e_Tx: ComBitPosition=39, ComSystemTemplateSystemSignalRef=F_Sig_0x214_Used_3
            F_Sig_0x214_Used_5_oSupF_Function_1_oDBCNetWork_3a676d7e_Tx: ComBitPosition=55, ComSystemTemplateSystemSignalRef=F_Sig_0x214_Used_5
        SG_Sig_Grp_0x216_oSupF_ComError_oDBCNetWork_8d63d174_Tx: ComSystemTemplateSignalGroupRef=SG_Sig_Grp_0x216
          F_Meg_E2E_Error_oSupF_ComError_oDBCNetWork_edc11637_Tx (ComGroupSignal):
            ComBitPosition = 15
            ComBitSize = 8
            ComSignalEndianness = BIG_ENDIAN
            ComSignalInitValue = 0
            ComSignalType = UINT8
            ComTransferProperty = PENDING
            ComSystemTemplateSystemSignalRef = F_Meg_E2E_Error
          F_Mes_Lost_Error_oSupF_ComError_oDBCNetWork_72d68791_Tx (ComGroupSignal):
            ComBitPosition = 7
            ComBitSize = 8
            ComSignalEndianness = BIG_ENDIAN
            ComSignalInitValue = 0
            ComSignalType = UINT8
            ComTransferProperty = PENDING
            ComSystemTemplateSystemSignalRef = F_Mes_Lost_Error
        SG_Sig_Grp_0x300_oSupD_Led_Control_oDBCNetWork_89733210_Rx: ComTimeout=0, ComSystemTemplateSignalGroupRef=SG_Sig_Grp_0x300
          6 x ComGroupSignal, all with ComSignalEndianness=BIG_ENDIAN, ComSignalType=UINT8:
            D_Led1_Control_oSupD_Led_Control_oDBCNetWork_34bc1d83_Rx: ComBitPosition=9, ComBitSize=2, ComSignalInitValue=2, ComSystemTemplateSystemSignalRef=D_Led1_Control
            D_Led2_Control_oSupD_Led_Control_oDBCNetWork_e7270178_Rx: ComBitPosition=11, ComBitSize=2, ComSignalInitValue=2, ComSystemTemplateSystemSignalRef=D_Led2_Control
            D_Led3_Control_oSupD_Led_Control_oDBCNetWork_a9ae0ad1_Rx: ComBitPosition=13, ComBitSize=2, ComSignalInitValue=2, ComSystemTemplateSystemSignalRef=D_Led3_Control
            D_Led4_Control_oSupD_Led_Control_oDBCNetWork_9b603ecf_Rx: ComBitPosition=15, ComBitSize=2, ComSignalInitValue=2, ComSystemTemplateSystemSignalRef=D_Led4_Control
            SupD_Checksum_0x300_oSupD_Led_Control_oDBCNetWork_2c493488_Rx: ComBitPosition=7, ComBitSize=8, ComSignalInitValue=0, ComSystemTemplateSystemSignalRef=SupD_Checksum_0x300
            SupD_Counter_0x300_oSupD_Led_Control_oDBCNetWork_b943cd4b_Rx: ComBitPosition=59, ComBitSize=4, ComSignalInitValue=0, ComSystemTemplateSystemSignalRef=SupD_Counter_0x300
        SG_Sig_Grp_0x301_oSupD_Button_Control_oDBCNetWork_188cbd42_Rx: ComTimeout=0, ComSystemTemplateSignalGroupRef=SG_Sig_Grp_0x301
          4 x ComGroupSignal, all with ComBitSize=2, ComSignalEndianness=BIG_ENDIAN, ComSignalInitValue=0, ComSignalType=UINT8:
            D_Button1_Control_oSupD_Button_Control_oDBCNetWork_fc1efec2_Rx: ComBitPosition=1, ComSystemTemplateSystemSignalRef=D_Button1_Control
            D_Button2_Control_oSupD_Button_Control_oDBCNetWork_c42575b1_Rx: ComBitPosition=9, ComSystemTemplateSystemSignalRef=D_Button2_Control
            D_Button3_Control_oSupD_Button_Control_oDBCNetWork_651cf15f_Rx: ComBitPosition=17, ComSystemTemplateSystemSignalRef=D_Button3_Control
            D_Button4_Control_oSupD_Button_Control_oDBCNetWork_b4526357_Rx: ComBitPosition=25, ComSystemTemplateSystemSignalRef=D_Button4_Control
        SG_Sig_Grp_0x302_oSupE_Function_1_oDBCNetWork_28664efe_Rx: ComTimeout=0, ComSystemTemplateSignalGroupRef=SG_Sig_Grp_0x302
          3 x ComGroupSignal, all with ComSignalEndianness=BIG_ENDIAN, ComSignalInitValue=0:
            E_Sig_0x302_Used_1_oSupE_Function_1_oDBCNetWork_5fb2dd52_Rx: ComBitPosition=7, ComBitSize=16, ComSignalType=UINT16, ComSystemTemplateSystemSignalRef=E_Sig_0x302_Used_1
            E_Sig_0x302_Used_2_oSupE_Function_1_oDBCNetWork_1b13f84a_Rx: ComBitPosition=23, ComBitSize=8, ComSignalType=UINT8, ComSystemTemplateSystemSignalRef=E_Sig_0x302_Used_2
            E_Sig_0x302_Used_3_oSupE_Function_1_oDBCNetWork_27731b42_Rx: ComBitPosition=31, ComBitSize=8, ComSignalType=UINT8, ComSystemTemplateSystemSignalRef=E_Sig_0x302_Used_3
        SG_Sig_Grp_0x304_oSupD_Led_CtrlMode_oDBCNetWork_663125ab_Rx: ComTimeout=0, ComSystemTemplateSignalGroupRef=SG_Sig_Grp_0x304
          6 x ComGroupSignal, all with ComSignalEndianness=BIG_ENDIAN, ComSignalInitValue=0, ComSignalType=UINT8:
            D_Led1_CtrlMode_oSupD_Led_CtrlMode_oDBCNetWork_e2fdf3e9_Rx: ComBitPosition=11, ComBitSize=4, ComSystemTemplateSystemSignalRef=D_Led1_CtrlMode
            D_Led2_CtrlMode_oSupD_Led_CtrlMode_oDBCNetWork_01b4444b_Rx: ComBitPosition=19, ComBitSize=4, ComSystemTemplateSystemSignalRef=D_Led2_CtrlMode
            D_Led3_CtrlMode_oSupD_Led_CtrlMode_oDBCNetWork_e9a3d4ea_Rx: ComBitPosition=27, ComBitSize=4, ComSystemTemplateSystemSignalRef=D_Led3_CtrlMode
            D_Led4_CtrlMode_oSupD_Led_CtrlMode_oDBCNetWork_1c562d4e_Rx: ComBitPosition=35, ComBitSize=4, ComSystemTemplateSystemSignalRef=D_Led4_CtrlMode
            SupD_Checksum_0x304_oSupD_Led_CtrlMode_oDBCNetWork_984004db_Rx: ComBitPosition=7, ComBitSize=8, ComSystemTemplateSystemSignalRef=SupD_Checksum_0x304
            SupD_Counter_0x304_oSupD_Led_CtrlMode_oDBCNetWork_9ab89d28_Rx: ComBitPosition=59, ComBitSize=4, ComSystemTemplateSystemSignalRef=SupD_Counter_0x304
    ComGeneral
  module config ComM
    ComMConfigSet: ComMPncEnabled=false
      CN_DBCNetWork_05d62413 (ComMChannel): ComMBusType=COMM_BUS_TYPE_CAN, ComMChannelId=0
        ComMNetworkManagement: ComMNmVariant=PASSIVE
        CN_DBCNetWork_ecd7f164 (ComMUserPerChannel): ComMUserChannel=CN_DBCNetWork_f94df0c8
      CN_DBCNetWork_INTER1_9768a826 (ComMChannel): ComMBusType=COMM_BUS_TYPE_CAN, ComMChannelId=1
        ComMNetworkManagement: ComMNmVariant=PASSIVE
        CN_DBCNetWork_INTER1_aa29c0bb (ComMUserPerChannel): ComMUserChannel=CN_DBCNetWork_INTER1_b99b6675
      CN_DBCNetWork_INTER1_b99b6675 (ComMUser): ComMUserIdentifier=1
      CN_DBCNetWork_f94df0c8 (ComMUser): ComMUserIdentifier=0
    ComMGeneral: ComMPncIdCounting=COMM_PNC_ID_COUNT_FROM_NM_MESSAGE, ComMPncSupport=false
  module config Dcm
    DcmConfigSet  # Diagnostics Data Import
      DcmDsl
        DcmDslProtocol
          DcmDslProtocolRow_29812fbf (DcmDslProtocolRow)
            DcmDslConnection_b0443a58 (DcmDslConnection)
              DcmDslMainConnection
                Meg_FunDiag_oDBCNetWork_8501a87a_Rx_bf5f7bb7 (DcmDslProtocolRx):
                  DcmDslProtocolRxAddrType = DCM_FUNCTIONAL_TYPE
                  DcmDslProtocolRxPduId = 1
                  DcmDslProtocolRxComMChannelRef = ComMConfigSet/CN_DBCNetWork_05d62413
                  DcmDslProtocolRxPduRef = Meg_FunDiag_oDBCNetWork_8501a87a_Rx
                Meg_PhyDiag_oDBCNetWork_e154eea6_Rx_9bc604ea (DcmDslProtocolRx):
                  DcmDslProtocolRxAddrType = DCM_PHYSICAL_TYPE
                  DcmDslProtocolRxPduId = 2
                  DcmDslProtocolRxComMChannelRef = ComMConfigSet/CN_DBCNetWork_05d62413
                  DcmDslProtocolRxPduRef = Meg_PhyDiag_oDBCNetWork_e154eea6_Rx
                Meg_ResDiag_oDBCNetWork_5467f8e5_Tx_024d51d1 (DcmDslProtocolTx): DcmDslTxConfirmationPduId=0, DcmDslProtocolTxPduRef=EcucPduCollection/Meg_ResDiag_oDBCNetWork_5467f8e5_Tx
      DcmDsp: DcmDspMaxDidToRead=1  # Diagnostics Data Import
        ComControl (DcmDspComControl)  # Diagnostics Data Import
          DspComContolAllChannel (DcmDspComControlAllChannel)  # Diagnostics Data Import
        DcmDspSession  # Diagnostics Data Import
          3 x DcmDspSessionRow, all with DcmDspSessionP2ServerMax=0.05, DcmDspSessionP2StarServerMax=5:
            Extended: DcmDspSessionLevel=3, DcmDspSessionForBoot=DCM_NO_BOOT  # Diagnostics Data Import
            Programming: DcmDspSessionLevel=2  # Diagnostics Data Import
            Default: DcmDspSessionLevel=1, DcmDspSessionForBoot=DCM_NO_BOOT  # Diagnostics Data Import
        DcmDspSecurity  # Diagnostics Data Import
          UnlockedL1 (DcmDspSecurityRow): DcmDspSecurityKeySize=4, DcmDspSecurityLevel=1, DcmDspSecuritySeedSize=4  # Diagnostics Data Import
        RoutineInfo_ECU_Check (DcmDspRoutineInfo)  # Diagnostics Data Import
          DcmDspRoutineRequestResOut  # Diagnostics Data Import
            Out_ECU_Check_status (DcmDspRoutineRequestResOutSignal): DcmDspRoutineSignalLength=8, DcmDspRoutineSignalType=UINT8, DcmDspRoutineSignalPos=0  # Diagnostics Data Import
          DcmDspStartRoutineOut  # Diagnostics Data Import
            Out_ECU_Check_is_in_progress (DcmDspStartRoutineOutSignal): DcmDspRoutineSignalLength=8, DcmDspRoutineSignalType=UINT8, DcmDspRoutineSignalPos=0  # Diagnostics Data Import
          DcmDspStartRoutineIn  # Diagnostics Data Import
            In_Start_ECU_Check (DcmDspStartRoutineInSignal): DcmDspRoutineSignalLength=8, DcmDspRoutineSignalType=UINT8, DcmDspRoutineSignalPos=0  # Diagnostics Data Import
          DcmDspRoutineAuthorization  # Diagnostics Data Import
        ECU_Check (DcmDspRoutine):  # Diagnostics Data Import
          DcmDspRequestResultsRoutineSupported = true
          DcmDspStopRoutineSupported = false
          DcmDspRoutineIdentifier = 256
          DcmDspRoutineInfoRef = RoutineInfo_ECU_Check
        19 x DcmDspDidInfo:
          DidInfo_Fingerprint  # Diagnostics Data Import
            DcmDspDidAccess  # Diagnostics Data Import
              DcmDspDidWrite  # Diagnostics Data Import
              DcmDspDidRead  # Diagnostics Data Import
          DidInfo_Software_Supplier_Identification  # Diagnostics Data Import
            DcmDspDidAccess  # Diagnostics Data Import
              DcmDspDidWrite  # Diagnostics Data Import
              DcmDspDidRead  # Diagnostics Data Import
          DidInfo_Hardware_Supplier_Identification  # Diagnostics Data Import
            DcmDspDidAccess  # Diagnostics Data Import
              DcmDspDidWrite  # Diagnostics Data Import
              DcmDspDidRead  # Diagnostics Data Import
          DidInfo_Hardware_Part_Number  # Diagnostics Data Import
            DcmDspDidAccess  # Diagnostics Data Import
              DcmDspDidWrite  # Diagnostics Data Import
              DcmDspDidRead  # Diagnostics Data Import
          DidInfo_VIN  # Diagnostics Data Import
            DcmDspDidAccess  # Diagnostics Data Import
              DcmDspDidWrite  # Diagnostics Data Import
              DcmDspDidRead  # Diagnostics Data Import
          DidInfo_Serial_Number  # Diagnostics Data Import
            DcmDspDidAccess  # Diagnostics Data Import
              DcmDspDidWrite  # Diagnostics Data Import
              DcmDspDidRead  # Diagnostics Data Import
          DidInfo_Software_Version  # Diagnostics Data Import
            DcmDspDidAccess  # Diagnostics Data Import
              DcmDspDidWrite  # Diagnostics Data Import
              DcmDspDidRead  # Diagnostics Data Import
          DidInfo_Service_Information  # Diagnostics Data Import
            DcmDspDidAccess  # Diagnostics Data Import
              DcmDspDidWrite  # Diagnostics Data Import
              DcmDspDidRead  # Diagnostics Data Import
          DidInfo_Inflation_Pressure  # Diagnostics Data Import
            DcmDspDidAccess  # Diagnostics Data Import
              DcmDspDidRead  # Diagnostics Data Import
          DidInfo_Switches  # Diagnostics Data Import
            DcmDspDidAccess  # Diagnostics Data Import
              DcmDspDidRead  # Diagnostics Data Import
              DcmDspDidControl:  # Diagnostics Data Import
                DcmDspDidFreezeCurrentState = false
                DcmDspDidResetToDefault = true
                DcmDspDidReturnControlToEcu = false
                DcmDspDidShortTermAdjustment = true
                DcmDspDidControlSessionRef = DcmDspSession/Programming
                DcmDspDidControlSessionRef = DcmDspSession/Extended
          DidInfo_Hydraulic_Pump  # Diagnostics Data Import
            DcmDspDidAccess  # Diagnostics Data Import
              DcmDspDidRead  # Diagnostics Data Import
          DidInfo_Brake_Pressure  # Diagnostics Data Import
            DcmDspDidAccess  # Diagnostics Data Import
              DcmDspDidRead  # Diagnostics Data Import
          DidInfo_Brake_Pedal  # Diagnostics Data Import
            DcmDspDidAccess  # Diagnostics Data Import
              DcmDspDidRead  # Diagnostics Data Import
          DidInfo_Hydro_Unit  # Diagnostics Data Import
            DcmDspDidAccess  # Diagnostics Data Import
              DcmDspDidRead  # Diagnostics Data Import
          DidInfo_Acceleration_Sensor  # Diagnostics Data Import
            DcmDspDidAccess  # Diagnostics Data Import
              DcmDspDidRead  # Diagnostics Data Import
          DidInfo_Wheel_Speed  # Diagnostics Data Import
            DcmDspDidAccess  # Diagnostics Data Import
              DcmDspDidRead  # Diagnostics Data Import
          DidInfo_Wheel_Type  # Diagnostics Data Import
            DcmDspDidAccess  # Diagnostics Data Import
              DcmDspDidWrite  # Diagnostics Data Import
              DcmDspDidRead  # Diagnostics Data Import
          DidInfo_Supply_Voltage_ECU  # Diagnostics Data Import
            DcmDspDidAccess  # Diagnostics Data Import
              DcmDspDidRead  # Diagnostics Data Import
          DidInfo_Braking  # Diagnostics Data Import
            DcmDspDidAccess  # Diagnostics Data Import
              DcmDspDidRead  # Diagnostics Data Import
        19 x DcmDspDid:
          Fingerprint: DcmDspDidIdentifier=61848, DcmDspDidInfoRef=DidInfo_Fingerprint  # Diagnostics Data Import
            3 x DcmDspDidSignal:
              Programming_Date: DcmDspDidDataPos=72, DcmDspDidDataRef=Fingerprint_Programming_Date  # Diagnostics Data Import
              Repair_Shop_Identification: DcmDspDidDataPos=64, DcmDspDidDataRef=Fingerprint_Repair_Shop_Identification  # Diagnostics Data Import
              Serial_number_of_flash_tool: DcmDspDidDataPos=0, DcmDspDidDataRef=Fingerprint_Serial_number_of_flash_tool  # Diagnostics Data Import
          Software_Supplier_Identification: DcmDspDidIdentifier=61844, DcmDspDidInfoRef=DidInfo_Software_Supplier_Identification  # Diagnostics Data Import
            SoftwareSupplier (DcmDspDidSignal): DcmDspDidDataPos=0, DcmDspDidDataRef=Software_Supplier_Identification_SoftwareSupplier  # Diagnostics Data Import
          Hardware_Supplier_Identification: DcmDspDidIdentifier=61842, DcmDspDidInfoRef=DidInfo_Hardware_Supplier_Identification  # Diagnostics Data Import
            HardwareSupplier (DcmDspDidSignal): DcmDspDidDataPos=0, DcmDspDidDataRef=Hardware_Supplier_Identification_HardwareSupplier  # Diagnostics Data Import
          Hardware_Part_Number: DcmDspDidIdentifier=61841, DcmDspDidInfoRef=DidInfo_Hardware_Part_Number  # Diagnostics Data Import
            PartNumber (DcmDspDidSignal): DcmDspDidDataPos=0, DcmDspDidDataRef=Hardware_Part_Number_PartNumber  # Diagnostics Data Import
          VIN: DcmDspDidIdentifier=61840, DcmDspDidInfoRef=DidInfo_VIN  # Diagnostics Data Import
            VIN (DcmDspDidSignal): DcmDspDidDataPos=0, DcmDspDidDataRef=VIN_VIN  # Diagnostics Data Import
          Serial_Number: DcmDspDidIdentifier=61836, DcmDspDidInfoRef=DidInfo_Serial_Number  # Diagnostics Data Import
            SerialNumber (DcmDspDidSignal): DcmDspDidDataPos=0, DcmDspDidDataRef=Serial_Number_SerialNumber  # Diagnostics Data Import
          Software_Version: DcmDspDidIdentifier=61833, DcmDspDidInfoRef=DidInfo_Software_Version  # Diagnostics Data Import
            SoftwareVersion (DcmDspDidSignal): DcmDspDidDataPos=0, DcmDspDidDataRef=Software_Version_SoftwareVersion  # Diagnostics Data Import
          Service_Information: DcmDspDidIdentifier=274, DcmDspDidInfoRef=DidInfo_Service_Information  # Diagnostics Data Import
            Remaining_Service_Time_Left (DcmDspDidSignal): DcmDspDidDataPos=8, DcmDspDidDataRef=Service_Information_Remaining_Service_Time_Left  # Diagnostics Data Import
            Remaining_Service_Brake_Fluid_Life (DcmDspDidSignal): DcmDspDidDataPos=0, DcmDspDidDataRef=Service_Information_Remaining_Service_Brake_Fluid_Life  # Diagnostics Data Import
          Inflation_Pressure: DcmDspDidIdentifier=273, DcmDspDidInfoRef=DidInfo_Inflation_Pressure  # Diagnostics Data Import
            4 x DcmDspDidSignal:
              Inflation_Pressure_RL: DcmDspDidDataPos=24, DcmDspDidDataRef=Inflation_Pressure_Inflation_Pressure_RL  # Diagnostics Data Import
              Inflation_Pressure_RR: DcmDspDidDataPos=16, DcmDspDidDataRef=Inflation_Pressure_Inflation_Pressure_RR  # Diagnostics Data Import
              Inflation_Pressure_FL: DcmDspDidDataPos=8, DcmDspDidDataRef=Inflation_Pressure_Inflation_Pressure_FL  # Diagnostics Data Import
              Inflation_Pressure_FR: DcmDspDidDataPos=0, DcmDspDidDataRef=Inflation_Pressure_Inflation_Pressure_FR  # Diagnostics Data Import
          Switches: DcmDspDidIdentifier=272, DcmDspDidInfoRef=DidInfo_Switches  # Diagnostics Data Import
            3 x DcmDspDidSignal:
              Rear_Gear_Switch: DcmDspDidDataPos=16, DcmDspDidDataRef=Switches_Rear_Gear_Switch  # Diagnostics Data Import
              Parking_Brake_Switch: DcmDspDidDataPos=8, DcmDspDidDataRef=Switches_Parking_Brake_Switch  # Diagnostics Data Import
              Brake_Switch: DcmDspDidDataPos=0, DcmDspDidDataRef=Switches_Brake_Switch  # Diagnostics Data Import
          Hydraulic_Pump: DcmDspDidIdentifier=271, DcmDspDidInfoRef=DidInfo_Hydraulic_Pump  # Diagnostics Data Import
            3 x DcmDspDidSignal:
              Hydraulic_Pump_Performance: DcmDspDidDataPos=16, DcmDspDidDataRef=Hydraulic_Pump_Hydraulic_Pump_Performance  # Diagnostics Data Import
              Status_Hydraulic_Pump: DcmDspDidDataPos=8, DcmDspDidDataRef=Hydraulic_Pump_Status_Hydraulic_Pump  # Diagnostics Data Import
              Hydraulic_Pump_Voltage: DcmDspDidDataPos=0, DcmDspDidDataRef=Hydraulic_Pump_Hydraulic_Pump_Voltage  # Diagnostics Data Import
          Brake_Pressure: DcmDspDidIdentifier=270, DcmDspDidInfoRef=DidInfo_Brake_Pressure  # Diagnostics Data Import
            Brake_Pressure (DcmDspDidSignal): DcmDspDidDataPos=0, DcmDspDidDataRef=Brake_Pressure_Brake_Pressure  # Diagnostics Data Import
          Brake_Pedal: DcmDspDidIdentifier=269, DcmDspDidInfoRef=DidInfo_Brake_Pedal  # Diagnostics Data Import
            8 x DcmDspDidSignal:
              Valve_Status_RL: DcmDspDidDataPos=56, DcmDspDidDataRef=Brake_Pedal_Valve_Status_RL  # Diagnostics Data Import
              Valve_Status_RR: DcmDspDidDataPos=48, DcmDspDidDataRef=Brake_Pedal_Valve_Status_RR  # Diagnostics Data Import
              Valve_Status_FL: DcmDspDidDataPos=40, DcmDspDidDataRef=Brake_Pedal_Valve_Status_FL  # Diagnostics Data Import
              Valve_Status_FR: DcmDspDidDataPos=32, DcmDspDidDataRef=Brake_Pedal_Valve_Status_FR  # Diagnostics Data Import
              Valve_Voltage_RL: DcmDspDidDataPos=24, DcmDspDidDataRef=Brake_Pedal_Valve_Voltage_RL  # Diagnostics Data Import
              Valve_Voltage_RR: DcmDspDidDataPos=16, DcmDspDidDataRef=Brake_Pedal_Valve_Voltage_RR  # Diagnostics Data Import
              Valve_Voltage_FL: DcmDspDidDataPos=8, DcmDspDidDataRef=Brake_Pedal_Valve_Voltage_FL  # Diagnostics Data Import
              Valve_Voltage_FR: DcmDspDidDataPos=0, DcmDspDidDataRef=Brake_Pedal_Valve_Voltage_FR  # Diagnostics Data Import
          Hydro_Unit: DcmDspDidIdentifier=268, DcmDspDidInfoRef=DidInfo_Hydro_Unit  # Diagnostics Data Import
            8 x DcmDspDidSignal:
              Valve_Status_RL: DcmDspDidDataPos=56, DcmDspDidDataRef=Hydro_Unit_Valve_Status_RL  # Diagnostics Data Import
              Valve_Status_RR: DcmDspDidDataPos=48, DcmDspDidDataRef=Hydro_Unit_Valve_Status_RR  # Diagnostics Data Import
              Valve_Status_FL: DcmDspDidDataPos=40, DcmDspDidDataRef=Hydro_Unit_Valve_Status_FL  # Diagnostics Data Import
              Valve_Status_FR: DcmDspDidDataPos=32, DcmDspDidDataRef=Hydro_Unit_Valve_Status_FR  # Diagnostics Data Import
              Valve_Voltage_RL: DcmDspDidDataPos=24, DcmDspDidDataRef=Hydro_Unit_Valve_Voltage_RL  # Diagnostics Data Import
              Valve_Voltage_RR: DcmDspDidDataPos=16, DcmDspDidDataRef=Hydro_Unit_Valve_Voltage_RR  # Diagnostics Data Import
              Valve_Voltage_FL: DcmDspDidDataPos=8, DcmDspDidDataRef=Hydro_Unit_Valve_Voltage_FL  # Diagnostics Data Import
              Valve_Voltage_FR: DcmDspDidDataPos=0, DcmDspDidDataRef=Hydro_Unit_Valve_Voltage_FR  # Diagnostics Data Import
          Acceleration_Sensor: DcmDspDidIdentifier=267, DcmDspDidInfoRef=DidInfo_Acceleration_Sensor  # Diagnostics Data Import
            Acceleration (DcmDspDidSignal): DcmDspDidDataPos=8, DcmDspDidDataRef=Acceleration_Sensor_Acceleration  # Diagnostics Data Import
            Voltage (DcmDspDidSignal): DcmDspDidDataPos=0, DcmDspDidDataRef=Acceleration_Sensor_Voltage  # Diagnostics Data Import
          Wheel_Speed: DcmDspDidIdentifier=266, DcmDspDidInfoRef=DidInfo_Wheel_Speed  # Diagnostics Data Import
            9 x DcmDspDidSignal:
              Direction_of_rotation: DcmDspDidDataPos=64, DcmDspDidDataRef=Wheel_Speed_Direction_of_rotation  # Diagnostics Data Import
              Wheel_Voltage_RL: DcmDspDidDataPos=56, DcmDspDidDataRef=Wheel_Speed_Wheel_Voltage_RL  # Diagnostics Data Import
              Wheel_Voltage_RR: DcmDspDidDataPos=48, DcmDspDidDataRef=Wheel_Speed_Wheel_Voltage_RR  # Diagnostics Data Import
              Wheel_Voltage_FL: DcmDspDidDataPos=40, DcmDspDidDataRef=Wheel_Speed_Wheel_Voltage_FL  # Diagnostics Data Import
              Wheel_Voltage_FR: DcmDspDidDataPos=32, DcmDspDidDataRef=Wheel_Speed_Wheel_Voltage_FR  # Diagnostics Data Import
              Wheel_Speed_RL: DcmDspDidDataPos=24, DcmDspDidDataRef=Wheel_Speed_Wheel_Speed_RL  # Diagnostics Data Import
              Wheel_Speed_RR: DcmDspDidDataPos=16, DcmDspDidDataRef=Wheel_Speed_Wheel_Speed_RR  # Diagnostics Data Import
              Wheel_Speed_FL: DcmDspDidDataPos=8, DcmDspDidDataRef=Wheel_Speed_Wheel_Speed_FL  # Diagnostics Data Import
              Wheel_Speed_FR: DcmDspDidDataPos=0, DcmDspDidDataRef=Wheel_Speed_Wheel_Speed_FR  # Diagnostics Data Import
          Wheel_Type: DcmDspDidIdentifier=265, DcmDspDidInfoRef=DidInfo_Wheel_Type  # Diagnostics Data Import
            Wheel_type (DcmDspDidSignal): DcmDspDidDataPos=0, DcmDspDidDataRef=Wheel_Type_Wheel_type  # Diagnostics Data Import
          Supply_Voltage_ECU: DcmDspDidIdentifier=263, DcmDspDidInfoRef=DidInfo_Supply_Voltage_ECU  # Diagnostics Data Import
            Voltage_ECU (DcmDspDidSignal): DcmDspDidDataPos=0, DcmDspDidDataRef=Supply_Voltage_ECU_Voltage_ECU  # Diagnostics Data Import
          Braking: DcmDspDidIdentifier=256, DcmDspDidInfoRef=DidInfo_Braking  # Diagnostics Data Import
            7 x DcmDspDidSignal:
              Valve_Status_RL: DcmDspDidDataPos=48, DcmDspDidDataRef=Braking_Valve_Status_RL  # Diagnostics Data Import
              Valve_Status_RR: DcmDspDidDataPos=40, DcmDspDidDataRef=Braking_Valve_Status_RR  # Diagnostics Data Import
              Valve_Status_FL: DcmDspDidDataPos=32, DcmDspDidDataRef=Braking_Valve_Status_FL  # Diagnostics Data Import
              Valve_Status_FR: DcmDspDidDataPos=24, DcmDspDidDataRef=Braking_Valve_Status_FR  # Diagnostics Data Import
              Status_Hydraulic_Pump: DcmDspDidDataPos=16, DcmDspDidDataRef=Braking_Status_Hydraulic_Pump  # Diagnostics Data Import
              Brake_Pressure: DcmDspDidDataPos=8, DcmDspDidDataRef=Braking_Brake_Pressure  # Diagnostics Data Import
              Brake_Pedal: DcmDspDidDataPos=0, DcmDspDidDataRef=Braking_Brake_Pedal  # Diagnostics Data Import
        DataInfo_Fingerprint_Programming_Date (DcmDspDataInfo): DcmDspDataFixedLength=true  # Diagnostics Data Import
        Fingerprint_Programming_Date (DcmDspData): DcmDspDataSize=64, DcmDspDataType=UINT8_N, DcmDspDataInfoRef=DataInfo_Fingerprint_Programming_Date  # Diagnostics Data Import
        DataInfo_Fingerprint_Repair_Shop_Identification (DcmDspDataInfo): DcmDspDataFixedLength=true  # Diagnostics Data Import
        Fingerprint_Repair_Shop_Identification (DcmDspData): DcmDspDataSize=8, DcmDspDataType=UINT8, DcmDspDataInfoRef=DataInfo_Fingerprint_Repair_Shop_Identification  # Diagnostics Data Import
        DataInfo_Fingerprint_Serial_number_of_flash_tool (DcmDspDataInfo): DcmDspDataFixedLength=true  # Diagnostics Data Import
        Fingerprint_Serial_number_of_flash_tool (DcmDspData): DcmDspDataSize=64, DcmDspDataType=UINT8_N, DcmDspDataInfoRef=DataInfo_Fingerprint_Serial_number_of_flash_tool  # Diagnostics Data Import
        DataInfo_Software_Supplier_Identification_SoftwareSupplier (DcmDspDataInfo): DcmDspDataFixedLength=true  # Diagnostics Data Import
        Software_Supplier_Identification_SoftwareSupplier (DcmDspData): DcmDspDataSize=8, DcmDspDataType=UINT8, DcmDspDataInfoRef=DataInfo_Software_Supplier_Identification_SoftwareSupplier  # Diagnostics Data Import
        DataInfo_Hardware_Supplier_Identification_HardwareSupplier (DcmDspDataInfo): DcmDspDataFixedLength=true  # Diagnostics Data Import
        Hardware_Supplier_Identification_HardwareSupplier (DcmDspData): DcmDspDataSize=8, DcmDspDataType=UINT8, DcmDspDataInfoRef=DataInfo_Hardware_Supplier_Identification_HardwareSupplier  # Diagnostics Data Import
        DataInfo_Hardware_Part_Number_PartNumber (DcmDspDataInfo): DcmDspDataFixedLength=true  # Diagnostics Data Import
        Hardware_Part_Number_PartNumber (DcmDspData): DcmDspDataSize=104, DcmDspDataType=UINT8_N, DcmDspDataInfoRef=DataInfo_Hardware_Part_Number_PartNumber  # Diagnostics Data Import
        DataInfo_VIN_VIN (DcmDspDataInfo): DcmDspDataFixedLength=true  # Diagnostics Data Import
        VIN_VIN (DcmDspData): DcmDspDataSize=136, DcmDspDataType=UINT8_N, DcmDspDataInfoRef=DataInfo_VIN_VIN  # Diagnostics Data Import
        DataInfo_Serial_Number_SerialNumber (DcmDspDataInfo): DcmDspDataFixedLength=true  # Diagnostics Data Import
        Serial_Number_SerialNumber (DcmDspData): DcmDspDataSize=104, DcmDspDataType=UINT8_N, DcmDspDataInfoRef=DataInfo_Serial_Number_SerialNumber  # Diagnostics Data Import
        DataInfo_Software_Version_SoftwareVersion (DcmDspDataInfo): DcmDspDataFixedLength=true  # Diagnostics Data Import
        Software_Version_SoftwareVersion (DcmDspData): DcmDspDataSize=40, DcmDspDataType=UINT8_N, DcmDspDataInfoRef=DataInfo_Software_Version_SoftwareVersion  # Diagnostics Data Import
        DataInfo_Service_Information_Remaining_Service_Time_Left (DcmDspDataInfo): DcmDspDataFixedLength=true  # Diagnostics Data Import
        Service_Information_Remaining_Service_Time_Left (DcmDspData): DcmDspDataSize=16, DcmDspDataType=UINT16, DcmDspDataInfoRef=DataInfo_Service_Information_Remaining_Service_Time_Left  # Diagnostics Data Import
        DataInfo_Service_Information_Remaining_Service_Brake_Fluid_Life (DcmDspDataInfo): DcmDspDataFixedLength=true  # Diagnostics Data Import
        Service_Information_Remaining_Service_Brake_Fluid_Life (DcmDspData): DcmDspDataSize=8, DcmDspDataType=UINT8, DcmDspDataInfoRef=DataInfo_Service_Information_Remaining_Service_Brake_Fluid_Life  # Diagnostics Data Import
        DataInfo_Inflation_Pressure_Inflation_Pressure_RL (DcmDspDataInfo): DcmDspDataFixedLength=true  # Diagnostics Data Import
        Inflation_Pressure_Inflation_Pressure_RL (DcmDspData): DcmDspDataSize=8, DcmDspDataType=UINT8, DcmDspDataInfoRef=DataInfo_Inflation_Pressure_Inflation_Pressure_RL  # Diagnostics Data Import
        DataInfo_Inflation_Pressure_Inflation_Pressure_RR (DcmDspDataInfo): DcmDspDataFixedLength=true  # Diagnostics Data Import
        Inflation_Pressure_Inflation_Pressure_RR (DcmDspData): DcmDspDataSize=8, DcmDspDataType=UINT8, DcmDspDataInfoRef=DataInfo_Inflation_Pressure_Inflation_Pressure_RR  # Diagnostics Data Import
        DataInfo_Inflation_Pressure_Inflation_Pressure_FL (DcmDspDataInfo): DcmDspDataFixedLength=true  # Diagnostics Data Import
        Inflation_Pressure_Inflation_Pressure_FL (DcmDspData): DcmDspDataSize=8, DcmDspDataType=UINT8, DcmDspDataInfoRef=DataInfo_Inflation_Pressure_Inflation_Pressure_FL  # Diagnostics Data Import
        DataInfo_Inflation_Pressure_Inflation_Pressure_FR (DcmDspDataInfo): DcmDspDataFixedLength=true  # Diagnostics Data Import
        Inflation_Pressure_Inflation_Pressure_FR (DcmDspData): DcmDspDataSize=8, DcmDspDataType=UINT8, DcmDspDataInfoRef=DataInfo_Inflation_Pressure_Inflation_Pressure_FR  # Diagnostics Data Import
        DataInfo_Switches_Rear_Gear_Switch (DcmDspDataInfo): DcmDspDataFixedLength=true  # Diagnostics Data Import
        Switches_Rear_Gear_Switch (DcmDspData): DcmDspDataConditionCheckReadFncUsed=false, DcmDspDataSize=8, DcmDspDataType=UINT8, DcmDspDataInfoRef=DataInfo_Switches_Rear_Gear_Switch  # Diagnostics Data Import
        DataInfo_Switches_Parking_Brake_Switch (DcmDspDataInfo): DcmDspDataFixedLength=true  # Diagnostics Data Import
        Switches_Parking_Brake_Switch (DcmDspData): DcmDspDataConditionCheckReadFncUsed=false, DcmDspDataSize=8, DcmDspDataType=UINT8, DcmDspDataInfoRef=DataInfo_Switches_Parking_Brake_Switch  # Diagnostics Data Import
        DataInfo_Switches_Brake_Switch (DcmDspDataInfo): DcmDspDataFixedLength=true  # Diagnostics Data Import
        Switches_Brake_Switch (DcmDspData): DcmDspDataConditionCheckReadFncUsed=false, DcmDspDataSize=8, DcmDspDataType=UINT8, DcmDspDataInfoRef=DataInfo_Switches_Brake_Switch  # Diagnostics Data Import
        DataInfo_Hydraulic_Pump_Hydraulic_Pump_Performance (DcmDspDataInfo): DcmDspDataFixedLength=true  # Diagnostics Data Import
        Hydraulic_Pump_Hydraulic_Pump_Performance (DcmDspData): DcmDspDataSize=8, DcmDspDataType=UINT8, DcmDspDataInfoRef=DataInfo_Hydraulic_Pump_Hydraulic_Pump_Performance  # Diagnostics Data Import
        DataInfo_Hydraulic_Pump_Status_Hydraulic_Pump (DcmDspDataInfo): DcmDspDataFixedLength=true  # Diagnostics Data Import
        Hydraulic_Pump_Status_Hydraulic_Pump (DcmDspData): DcmDspDataSize=8, DcmDspDataType=UINT8, DcmDspDataInfoRef=DataInfo_Hydraulic_Pump_Status_Hydraulic_Pump  # Diagnostics Data Import
        DataInfo_Hydraulic_Pump_Hydraulic_Pump_Voltage (DcmDspDataInfo): DcmDspDataFixedLength=true  # Diagnostics Data Import
        Hydraulic_Pump_Hydraulic_Pump_Voltage (DcmDspData): DcmDspDataSize=8, DcmDspDataType=UINT8, DcmDspDataInfoRef=DataInfo_Hydraulic_Pump_Hydraulic_Pump_Voltage  # Diagnostics Data Import
        DataInfo_Brake_Pressure_Brake_Pressure (DcmDspDataInfo): DcmDspDataFixedLength=true  # Diagnostics Data Import
        Brake_Pressure_Brake_Pressure (DcmDspData): DcmDspDataSize=8, DcmDspDataType=UINT8, DcmDspDataInfoRef=DataInfo_Brake_Pressure_Brake_Pressure  # Diagnostics Data Import
        DataInfo_Brake_Pedal_Valve_Status_RL (DcmDspDataInfo): DcmDspDataFixedLength=true  # Diagnostics Data Import
        Brake_Pedal_Valve_Status_RL (DcmDspData): DcmDspDataSize=8, DcmDspDataType=UINT8, DcmDspDataInfoRef=DataInfo_Brake_Pedal_Valve_Status_RL  # Diagnostics Data Import
        DataInfo_Brake_Pedal_Valve_Status_RR (DcmDspDataInfo): DcmDspDataFixedLength=true  # Diagnostics Data Import
        Brake_Pedal_Valve_Status_RR (DcmDspData): DcmDspDataSize=8, DcmDspDataType=UINT8, DcmDspDataInfoRef=DataInfo_Brake_Pedal_Valve_Status_RR  # Diagnostics Data Import
        DataInfo_Brake_Pedal_Valve_Status_FL (DcmDspDataInfo): DcmDspDataFixedLength=true  # Diagnostics Data Import
        Brake_Pedal_Valve_Status_FL (DcmDspData): DcmDspDataSize=8, DcmDspDataType=UINT8, DcmDspDataInfoRef=DataInfo_Brake_Pedal_Valve_Status_FL  # Diagnostics Data Import
        DataInfo_Brake_Pedal_Valve_Status_FR (DcmDspDataInfo): DcmDspDataFixedLength=true  # Diagnostics Data Import
        Brake_Pedal_Valve_Status_FR (DcmDspData): DcmDspDataSize=8, DcmDspDataType=UINT8, DcmDspDataInfoRef=DataInfo_Brake_Pedal_Valve_Status_FR  # Diagnostics Data Import
        DataInfo_Brake_Pedal_Valve_Voltage_RL (DcmDspDataInfo): DcmDspDataFixedLength=true  # Diagnostics Data Import
        Brake_Pedal_Valve_Voltage_RL (DcmDspData): DcmDspDataSize=8, DcmDspDataType=UINT8, DcmDspDataInfoRef=DataInfo_Brake_Pedal_Valve_Voltage_RL  # Diagnostics Data Import
        DataInfo_Brake_Pedal_Valve_Voltage_RR (DcmDspDataInfo): DcmDspDataFixedLength=true  # Diagnostics Data Import
        Brake_Pedal_Valve_Voltage_RR (DcmDspData): DcmDspDataSize=8, DcmDspDataType=UINT8, DcmDspDataInfoRef=DataInfo_Brake_Pedal_Valve_Voltage_RR  # Diagnostics Data Import
        DataInfo_Brake_Pedal_Valve_Voltage_FL (DcmDspDataInfo): DcmDspDataFixedLength=true  # Diagnostics Data Import
        Brake_Pedal_Valve_Voltage_FL (DcmDspData): DcmDspDataSize=8, DcmDspDataType=UINT8, DcmDspDataInfoRef=DataInfo_Brake_Pedal_Valve_Voltage_FL  # Diagnostics Data Import
        DataInfo_Brake_Pedal_Valve_Voltage_FR (DcmDspDataInfo): DcmDspDataFixedLength=true  # Diagnostics Data Import
        Brake_Pedal_Valve_Voltage_FR (DcmDspData): DcmDspDataSize=8, DcmDspDataType=UINT8, DcmDspDataInfoRef=DataInfo_Brake_Pedal_Valve_Voltage_FR  # Diagnostics Data Import
        DataInfo_Hydro_Unit_Valve_Status_RL (DcmDspDataInfo): DcmDspDataFixedLength=true  # Diagnostics Data Import
        Hydro_Unit_Valve_Status_RL (DcmDspData): DcmDspDataSize=8, DcmDspDataType=UINT8, DcmDspDataInfoRef=DataInfo_Hydro_Unit_Valve_Status_RL  # Diagnostics Data Import
        DataInfo_Hydro_Unit_Valve_Status_RR (DcmDspDataInfo): DcmDspDataFixedLength=true  # Diagnostics Data Import
        Hydro_Unit_Valve_Status_RR (DcmDspData): DcmDspDataSize=8, DcmDspDataType=UINT8, DcmDspDataInfoRef=DataInfo_Hydro_Unit_Valve_Status_RR  # Diagnostics Data Import
        DataInfo_Hydro_Unit_Valve_Status_FL (DcmDspDataInfo): DcmDspDataFixedLength=true  # Diagnostics Data Import
        Hydro_Unit_Valve_Status_FL (DcmDspData): DcmDspDataSize=8, DcmDspDataType=UINT8, DcmDspDataInfoRef=DataInfo_Hydro_Unit_Valve_Status_FL  # Diagnostics Data Import
        DataInfo_Hydro_Unit_Valve_Status_FR (DcmDspDataInfo): DcmDspDataFixedLength=true  # Diagnostics Data Import
        Hydro_Unit_Valve_Status_FR (DcmDspData): DcmDspDataSize=8, DcmDspDataType=UINT8, DcmDspDataInfoRef=DataInfo_Hydro_Unit_Valve_Status_FR  # Diagnostics Data Import
        DataInfo_Hydro_Unit_Valve_Voltage_RL (DcmDspDataInfo): DcmDspDataFixedLength=true  # Diagnostics Data Import
        Hydro_Unit_Valve_Voltage_RL (DcmDspData): DcmDspDataSize=8, DcmDspDataType=UINT8, DcmDspDataInfoRef=DataInfo_Hydro_Unit_Valve_Voltage_RL  # Diagnostics Data Import
        DataInfo_Hydro_Unit_Valve_Voltage_RR (DcmDspDataInfo): DcmDspDataFixedLength=true  # Diagnostics Data Import
        Hydro_Unit_Valve_Voltage_RR (DcmDspData): DcmDspDataSize=8, DcmDspDataType=UINT8, DcmDspDataInfoRef=DataInfo_Hydro_Unit_Valve_Voltage_RR  # Diagnostics Data Import
        DataInfo_Hydro_Unit_Valve_Voltage_FL (DcmDspDataInfo): DcmDspDataFixedLength=true  # Diagnostics Data Import
        Hydro_Unit_Valve_Voltage_FL (DcmDspData): DcmDspDataSize=8, DcmDspDataType=UINT8, DcmDspDataInfoRef=DataInfo_Hydro_Unit_Valve_Voltage_FL  # Diagnostics Data Import
        DataInfo_Hydro_Unit_Valve_Voltage_FR (DcmDspDataInfo): DcmDspDataFixedLength=true  # Diagnostics Data Import
        Hydro_Unit_Valve_Voltage_FR (DcmDspData): DcmDspDataSize=8, DcmDspDataType=UINT8, DcmDspDataInfoRef=DataInfo_Hydro_Unit_Valve_Voltage_FR  # Diagnostics Data Import
        DataInfo_Acceleration_Sensor_Acceleration (DcmDspDataInfo): DcmDspDataFixedLength=true  # Diagnostics Data Import
        Acceleration_Sensor_Acceleration (DcmDspData): DcmDspDataSize=8, DcmDspDataType=UINT8, DcmDspDataInfoRef=DataInfo_Acceleration_Sensor_Acceleration  # Diagnostics Data Import
        DataInfo_Acceleration_Sensor_Voltage (DcmDspDataInfo): DcmDspDataFixedLength=true  # Diagnostics Data Import
        Acceleration_Sensor_Voltage (DcmDspData): DcmDspDataSize=8, DcmDspDataType=UINT8, DcmDspDataInfoRef=DataInfo_Acceleration_Sensor_Voltage  # Diagnostics Data Import
        DataInfo_Wheel_Speed_Direction_of_rotation (DcmDspDataInfo): DcmDspDataFixedLength=true  # Diagnostics Data Import
        Wheel_Speed_Direction_of_rotation (DcmDspData): DcmDspDataSize=8, DcmDspDataType=UINT8, DcmDspDataInfoRef=DataInfo_Wheel_Speed_Direction_of_rotation  # Diagnostics Data Import
        DataInfo_Wheel_Speed_Wheel_Voltage_RL (DcmDspDataInfo): DcmDspDataFixedLength=true  # Diagnostics Data Import
        Wheel_Speed_Wheel_Voltage_RL (DcmDspData): DcmDspDataSize=8, DcmDspDataType=UINT8, DcmDspDataInfoRef=DataInfo_Wheel_Speed_Wheel_Voltage_RL  # Diagnostics Data Import
        DataInfo_Wheel_Speed_Wheel_Voltage_RR (DcmDspDataInfo): DcmDspDataFixedLength=true  # Diagnostics Data Import
        Wheel_Speed_Wheel_Voltage_RR (DcmDspData): DcmDspDataSize=8, DcmDspDataType=UINT8, DcmDspDataInfoRef=DataInfo_Wheel_Speed_Wheel_Voltage_RR  # Diagnostics Data Import
        DataInfo_Wheel_Speed_Wheel_Voltage_FL (DcmDspDataInfo): DcmDspDataFixedLength=true  # Diagnostics Data Import
        Wheel_Speed_Wheel_Voltage_FL (DcmDspData): DcmDspDataSize=8, DcmDspDataType=UINT8, DcmDspDataInfoRef=DataInfo_Wheel_Speed_Wheel_Voltage_FL  # Diagnostics Data Import
        DataInfo_Wheel_Speed_Wheel_Voltage_FR (DcmDspDataInfo): DcmDspDataFixedLength=true  # Diagnostics Data Import
        Wheel_Speed_Wheel_Voltage_FR (DcmDspData): DcmDspDataSize=8, DcmDspDataType=UINT8, DcmDspDataInfoRef=DataInfo_Wheel_Speed_Wheel_Voltage_FR  # Diagnostics Data Import
        DataInfo_Wheel_Speed_Wheel_Speed_RL (DcmDspDataInfo): DcmDspDataFixedLength=true  # Diagnostics Data Import
        Wheel_Speed_Wheel_Speed_RL (DcmDspData): DcmDspDataSize=8, DcmDspDataType=UINT8, DcmDspDataInfoRef=DataInfo_Wheel_Speed_Wheel_Speed_RL  # Diagnostics Data Import
        DataInfo_Wheel_Speed_Wheel_Speed_RR (DcmDspDataInfo): DcmDspDataFixedLength=true  # Diagnostics Data Import
        Wheel_Speed_Wheel_Speed_RR (DcmDspData): DcmDspDataSize=8, DcmDspDataType=UINT8, DcmDspDataInfoRef=DataInfo_Wheel_Speed_Wheel_Speed_RR  # Diagnostics Data Import
        DataInfo_Wheel_Speed_Wheel_Speed_FL (DcmDspDataInfo): DcmDspDataFixedLength=true  # Diagnostics Data Import
        Wheel_Speed_Wheel_Speed_FL (DcmDspData): DcmDspDataSize=8, DcmDspDataType=UINT8, DcmDspDataInfoRef=DataInfo_Wheel_Speed_Wheel_Speed_FL  # Diagnostics Data Import
        DataInfo_Wheel_Speed_Wheel_Speed_FR (DcmDspDataInfo): DcmDspDataFixedLength=true  # Diagnostics Data Import
        Wheel_Speed_Wheel_Speed_FR (DcmDspData): DcmDspDataSize=8, DcmDspDataType=UINT8, DcmDspDataInfoRef=DataInfo_Wheel_Speed_Wheel_Speed_FR  # Diagnostics Data Import
        DataInfo_Wheel_Type_Wheel_type (DcmDspDataInfo): DcmDspDataFixedLength=true  # Diagnostics Data Import
        Wheel_Type_Wheel_type (DcmDspData): DcmDspDataSize=8, DcmDspDataType=UINT8, DcmDspDataInfoRef=DataInfo_Wheel_Type_Wheel_type  # Diagnostics Data Import
        DataInfo_Supply_Voltage_ECU_Voltage_ECU (DcmDspDataInfo): DcmDspDataFixedLength=true  # Diagnostics Data Import
        Supply_Voltage_ECU_Voltage_ECU (DcmDspData): DcmDspDataSize=8, DcmDspDataType=UINT8, DcmDspDataInfoRef=DataInfo_Supply_Voltage_ECU_Voltage_ECU  # Diagnostics Data Import
        DataInfo_Braking_Valve_Status_RL (DcmDspDataInfo): DcmDspDataFixedLength=true  # Diagnostics Data Import
        Braking_Valve_Status_RL (DcmDspData): DcmDspDataSize=8, DcmDspDataType=UINT8, DcmDspDataInfoRef=DataInfo_Braking_Valve_Status_RL  # Diagnostics Data Import
        DataInfo_Braking_Valve_Status_RR (DcmDspDataInfo): DcmDspDataFixedLength=true  # Diagnostics Data Import
        Braking_Valve_Status_RR (DcmDspData): DcmDspDataSize=8, DcmDspDataType=UINT8, DcmDspDataInfoRef=DataInfo_Braking_Valve_Status_RR  # Diagnostics Data Import
        DataInfo_Braking_Valve_Status_FL (DcmDspDataInfo): DcmDspDataFixedLength=true  # Diagnostics Data Import
        Braking_Valve_Status_FL (DcmDspData): DcmDspDataSize=8, DcmDspDataType=UINT8, DcmDspDataInfoRef=DataInfo_Braking_Valve_Status_FL  # Diagnostics Data Import
        DataInfo_Braking_Valve_Status_FR (DcmDspDataInfo): DcmDspDataFixedLength=true  # Diagnostics Data Import
        Braking_Valve_Status_FR (DcmDspData): DcmDspDataSize=8, DcmDspDataType=UINT8, DcmDspDataInfoRef=DataInfo_Braking_Valve_Status_FR  # Diagnostics Data Import
        DataInfo_Braking_Status_Hydraulic_Pump (DcmDspDataInfo): DcmDspDataFixedLength=true  # Diagnostics Data Import
        Braking_Status_Hydraulic_Pump (DcmDspData): DcmDspDataSize=8, DcmDspDataType=UINT8, DcmDspDataInfoRef=DataInfo_Braking_Status_Hydraulic_Pump  # Diagnostics Data Import
        DataInfo_Braking_Brake_Pressure (DcmDspDataInfo): DcmDspDataFixedLength=true  # Diagnostics Data Import
        Braking_Brake_Pressure (DcmDspData): DcmDspDataSize=8, DcmDspDataType=UINT8, DcmDspDataInfoRef=DataInfo_Braking_Brake_Pressure  # Diagnostics Data Import
        DataInfo_Braking_Brake_Pedal (DcmDspDataInfo): DcmDspDataFixedLength=true  # Diagnostics Data Import
        Braking_Brake_Pedal (DcmDspData): DcmDspDataSize=8, DcmDspDataType=UINT8, DcmDspDataInfoRef=DataInfo_Braking_Brake_Pedal  # Diagnostics Data Import
      DcmDsd  # Diagnostics Data Import
        DcmDsdServiceTable  # Diagnostics Data Import
          12 x DcmDsdService:
            ControlDtcSetting: DcmDsdSidTabServiceId=133, DcmDsdSidTabSubfuncAvail=true, DcmDsdSidTabSessionLevelRef=DcmDspSession/Programming, DcmDsdSidTabSessionLevelRef=DcmDspSession/Extended  # Diagnostics Data Import
              Disable (DcmDsdSubService): DcmDsdSubServiceId=2, DcmDsdSubServiceSessionLevelRef=DcmDspSession/Programming, DcmDsdSubServiceSessionLevelRef=DcmDspSession/Extended  # Diagnostics Data Import
              Enable (DcmDsdSubService): DcmDsdSubServiceId=1, DcmDsdSubServiceSessionLevelRef=DcmDspSession/Programming, DcmDsdSubServiceSessionLevelRef=DcmDspSession/Extended  # Diagnostics Data Import
            TesterPresent: DcmDsdSidTabServiceId=62, DcmDsdSidTabSubfuncAvail=true  # Diagnostics Data Import
              TesterPresent (DcmDsdSubService): DcmDsdSubServiceId=0  # Diagnostics Data Import
            RoutineControl: DcmDsdSidTabServiceId=49, DcmDsdSidTabSubfuncAvail=true  # Diagnostics Data Import
            IoControlById: DcmDsdSidTabServiceId=47, DcmDsdSidTabSubfuncAvail=false, DcmDsdSidTabSessionLevelRef=DcmDspSession/Programming, DcmDsdSidTabSessionLevelRef=DcmDspSession/Extended  # Diagnostics Data Import
            WriteDataById: DcmDsdSidTabServiceId=46, DcmDsdSidTabSubfuncAvail=false  # Diagnostics Data Import
            CommunicationControl: DcmDsdSidTabServiceId=40, DcmDsdSidTabSubfuncAvail=true, DcmDsdSidTabSessionLevelRef=DcmDspSession/Programming, DcmDsdSidTabSessionLevelRef=DcmDspSession/Extended  # Diagnostics Data Import
              EnableRxAndDisableTx (DcmDsdSubService): DcmDsdSubServiceId=1, DcmDsdSubServiceSessionLevelRef=DcmDspSession/Programming, DcmDsdSubServiceSessionLevelRef=DcmDspSession/Extended  # Diagnostics Data Import
              EnableRxAndTx (DcmDsdSubService): DcmDsdSubServiceId=0, DcmDsdSubServiceSessionLevelRef=DcmDspSession/Programming, DcmDsdSubServiceSessionLevelRef=DcmDspSession/Extended  # Diagnostics Data Import
            SecurityAccess: DcmDsdSidTabServiceId=39, DcmDsdSidTabSubfuncAvail=true, DcmDsdSidTabSessionLevelRef=DcmDspSession/Programming, DcmDsdSidTabSessionLevelRef=DcmDspSession/Extended  # Diagnostics Data Import
              KeyLevel1_Send (DcmDsdSubService): DcmDsdSubServiceId=2, DcmDsdSubServiceSessionLevelRef=DcmDspSession/Programming, DcmDsdSubServiceSessionLevelRef=DcmDspSession/Extended  # Diagnostics Data Import
              SeedLevel1_Request (DcmDsdSubService): DcmDsdSubServiceId=1, DcmDsdSubServiceSessionLevelRef=DcmDspSession/Programming, DcmDsdSubServiceSessionLevelRef=DcmDspSession/Extended  # Diagnostics Data Import
            ReadDataById: DcmDsdSidTabServiceId=34, DcmDsdSidTabSubfuncAvail=false  # Diagnostics Data Import
            ReadDtcInfo: DcmDsdSidTabServiceId=25, DcmDsdSidTabSubfuncAvail=true  # Diagnostics Data Import
              5 x DcmDsdSubService:
                RSUPDTC: DcmDsdSubServiceId=10  # Diagnostics Data Import
                RDTCEDRBDN: DcmDsdSubServiceId=6  # Diagnostics Data Import
                RDTCSSBDTC: DcmDsdSubServiceId=4  # Diagnostics Data Import
                RNODTCBSM: DcmDsdSubServiceId=1  # Diagnostics Data Import
                RDTCBSM: DcmDsdSubServiceId=2  # Diagnostics Data Import
            ClearDiagInfo: DcmDsdSidTabServiceId=20, DcmDsdSidTabSubfuncAvail=false  # Diagnostics Data Import
            EcuReset: DcmDsdSidTabServiceId=17, DcmDsdSidTabSubfuncAvail=true  # Diagnostics Data Import
              Soft (DcmDsdSubService): DcmDsdSubServiceId=3  # Diagnostics Data Import
              Hard (DcmDsdSubService): DcmDsdSubServiceId=1  # Diagnostics Data Import
            DiagSessionControl: DcmDsdSidTabServiceId=16, DcmDsdSidTabSubfuncAvail=true  # Diagnostics Data Import
              3 x DcmDsdSubService:
                Extended: DcmDsdSubServiceId=3  # Diagnostics Data Import
                Programming: DcmDsdSubServiceId=2, DcmDsdSubServiceSessionLevelRef=DcmDspSession/Programming, DcmDsdSubServiceSessionLevelRef=DcmDspSession/Extended  # Diagnostics Data Import
                Default: DcmDsdSubServiceId=1  # Diagnostics Data Import
      DcmGeneral  # Diagnostics Data Import
  module config Dem
    DemGeneral:  # Diagnostics Data Import
      DemAgingCycleCounterProcessing = DEM_PROCESS_AGINGCTR_INTERN
      DemDtcStatusAvailabilityMask = 9
      DemMaxNumberEventEntryMirror = 0
      DemPTOSupport = false
      DemTypeOfFreezeFrameRecordNumeration = DEM_FF_RECNUM_CALCULATED
      21 x DemDataClass, all with DemDataElementDataSize=1, DemDataElementDataType=UINT8, DemDataElementUsePort=USE_DATA_CLIENT_SERVER_PORT, DemDataElementStoreNonVolatile=true:
        DID_0x10a_Wheel_Voltage_RR  # Diagnostics Data Import
        DID_0x10a_Wheel_Voltage_RL  # Diagnostics Data Import
        DID_0x10a_Wheel_Voltage_FR  # Diagnostics Data Import
        DID_0x10a_Wheel_Voltage_FL  # Diagnostics Data Import
        DID_0x10a_Wheel_Speed_RR  # Diagnostics Data Import
        DID_0x10a_Wheel_Speed_RL  # Diagnostics Data Import
        DID_0x10a_Wheel_Speed_FR  # Diagnostics Data Import
        DID_0x10a_Wheel_Speed_FL  # Diagnostics Data Import
        DID_0x107_Voltage_ECU  # Diagnostics Data Import
        DID_0x10d_Valve_Voltage_RR  # Diagnostics Data Import
        DID_0x10d_Valve_Voltage_RL  # Diagnostics Data Import
        DID_0x10d_Valve_Voltage_FR  # Diagnostics Data Import
        DID_0x10d_Valve_Voltage_FL  # Diagnostics Data Import
        DID_0x10d_Valve_Status_RR  # Diagnostics Data Import
        DID_0x10d_Valve_Status_RL  # Diagnostics Data Import
        DID_0x10d_Valve_Status_FR  # Diagnostics Data Import
        DID_0x10d_Valve_Status_FL  # Diagnostics Data Import
        OccurrenceCounter_Driving_Cycles_Since_Test_Failed  # Diagnostics Data Import
        DTCAgingCounter_Driving_Cycles_Since_Last_Failed  # Diagnostics Data Import
        UncompletedTestCounters_Driving_Cycles_Since_Last_Completed  # Diagnostics Data Import
        DID_0x10a_Direction_of_rotation  # Diagnostics Data Import
      PowerCycle (DemOperationCycle): DemOperationCycleType=DEM_OPCYC_POWER  # Diagnostics Data Import
      FreezeFrameClass_d4213761 (DemFreezeFrameClass): DemDidClassRef=DemGeneral/Wheel_Speed, DemDidClassRef=DemGeneral/Brake_Pedal, DemDidClassRef=DemGeneral/Supply_Voltage_ECU  # Diagnostics Data Import
      FreezeFrameClass_226af9a2 (DemFreezeFrameClass): DemDidClassRef=DemGeneral/Wheel_Speed, DemDidClassRef=DemGeneral/Brake_Pedal  # Diagnostics Data Import
      3 x DemExtendedDataRecordClass:
        UncompletedTestCounters: DemExtendedDataRecordNumber=12, DemDataClassRef=UncompletedTestCounters_Driving_Cycles_Since_Last_Completed  # Diagnostics Data Import
        DTCAgingCounter: DemExtendedDataRecordNumber=11, DemDataClassRef=DTCAgingCounter_Driving_Cycles_Since_Last_Failed  # Diagnostics Data Import
        OccurrenceCounter: DemExtendedDataRecordNumber=10, DemDataClassRef=OccurrenceCounter_Driving_Cycles_Since_Test_Failed  # Diagnostics Data Import
      ExtendedDataClass_bc718b7c (DemExtendedDataClass):  # Diagnostics Data Import
        DemExtendedDataRecordClassRef = OccurrenceCounter
        DemExtendedDataRecordClassRef = DTCAgingCounter
        DemExtendedDataRecordClassRef = UncompletedTestCounters
      3 x DemDidClass:
        Brake_Pedal: DemDidIdentifier=269, DemDidDataClassRef=DID_0x10d_Valve_Voltage_FR, DemDidDataClassRef=DID_0x10d_Valve_Voltage_FL, DemDidDataClassRef=DID_0x10d_Valve_Voltage_RR, DemDidDataClassRef=DID_0x10d_Valve_Voltage_RL, DemDidDataClassRef=DID_0x10d_Valve_Status_FR, DemDidDataClassRef=DID_0x10d_Valve_Status_FL, DemDidDataClassRef=DID_0x10d_Valve_Status_RR, DemDidDataClassRef=DID_0x10d_Valve_Status_RL  # Diagnostics Data Import
        Wheel_Speed: DemDidIdentifier=266, DemDidDataClassRef=DID_0x10a_Wheel_Speed_FR, DemDidDataClassRef=DID_0x10a_Wheel_Speed_FL, DemDidDataClassRef=DID_0x10a_Wheel_Speed_RR, DemDidDataClassRef=DID_0x10a_Wheel_Speed_RL, DemDidDataClassRef=DID_0x10a_Wheel_Voltage_FR, DemDidDataClassRef=DID_0x10a_Wheel_Voltage_FL, DemDidDataClassRef=DID_0x10a_Wheel_Voltage_RR, DemDidDataClassRef=DID_0x10a_Wheel_Voltage_RL, DemDidDataClassRef=DID_0x10a_Direction_of_rotation  # Diagnostics Data Import
        Supply_Voltage_ECU: DemDidIdentifier=263, DemDidDataClassRef=DID_0x107_Voltage_ECU  # Diagnostics Data Import
    DemConfigSet  # Diagnostics Data Import
      DTC_0x406325 (DemEventParameter):  # Diagnostics Data Import
        DemEventKind = DEM_EVENT_KIND_SWC
        DemMaxNumberFreezeFrameRecords = 2
        DemDTCClassRef = DTCClass_DTC_0x406325
        DemExtendedDataClassRef = ExtendedDataClass_bc718b7c
        DemFreezeFrameClassRef = FreezeFrameClass_226af9a2
        DemEventClass:  # Diagnostics Data Import
          DemEventDestination = DEM_DTC_ORIGIN_PRIMARY_MEMORY
          DemEventSignificance = DEM_EVENT_SIGNIFICANCE_FAULT
          DemAgingCycleRef = PowerCycle
          DemOperationCycleRef = PowerCycle
          DemDebounceAlgorithmClass  # Diagnostics Data Import
            DemDebounceMonitorInternal  # Diagnostics Data Import
              DemCallbackGetFDC  # Diagnostics Data Import
      DTCClass_DTC_0x406325 (DemDTCClass): DemUdsDTC=4219685  # Diagnostics Data Import
      DTC_0x406322 (DemEventParameter):  # Diagnostics Data Import
        DemEventKind = DEM_EVENT_KIND_SWC
        DemMaxNumberFreezeFrameRecords = 2
        DemDTCClassRef = DTCClass_DTC_0x406322
        DemExtendedDataClassRef = ExtendedDataClass_bc718b7c
        DemFreezeFrameClassRef = FreezeFrameClass_226af9a2
        DemEventClass:  # Diagnostics Data Import
          DemEventDestination = DEM_DTC_ORIGIN_PRIMARY_MEMORY
          DemEventSignificance = DEM_EVENT_SIGNIFICANCE_FAULT
          DemAgingCycleRef = PowerCycle
          DemOperationCycleRef = PowerCycle
          DemDebounceAlgorithmClass  # Diagnostics Data Import
            DemDebounceMonitorInternal  # Diagnostics Data Import
              DemCallbackGetFDC  # Diagnostics Data Import
      DTCClass_DTC_0x406322 (DemDTCClass): DemUdsDTC=4219682  # Diagnostics Data Import
      DTC_0x406321 (DemEventParameter):  # Diagnostics Data Import
        DemEventKind = DEM_EVENT_KIND_SWC
        DemMaxNumberFreezeFrameRecords = 2
        DemDTCClassRef = DTCClass_DTC_0x406321
        DemExtendedDataClassRef = ExtendedDataClass_bc718b7c
        DemFreezeFrameClassRef = FreezeFrameClass_226af9a2
        DemEventClass:  # Diagnostics Data Import
          DemEventDestination = DEM_DTC_ORIGIN_PRIMARY_MEMORY
          DemEventSignificance = DEM_EVENT_SIGNIFICANCE_FAULT
          DemAgingCycleRef = PowerCycle
          DemOperationCycleRef = PowerCycle
          DemDebounceAlgorithmClass  # Diagnostics Data Import
            DemDebounceMonitorInternal  # Diagnostics Data Import
              DemCallbackGetFDC  # Diagnostics Data Import
      DTCClass_DTC_0x406321 (DemDTCClass): DemUdsDTC=4219681  # Diagnostics Data Import
      DTC_0x406225 (DemEventParameter):  # Diagnostics Data Import
        DemEventKind = DEM_EVENT_KIND_SWC
        DemMaxNumberFreezeFrameRecords = 2
        DemDTCClassRef = DTCClass_DTC_0x406225
        DemExtendedDataClassRef = ExtendedDataClass_bc718b7c
        DemFreezeFrameClassRef = FreezeFrameClass_226af9a2
        DemEventClass:  # Diagnostics Data Import
          DemEventDestination = DEM_DTC_ORIGIN_PRIMARY_MEMORY
          DemEventSignificance = DEM_EVENT_SIGNIFICANCE_FAULT
          DemAgingCycleRef = PowerCycle
          DemOperationCycleRef = PowerCycle
          DemDebounceAlgorithmClass  # Diagnostics Data Import
            DemDebounceMonitorInternal  # Diagnostics Data Import
              DemCallbackGetFDC  # Diagnostics Data Import
      DTCClass_DTC_0x406225 (DemDTCClass): DemUdsDTC=4219429  # Diagnostics Data Import
      DTC_0x406222 (DemEventParameter):  # Diagnostics Data Import
        DemEventKind = DEM_EVENT_KIND_SWC
        DemMaxNumberFreezeFrameRecords = 2
        DemDTCClassRef = DTCClass_DTC_0x406222
        DemExtendedDataClassRef = ExtendedDataClass_bc718b7c
        DemFreezeFrameClassRef = FreezeFrameClass_226af9a2
        DemEventClass:  # Diagnostics Data Import
          DemEventDestination = DEM_DTC_ORIGIN_PRIMARY_MEMORY
          DemEventSignificance = DEM_EVENT_SIGNIFICANCE_FAULT
          DemAgingCycleRef = PowerCycle
          DemOperationCycleRef = PowerCycle
          DemDebounceAlgorithmClass  # Diagnostics Data Import
            DemDebounceMonitorInternal  # Diagnostics Data Import
              DemCallbackGetFDC  # Diagnostics Data Import
      DTCClass_DTC_0x406222 (DemDTCClass): DemUdsDTC=4219426  # Diagnostics Data Import
      DTC_0x406221 (DemEventParameter):  # Diagnostics Data Import
        DemEventKind = DEM_EVENT_KIND_SWC
        DemMaxNumberFreezeFrameRecords = 2
        DemDTCClassRef = DTCClass_DTC_0x406221
        DemExtendedDataClassRef = ExtendedDataClass_bc718b7c
        DemFreezeFrameClassRef = FreezeFrameClass_226af9a2
        DemEventClass:  # Diagnostics Data Import
          DemEventDestination = DEM_DTC_ORIGIN_PRIMARY_MEMORY
          DemEventSignificance = DEM_EVENT_SIGNIFICANCE_FAULT
          DemAgingCycleRef = PowerCycle
          DemOperationCycleRef = PowerCycle
          DemDebounceAlgorithmClass  # Diagnostics Data Import
            DemDebounceMonitorInternal  # Diagnostics Data Import
              DemCallbackGetFDC  # Diagnostics Data Import
      DTCClass_DTC_0x406221 (DemDTCClass): DemUdsDTC=4219425  # Diagnostics Data Import
      DTC_0x404428 (DemEventParameter):  # Diagnostics Data Import
        DemEventKind = DEM_EVENT_KIND_SWC
        DemMaxNumberFreezeFrameRecords = 2
        DemDTCClassRef = DTCClass_DTC_0x404428
        DemExtendedDataClassRef = ExtendedDataClass_bc718b7c
        DemFreezeFrameClassRef = FreezeFrameClass_226af9a2
        DemEventClass:  # Diagnostics Data Import
          DemEventDestination = DEM_DTC_ORIGIN_PRIMARY_MEMORY
          DemEventSignificance = DEM_EVENT_SIGNIFICANCE_FAULT
          DemAgingCycleRef = PowerCycle
          DemOperationCycleRef = PowerCycle
          DemDebounceAlgorithmClass  # Diagnostics Data Import
            DemDebounceMonitorInternal  # Diagnostics Data Import
              DemCallbackGetFDC  # Diagnostics Data Import
      DTCClass_DTC_0x404428 (DemDTCClass): DemUdsDTC=4211752  # Diagnostics Data Import
      DTC_0x404422 (DemEventParameter):  # Diagnostics Data Import
        DemEventKind = DEM_EVENT_KIND_SWC
        DemMaxNumberFreezeFrameRecords = 2
        DemDTCClassRef = DTCClass_DTC_0x404422
        DemExtendedDataClassRef = ExtendedDataClass_bc718b7c
        DemFreezeFrameClassRef = FreezeFrameClass_226af9a2
        DemEventClass:  # Diagnostics Data Import
          DemEventDestination = DEM_DTC_ORIGIN_PRIMARY_MEMORY
          DemEventSignificance = DEM_EVENT_SIGNIFICANCE_FAULT
          DemAgingCycleRef = PowerCycle
          DemOperationCycleRef = PowerCycle
          DemDebounceAlgorithmClass  # Diagnostics Data Import
            DemDebounceMonitorInternal  # Diagnostics Data Import
              DemCallbackGetFDC  # Diagnostics Data Import
      DTCClass_DTC_0x404422 (DemDTCClass): DemUdsDTC=4211746  # Diagnostics Data Import
      DTC_0x404421 (DemEventParameter):  # Diagnostics Data Import
        DemEventKind = DEM_EVENT_KIND_SWC
        DemMaxNumberFreezeFrameRecords = 2
        DemDTCClassRef = DTCClass_DTC_0x404421
        DemExtendedDataClassRef = ExtendedDataClass_bc718b7c
        DemFreezeFrameClassRef = FreezeFrameClass_226af9a2
        DemEventClass:  # Diagnostics Data Import
          DemEventDestination = DEM_DTC_ORIGIN_PRIMARY_MEMORY
          DemEventSignificance = DEM_EVENT_SIGNIFICANCE_FAULT
          DemAgingCycleRef = PowerCycle
          DemOperationCycleRef = PowerCycle
          DemDebounceAlgorithmClass  # Diagnostics Data Import
            DemDebounceMonitorInternal  # Diagnostics Data Import
              DemCallbackGetFDC  # Diagnostics Data Import
      DTCClass_DTC_0x404421 (DemDTCClass): DemUdsDTC=4211745  # Diagnostics Data Import
      DTC_0x404213 (DemEventParameter):  # Diagnostics Data Import
        DemEventKind = DEM_EVENT_KIND_SWC
        DemMaxNumberFreezeFrameRecords = 2
        DemDTCClassRef = DTCClass_DTC_0x404213
        DemExtendedDataClassRef = ExtendedDataClass_bc718b7c
        DemFreezeFrameClassRef = FreezeFrameClass_226af9a2
        DemEventClass:  # Diagnostics Data Import
          DemEventDestination = DEM_DTC_ORIGIN_PRIMARY_MEMORY
          DemEventSignificance = DEM_EVENT_SIGNIFICANCE_FAULT
          DemAgingCycleRef = PowerCycle
          DemOperationCycleRef = PowerCycle
          DemDebounceAlgorithmClass  # Diagnostics Data Import
            DemDebounceMonitorInternal  # Diagnostics Data Import
              DemCallbackGetFDC  # Diagnostics Data Import
      DTCClass_DTC_0x404213 (DemDTCClass): DemUdsDTC=4211219  # Diagnostics Data Import
      DTC_0x404212 (DemEventParameter):  # Diagnostics Data Import
        DemEventKind = DEM_EVENT_KIND_SWC
        DemMaxNumberFreezeFrameRecords = 2
        DemDTCClassRef = DTCClass_DTC_0x404212
        DemExtendedDataClassRef = ExtendedDataClass_bc718b7c
        DemFreezeFrameClassRef = FreezeFrameClass_226af9a2
        DemEventClass:  # Diagnostics Data Import
          DemEventDestination = DEM_DTC_ORIGIN_PRIMARY_MEMORY
          DemEventSignificance = DEM_EVENT_SIGNIFICANCE_FAULT
          DemAgingCycleRef = PowerCycle
          DemOperationCycleRef = PowerCycle
          DemDebounceAlgorithmClass  # Diagnostics Data Import
            DemDebounceMonitorInternal  # Diagnostics Data Import
              DemCallbackGetFDC  # Diagnostics Data Import
      DTCClass_DTC_0x404212 (DemDTCClass): DemUdsDTC=4211218  # Diagnostics Data Import
      DTC_0x404211 (DemEventParameter):  # Diagnostics Data Import
        DemEventKind = DEM_EVENT_KIND_SWC
        DemMaxNumberFreezeFrameRecords = 2
        DemDTCClassRef = DTCClass_DTC_0x404211
        DemExtendedDataClassRef = ExtendedDataClass_bc718b7c
        DemFreezeFrameClassRef = FreezeFrameClass_226af9a2
        DemEventClass:  # Diagnostics Data Import
          DemEventDestination = DEM_DTC_ORIGIN_PRIMARY_MEMORY
          DemEventSignificance = DEM_EVENT_SIGNIFICANCE_FAULT
          DemAgingCycleRef = PowerCycle
          DemOperationCycleRef = PowerCycle
          DemDebounceAlgorithmClass  # Diagnostics Data Import
            DemDebounceMonitorInternal  # Diagnostics Data Import
              DemCallbackGetFDC  # Diagnostics Data Import
      DTCClass_DTC_0x404211 (DemDTCClass): DemUdsDTC=4211217  # Diagnostics Data Import
      DTC_0x404013 (DemEventParameter):  # Diagnostics Data Import
        DemEventKind = DEM_EVENT_KIND_SWC
        DemMaxNumberFreezeFrameRecords = 2
        DemDTCClassRef = DTCClass_DTC_0x404013
        DemExtendedDataClassRef = ExtendedDataClass_bc718b7c
        DemFreezeFrameClassRef = FreezeFrameClass_226af9a2
        DemEventClass:  # Diagnostics Data Import
          DemEventDestination = DEM_DTC_ORIGIN_PRIMARY_MEMORY
          DemEventSignificance = DEM_EVENT_SIGNIFICANCE_FAULT
          DemAgingCycleRef = PowerCycle
          DemOperationCycleRef = PowerCycle
          DemDebounceAlgorithmClass  # Diagnostics Data Import
            DemDebounceMonitorInternal  # Diagnostics Data Import
              DemCallbackGetFDC  # Diagnostics Data Import
      DTCClass_DTC_0x404013 (DemDTCClass): DemUdsDTC=4210707  # Diagnostics Data Import
      DTC_0x404012 (DemEventParameter):  # Diagnostics Data Import
        DemEventKind = DEM_EVENT_KIND_SWC
        DemMaxNumberFreezeFrameRecords = 2
        DemDTCClassRef = DTCClass_DTC_0x404012
        DemExtendedDataClassRef = ExtendedDataClass_bc718b7c
        DemFreezeFrameClassRef = FreezeFrameClass_226af9a2
        DemEventClass:  # Diagnostics Data Import
          DemEventDestination = DEM_DTC_ORIGIN_PRIMARY_MEMORY
          DemEventSignificance = DEM_EVENT_SIGNIFICANCE_FAULT
          DemAgingCycleRef = PowerCycle
          DemOperationCycleRef = PowerCycle
          DemDebounceAlgorithmClass  # Diagnostics Data Import
            DemDebounceMonitorInternal  # Diagnostics Data Import
              DemCallbackGetFDC  # Diagnostics Data Import
      DTCClass_DTC_0x404012 (DemDTCClass): DemUdsDTC=4210706  # Diagnostics Data Import
      DTC_0x404011 (DemEventParameter):  # Diagnostics Data Import
        DemEventKind = DEM_EVENT_KIND_SWC
        DemMaxNumberFreezeFrameRecords = 2
        DemDTCClassRef = DTCClass_DTC_0x404011
        DemExtendedDataClassRef = ExtendedDataClass_bc718b7c
        DemFreezeFrameClassRef = FreezeFrameClass_226af9a2
        DemEventClass:  # Diagnostics Data Import
          DemEventDestination = DEM_DTC_ORIGIN_PRIMARY_MEMORY
          DemEventSignificance = DEM_EVENT_SIGNIFICANCE_FAULT
          DemAgingCycleRef = PowerCycle
          DemOperationCycleRef = PowerCycle
          DemDebounceAlgorithmClass  # Diagnostics Data Import
            DemDebounceMonitorInternal  # Diagnostics Data Import
              DemCallbackGetFDC  # Diagnostics Data Import
      DTCClass_DTC_0x404011 (DemDTCClass): DemUdsDTC=4210705  # Diagnostics Data Import
      DTC_0x403a22 (DemEventParameter):  # Diagnostics Data Import
        DemEventKind = DEM_EVENT_KIND_SWC
        DemMaxNumberFreezeFrameRecords = 2
        DemDTCClassRef = DTCClass_DTC_0x403a22
        DemExtendedDataClassRef = ExtendedDataClass_bc718b7c
        DemFreezeFrameClassRef = FreezeFrameClass_226af9a2
        DemEventClass:  # Diagnostics Data Import
          DemEventDestination = DEM_DTC_ORIGIN_PRIMARY_MEMORY
          DemEventSignificance = DEM_EVENT_SIGNIFICANCE_FAULT
          DemAgingCycleRef = PowerCycle
          DemOperationCycleRef = PowerCycle
          DemDebounceAlgorithmClass  # Diagnostics Data Import
            DemDebounceMonitorInternal  # Diagnostics Data Import
              DemCallbackGetFDC  # Diagnostics Data Import
      DTCClass_DTC_0x403a22 (DemDTCClass): DemUdsDTC=4209186  # Diagnostics Data Import
      DTC_0x403a21 (DemEventParameter):  # Diagnostics Data Import
        DemEventKind = DEM_EVENT_KIND_SWC
        DemMaxNumberFreezeFrameRecords = 2
        DemDTCClassRef = DTCClass_DTC_0x403a21
        DemExtendedDataClassRef = ExtendedDataClass_bc718b7c
        DemFreezeFrameClassRef = FreezeFrameClass_226af9a2
        DemEventClass:  # Diagnostics Data Import
          DemEventDestination = DEM_DTC_ORIGIN_PRIMARY_MEMORY
          DemEventSignificance = DEM_EVENT_SIGNIFICANCE_FAULT
          DemAgingCycleRef = PowerCycle
          DemOperationCycleRef = PowerCycle
          DemDebounceAlgorithmClass  # Diagnostics Data Import
            DemDebounceMonitorInternal  # Diagnostics Data Import
              DemCallbackGetFDC  # Diagnostics Data Import
      DTCClass_DTC_0x403a21 (DemDTCClass): DemUdsDTC=4209185  # Diagnostics Data Import
      DTC_0x403a13 (DemEventParameter):  # Diagnostics Data Import
        DemEventKind = DEM_EVENT_KIND_SWC
        DemMaxNumberFreezeFrameRecords = 2
        DemDTCClassRef = DTCClass_DTC_0x403a13
        DemExtendedDataClassRef = ExtendedDataClass_bc718b7c
        DemFreezeFrameClassRef = FreezeFrameClass_226af9a2
        DemEventClass:  # Diagnostics Data Import
          DemEventDestination = DEM_DTC_ORIGIN_PRIMARY_MEMORY
          DemEventSignificance = DEM_EVENT_SIGNIFICANCE_FAULT
          DemAgingCycleRef = PowerCycle
          DemOperationCycleRef = PowerCycle
          DemDebounceAlgorithmClass  # Diagnostics Data Import
            DemDebounceMonitorInternal  # Diagnostics Data Import
              DemCallbackGetFDC  # Diagnostics Data Import
      DTCClass_DTC_0x403a13 (DemDTCClass): DemUdsDTC=4209171  # Diagnostics Data Import
      DTC_0x403722 (DemEventParameter):  # Diagnostics Data Import
        DemEventKind = DEM_EVENT_KIND_SWC
        DemMaxNumberFreezeFrameRecords = 2
        DemDTCClassRef = DTCClass_DTC_0x403722
        DemExtendedDataClassRef = ExtendedDataClass_bc718b7c
        DemFreezeFrameClassRef = FreezeFrameClass_226af9a2
        DemEventClass:  # Diagnostics Data Import
          DemEventDestination = DEM_DTC_ORIGIN_PRIMARY_MEMORY
          DemEventSignificance = DEM_EVENT_SIGNIFICANCE_FAULT
          DemAgingCycleRef = PowerCycle
          DemOperationCycleRef = PowerCycle
          DemDebounceAlgorithmClass  # Diagnostics Data Import
            DemDebounceMonitorInternal  # Diagnostics Data Import
              DemCallbackGetFDC  # Diagnostics Data Import
      DTCClass_DTC_0x403722 (DemDTCClass): DemUdsDTC=4208418  # Diagnostics Data Import
      DTC_0x403721 (DemEventParameter):  # Diagnostics Data Import
        DemEventKind = DEM_EVENT_KIND_SWC
        DemMaxNumberFreezeFrameRecords = 2
        DemDTCClassRef = DTCClass_DTC_0x403721
        DemExtendedDataClassRef = ExtendedDataClass_bc718b7c
        DemFreezeFrameClassRef = FreezeFrameClass_226af9a2
        DemEventClass:  # Diagnostics Data Import
          DemEventDestination = DEM_DTC_ORIGIN_PRIMARY_MEMORY
          DemEventSignificance = DEM_EVENT_SIGNIFICANCE_FAULT
          DemAgingCycleRef = PowerCycle
          DemOperationCycleRef = PowerCycle
          DemDebounceAlgorithmClass  # Diagnostics Data Import
            DemDebounceMonitorInternal  # Diagnostics Data Import
              DemCallbackGetFDC  # Diagnostics Data Import
      DTCClass_DTC_0x403721 (DemDTCClass): DemUdsDTC=4208417  # Diagnostics Data Import
      DTC_0x403713 (DemEventParameter):  # Diagnostics Data Import
        DemEventKind = DEM_EVENT_KIND_SWC
        DemMaxNumberFreezeFrameRecords = 2
        DemDTCClassRef = DTCClass_DTC_0x403713
        DemExtendedDataClassRef = ExtendedDataClass_bc718b7c
        DemFreezeFrameClassRef = FreezeFrameClass_226af9a2
        DemEventClass:  # Diagnostics Data Import
          DemEventDestination = DEM_DTC_ORIGIN_PRIMARY_MEMORY
          DemEventSignificance = DEM_EVENT_SIGNIFICANCE_FAULT
          DemAgingCycleRef = PowerCycle
          DemOperationCycleRef = PowerCycle
          DemDebounceAlgorithmClass  # Diagnostics Data Import
            DemDebounceMonitorInternal  # Diagnostics Data Import
              DemCallbackGetFDC  # Diagnostics Data Import
      DTCClass_DTC_0x403713 (DemDTCClass): DemUdsDTC=4208403  # Diagnostics Data Import
      DTC_0x403422 (DemEventParameter):  # Diagnostics Data Import
        DemEventKind = DEM_EVENT_KIND_SWC
        DemMaxNumberFreezeFrameRecords = 2
        DemDTCClassRef = DTCClass_DTC_0x403422
        DemExtendedDataClassRef = ExtendedDataClass_bc718b7c
        DemFreezeFrameClassRef = FreezeFrameClass_226af9a2
        DemEventClass:  # Diagnostics Data Import
          DemEventDestination = DEM_DTC_ORIGIN_PRIMARY_MEMORY
          DemEventSignificance = DEM_EVENT_SIGNIFICANCE_FAULT
          DemAgingCycleRef = PowerCycle
          DemOperationCycleRef = PowerCycle
          DemDebounceAlgorithmClass  # Diagnostics Data Import
            DemDebounceMonitorInternal  # Diagnostics Data Import
              DemCallbackGetFDC  # Diagnostics Data Import
      DTCClass_DTC_0x403422 (DemDTCClass): DemUdsDTC=4207650  # Diagnostics Data Import
      DTC_0x403421 (DemEventParameter):  # Diagnostics Data Import
        DemEventKind = DEM_EVENT_KIND_SWC
        DemMaxNumberFreezeFrameRecords = 2
        DemDTCClassRef = DTCClass_DTC_0x403421
        DemExtendedDataClassRef = ExtendedDataClass_bc718b7c
        DemFreezeFrameClassRef = FreezeFrameClass_226af9a2
        DemEventClass:  # Diagnostics Data Import
          DemEventDestination = DEM_DTC_ORIGIN_PRIMARY_MEMORY
          DemEventSignificance = DEM_EVENT_SIGNIFICANCE_FAULT
          DemAgingCycleRef = PowerCycle
          DemOperationCycleRef = PowerCycle
          DemDebounceAlgorithmClass  # Diagnostics Data Import
            DemDebounceMonitorInternal  # Diagnostics Data Import
              DemCallbackGetFDC  # Diagnostics Data Import
      DTCClass_DTC_0x403421 (DemDTCClass): DemUdsDTC=4207649  # Diagnostics Data Import
      DTC_0x403413 (DemEventParameter):  # Diagnostics Data Import
        DemEventKind = DEM_EVENT_KIND_SWC
        DemMaxNumberFreezeFrameRecords = 2
        DemDTCClassRef = DTCClass_DTC_0x403413
        DemExtendedDataClassRef = ExtendedDataClass_bc718b7c
        DemFreezeFrameClassRef = FreezeFrameClass_226af9a2
        DemEventClass:  # Diagnostics Data Import
          DemEventDestination = DEM_DTC_ORIGIN_PRIMARY_MEMORY
          DemEventSignificance = DEM_EVENT_SIGNIFICANCE_FAULT
          DemAgingCycleRef = PowerCycle
          DemOperationCycleRef = PowerCycle
          DemDebounceAlgorithmClass  # Diagnostics Data Import
            DemDebounceMonitorInternal  # Diagnostics Data Import
              DemCallbackGetFDC  # Diagnostics Data Import
      DTCClass_DTC_0x403413 (DemDTCClass): DemUdsDTC=4207635  # Diagnostics Data Import
      DTC_0x403122 (DemEventParameter):  # Diagnostics Data Import
        DemEventKind = DEM_EVENT_KIND_SWC
        DemMaxNumberFreezeFrameRecords = 2
        DemDTCClassRef = DTCClass_DTC_0x403122
        DemExtendedDataClassRef = ExtendedDataClass_bc718b7c
        DemFreezeFrameClassRef = FreezeFrameClass_226af9a2
        DemEventClass:  # Diagnostics Data Import
          DemEventDestination = DEM_DTC_ORIGIN_PRIMARY_MEMORY
          DemEventSignificance = DEM_EVENT_SIGNIFICANCE_FAULT
          DemAgingCycleRef = PowerCycle
          DemOperationCycleRef = PowerCycle
          DemDebounceAlgorithmClass  # Diagnostics Data Import
            DemDebounceMonitorInternal  # Diagnostics Data Import
              DemCallbackGetFDC  # Diagnostics Data Import
      DTCClass_DTC_0x403122 (DemDTCClass): DemUdsDTC=4206882  # Diagnostics Data Import
      DTC_0x403121 (DemEventParameter):  # Diagnostics Data Import
        DemEventKind = DEM_EVENT_KIND_SWC
        DemMaxNumberFreezeFrameRecords = 2
        DemDTCClassRef = DTCClass_DTC_0x403121
        DemExtendedDataClassRef = ExtendedDataClass_bc718b7c
        DemFreezeFrameClassRef = FreezeFrameClass_226af9a2
        DemEventClass:  # Diagnostics Data Import
          DemEventDestination = DEM_DTC_ORIGIN_PRIMARY_MEMORY
          DemEventSignificance = DEM_EVENT_SIGNIFICANCE_FAULT
          DemAgingCycleRef = PowerCycle
          DemOperationCycleRef = PowerCycle
          DemDebounceAlgorithmClass  # Diagnostics Data Import
            DemDebounceMonitorInternal  # Diagnostics Data Import
              DemCallbackGetFDC  # Diagnostics Data Import
      DTCClass_DTC_0x403121 (DemDTCClass): DemUdsDTC=4206881  # Diagnostics Data Import
      DTC_0x403113 (DemEventParameter):  # Diagnostics Data Import
        DemEventKind = DEM_EVENT_KIND_SWC
        DemMaxNumberFreezeFrameRecords = 2
        DemDTCClassRef = DTCClass_DTC_0x403113
        DemExtendedDataClassRef = ExtendedDataClass_bc718b7c
        DemFreezeFrameClassRef = FreezeFrameClass_226af9a2
        DemEventClass:  # Diagnostics Data Import
          DemEventDestination = DEM_DTC_ORIGIN_PRIMARY_MEMORY
          DemEventSignificance = DEM_EVENT_SIGNIFICANCE_FAULT
          DemAgingCycleRef = PowerCycle
          DemOperationCycleRef = PowerCycle
          DemDebounceAlgorithmClass  # Diagnostics Data Import
            DemDebounceMonitorInternal  # Diagnostics Data Import
              DemCallbackGetFDC  # Diagnostics Data Import
      DTCClass_DTC_0x403113 (DemDTCClass): DemUdsDTC=4206867  # Diagnostics Data Import
      DTC_0x403001 (DemEventParameter):  # Diagnostics Data Import
        DemEventKind = DEM_EVENT_KIND_SWC
        DemMaxNumberFreezeFrameRecords = 2
        DemDTCClassRef = DTCClass_DTC_0x403001
        DemExtendedDataClassRef = ExtendedDataClass_bc718b7c
        DemFreezeFrameClassRef = FreezeFrameClass_226af9a2
        DemEventClass:  # Diagnostics Data Import
          DemEventDestination = DEM_DTC_ORIGIN_PRIMARY_MEMORY
          DemEventSignificance = DEM_EVENT_SIGNIFICANCE_FAULT
          DemAgingCycleRef = PowerCycle
          DemOperationCycleRef = PowerCycle
          DemDebounceAlgorithmClass  # Diagnostics Data Import
            DemDebounceMonitorInternal  # Diagnostics Data Import
              DemCallbackGetFDC  # Diagnostics Data Import
      DTCClass_DTC_0x403001 (DemDTCClass): DemUdsDTC=4206593  # Diagnostics Data Import
      DTC_0x402025 (DemEventParameter):  # Diagnostics Data Import
        DemEventKind = DEM_EVENT_KIND_SWC
        DemMaxNumberFreezeFrameRecords = 2
        DemDTCClassRef = DTCClass_DTC_0x402025
        DemExtendedDataClassRef = ExtendedDataClass_bc718b7c
        DemFreezeFrameClassRef = FreezeFrameClass_226af9a2
        DemEventClass:  # Diagnostics Data Import
          DemEventDestination = DEM_DTC_ORIGIN_PRIMARY_MEMORY
          DemEventSignificance = DEM_EVENT_SIGNIFICANCE_FAULT
          DemAgingCycleRef = PowerCycle
          DemOperationCycleRef = PowerCycle
          DemDebounceAlgorithmClass  # Diagnostics Data Import
            DemDebounceMonitorInternal  # Diagnostics Data Import
              DemCallbackGetFDC  # Diagnostics Data Import
      DTCClass_DTC_0x402025 (DemDTCClass): DemUdsDTC=4202533  # Diagnostics Data Import
      DTC_0x402013 (DemEventParameter):  # Diagnostics Data Import
        DemEventKind = DEM_EVENT_KIND_SWC
        DemMaxNumberFreezeFrameRecords = 2
        DemDTCClassRef = DTCClass_DTC_0x402013
        DemExtendedDataClassRef = ExtendedDataClass_bc718b7c
        DemFreezeFrameClassRef = FreezeFrameClass_226af9a2
        DemEventClass:  # Diagnostics Data Import
          DemEventDestination = DEM_DTC_ORIGIN_PRIMARY_MEMORY
          DemEventSignificance = DEM_EVENT_SIGNIFICANCE_FAULT
          DemAgingCycleRef = PowerCycle
          DemOperationCycleRef = PowerCycle
          DemDebounceAlgorithmClass  # Diagnostics Data Import
            DemDebounceMonitorInternal  # Diagnostics Data Import
              DemCallbackGetFDC  # Diagnostics Data Import
      DTCClass_DTC_0x402013 (DemDTCClass): DemUdsDTC=4202515  # Diagnostics Data Import
      DTC_0x402012 (DemEventParameter):  # Diagnostics Data Import
        DemEventKind = DEM_EVENT_KIND_SWC
        DemMaxNumberFreezeFrameRecords = 2
        DemDTCClassRef = DTCClass_DTC_0x402012
        DemExtendedDataClassRef = ExtendedDataClass_bc718b7c
        DemFreezeFrameClassRef = FreezeFrameClass_d4213761
        DemEventClass:  # Diagnostics Data Import
          DemEventDestination = DEM_DTC_ORIGIN_PRIMARY_MEMORY
          DemEventSignificance = DEM_EVENT_SIGNIFICANCE_FAULT
          DemAgingCycleRef = PowerCycle
          DemOperationCycleRef = PowerCycle
          DemDebounceAlgorithmClass  # Diagnostics Data Import
            DemDebounceMonitorInternal  # Diagnostics Data Import
              DemCallbackGetFDC  # Diagnostics Data Import
      DTCClass_DTC_0x402012 (DemDTCClass): DemUdsDTC=4202514  # Diagnostics Data Import
      DTC_0x402011 (DemEventParameter):  # Diagnostics Data Import
        DemEventKind = DEM_EVENT_KIND_SWC
        DemMaxNumberFreezeFrameRecords = 2
        DemDTCClassRef = DTCClass_DTC_0x402011
        DemExtendedDataClassRef = ExtendedDataClass_bc718b7c
        DemFreezeFrameClassRef = FreezeFrameClass_d4213761
        DemEventClass:  # Diagnostics Data Import
          DemEventDestination = DEM_DTC_ORIGIN_PRIMARY_MEMORY
          DemEventSignificance = DEM_EVENT_SIGNIFICANCE_FAULT
          DemAgingCycleRef = PowerCycle
          DemOperationCycleRef = PowerCycle
          DemDebounceAlgorithmClass  # Diagnostics Data Import
            DemDebounceMonitorInternal  # Diagnostics Data Import
              DemCallbackGetFDC  # Diagnostics Data Import
      DTCClass_DTC_0x402011 (DemDTCClass): DemUdsDTC=4202513  # Diagnostics Data Import
      DTC_0x402001 (DemEventParameter):  # Diagnostics Data Import
        DemEventKind = DEM_EVENT_KIND_SWC
        DemMaxNumberFreezeFrameRecords = 2
        DemDTCClassRef = DTCClass_DTC_0x402001
        DemExtendedDataClassRef = ExtendedDataClass_bc718b7c
        DemFreezeFrameClassRef = FreezeFrameClass_226af9a2
        DemEventClass:  # Diagnostics Data Import
          DemEventDestination = DEM_DTC_ORIGIN_PRIMARY_MEMORY
          DemEventSignificance = DEM_EVENT_SIGNIFICANCE_FAULT
          DemAgingCycleRef = PowerCycle
          DemOperationCycleRef = PowerCycle
          DemDebounceAlgorithmClass  # Diagnostics Data Import
            DemDebounceMonitorInternal  # Diagnostics Data Import
              DemCallbackGetFDC  # Diagnostics Data Import
      DTCClass_DTC_0x402001 (DemDTCClass): DemUdsDTC=4202497  # Diagnostics Data Import
      DTC_0x401003 (DemEventParameter):  # Diagnostics Data Import
        DemEventKind = DEM_EVENT_KIND_SWC
        DemMaxNumberFreezeFrameRecords = 2
        DemDTCClassRef = DTCClass_DTC_0x401003
        DemExtendedDataClassRef = ExtendedDataClass_bc718b7c
        DemFreezeFrameClassRef = FreezeFrameClass_226af9a2
        DemEventClass:  # Diagnostics Data Import
          DemEventDestination = DEM_DTC_ORIGIN_PRIMARY_MEMORY
          DemEventSignificance = DEM_EVENT_SIGNIFICANCE_FAULT
          DemAgingCycleRef = PowerCycle
          DemOperationCycleRef = PowerCycle
          DemDebounceAlgorithmClass  # Diagnostics Data Import
            DemDebounceMonitorInternal  # Diagnostics Data Import
              DemCallbackGetFDC  # Diagnostics Data Import
      DTCClass_DTC_0x401003 (DemDTCClass): DemUdsDTC=4198403  # Diagnostics Data Import
      DTC_0x401001 (DemEventParameter):  # Diagnostics Data Import
        DemEventKind = DEM_EVENT_KIND_SWC
        DemMaxNumberFreezeFrameRecords = 2
        DemDTCClassRef = DTCClass_DTC_0x401001
        DemExtendedDataClassRef = ExtendedDataClass_bc718b7c
        DemFreezeFrameClassRef = FreezeFrameClass_226af9a2
        DemEventClass:  # Diagnostics Data Import
          DemEventDestination = DEM_DTC_ORIGIN_PRIMARY_MEMORY
          DemEventSignificance = DEM_EVENT_SIGNIFICANCE_FAULT
          DemAgingCycleRef = PowerCycle
          DemOperationCycleRef = PowerCycle
          DemDebounceAlgorithmClass  # Diagnostics Data Import
            DemDebounceMonitorInternal  # Diagnostics Data Import
              DemCallbackGetFDC  # Diagnostics Data Import
      DTCClass_DTC_0x401001 (DemDTCClass): DemUdsDTC=4198401  # Diagnostics Data Import
  module config EcuC
    EcucPduCollection: PduIdTypeEnum=UINT8, PduLengthTypeEnum=UINT8
      33 x Pdu:
        INTER_RECEIVE_oDBCNetWork_INTER1_12d35b51_Rx: PduLength=8, SysTPduToFrameMappingRef=INTER_RECEIVE
        INTER_SEND_oDBCNetWork_INTER1_c9dc7871_Tx: PduLength=8, SysTPduToFrameMappingRef=INTER_SEND
        Meg_FunDiag_Tp_oDBCNetWork_1b821788_Rx: PduLength=8, SysTPduToFrameMappingRef=Meg_FunDiag_Tp
        Meg_FunDiag_oDBCNetWork_245e23dc_Rx: PduLength=7
        Meg_FunDiag_oDBCNetWork_8501a87a_Rx: PduLength=7
        Meg_NmTx_oDBCNetWork_5d9e34f5_Tx: PduLength=8, SysTPduToFrameMappingRef=Meg_NmTx
        Meg_PhyDiag_Tp_oDBCNetWork_ff3be21a_Rx: PduLength=8, SysTPduToFrameMappingRef=Meg_PhyDiag_Tp
        Meg_PhyDiag_oDBCNetWork_e154eea6_Rx: PduLength=8
        Meg_PhyDiag_oDBCNetWork_e94a8f4d_Rx: PduLength=8
        Meg_ResDiag_Tp_oDBCNetWork_4a610c1c_Tx: PduLength=8, SysTPduToFrameMappingRef=Meg_ResDiag_Tp
        Meg_ResDiag_oDBCNetWork_1336e721_Tx: PduLength=8
        Meg_ResDiag_oDBCNetWork_5467f8e5_Tx: PduLength=8
        SupD_Button_Control_oDBCNetWork_09fc4743_Rx: PduLength=8
        SupD_Button_Control_oDBCNetWork_2fe6ff3f_Rx: PduLength=8, SysTPduToFrameMappingRef=SupD_Button_Control
        SupD_Led_Control_oDBCNetWork_36fcc7ec_Rx: PduLength=8, SysTPduToFrameMappingRef=SupD_Led_Control
        SupD_Led_Control_oDBCNetWork_80cdf82b_Rx: PduLength=8
        SupD_Led_CtrlMode_oDBCNetWork_8feda945_Rx: PduLength=8, SysTPduToFrameMappingRef=SupD_Led_CtrlMode
        SupD_Led_CtrlMode_oDBCNetWork_a6b9686f_Rx: PduLength=8
        SupE_Function_1_oDBCNetWork_582198e2_Rx: PduLength=8
        SupE_Function_1_oDBCNetWork_b8177f3a_Rx: PduLength=8, SysTPduToFrameMappingRef=SupE_Function_1
        SupF_Angle_oDBCNetWork_73452188_Tx: PduLength=8, SysTPduToFrameMappingRef=SupF_Angle
        SupF_Angle_oDBCNetWork_afae1504_Tx: PduLength=8
        SupF_Button_State_oDBCNetWork_4aab92e3_Tx: PduLength=8, SysTPduToFrameMappingRef=SupF_Button_State
        SupF_Button_State_oDBCNetWork_e1c0e29d_Tx: PduLength=8
        SupF_ComError_oDBCNetWork_d2a44cd7_Tx: PduLength=8, SysTPduToFrameMappingRef=SupF_ComError
        SupF_ComError_oDBCNetWork_f4af97d3_Tx: PduLength=8
        SupF_Function_1_oDBCNetWork_003f31ca_Tx: PduLength=8
        SupF_Function_1_oDBCNetWork_c66f379c_Tx: PduLength=8, SysTPduToFrameMappingRef=SupF_Function_1
        SupF_Led_State_oDBCNetWork_35eef7d2_Tx: PduLength=8
        SupF_Led_State_oDBCNetWork_e9fc4e73_Tx: PduLength=8, SysTPduToFrameMappingRef=SupF_Led_State
        SupF_PowerMode_oDBCNetWork_9f0609f7_Tx: PduLength=8, SysTPduToFrameMappingRef=SupF_PowerMode
        SupF_PowerMode_oDBCNetWork_c1c74254_Tx: PduLength=8
        XB_SUP_F_7e0db49d_Rx: PduLength=8, SysTPduToFrameMappingRef=Meg_NmRx
  module config EcuM
    EcuMConfiguration
      EcuMCommonConfiguration
        EcuMDriverInitListOne
        EcuMDriverRestartList
        CN_DBCNetWork_05d62413 (EcuMWakeupSource): EcuMWakeupSourceId=5, EcuMComMChannelRef=ComMConfigSet/CN_DBCNetWork_05d62413
        CN_DBCNetWork_INTER1_9768a826 (EcuMWakeupSource): EcuMWakeupSourceId=6, EcuMComMChannelRef=ComMConfigSet/CN_DBCNetWork_INTER1_9768a826
      EcuMFlexConfiguration: EcuMFlexModuleConfigurationRef=CanConfigSet
  module config Nm
    CN_DBCNetWork_05d62413 (NmChannelConfig): NmPassiveModeEnabled=true, NmComMChannelRef=ComMConfigSet/CN_DBCNetWork_05d62413
      DBCNetWork_CAN_9b3bc41d (NmBusType)
        NmStandardBusNmConfig: NmStandardBusType=NM_BUSNM_CANNM  # DBCNetWork_CAN
    CN_DBCNetWork_INTER1_9768a826 (NmChannelConfig): NmPassiveModeEnabled=true, NmComMChannelRef=ComMConfigSet/CN_DBCNetWork_INTER1_9768a826
      DBCNetWork_INTER1_CAN_daccbfb1 (NmBusType)
        NmStandardBusNmConfig: NmStandardBusType=NM_BUSNM_CANNM  # DBCNetWork_INTER1_CAN
    NmGlobalConfig
      NmGlobalFeatures: NmBusSynchronizationEnabled=false, NmNodeIdEnabled=true, NmUserDataEnabled=true
      NmGlobalProperties
  module config PduR
    PduRGeneral
    PduRRoutingTables
      PduRRoutingTable
        13 x PduRRoutingPath:
          Meg_FunDiag_oDBCNetWork_245e23dc_Rx
            Meg_FunDiag_oDBCNetWork_245e23dc_Rx_1af6dabd_Rx (PduRDestPdu): PduRDestPduRef=Meg_FunDiag_oDBCNetWork_8501a87a_Rx
            PduRSrcPdu_1af6dabd (PduRSrcPdu): PduRSrcPduRef=EcucPduCollection/Meg_FunDiag_oDBCNetWork_245e23dc_Rx
          Meg_PhyDiag_oDBCNetWork_e94a8f4d_Rx
            Meg_PhyDiag_oDBCNetWork_e94a8f4d_Rx_49b2840e_Rx (PduRDestPdu): PduRDestPduRef=Meg_PhyDiag_oDBCNetWork_e154eea6_Rx
            PduRSrcPdu_49b2840e (PduRSrcPdu): PduRSrcPduRef=EcucPduCollection/Meg_PhyDiag_oDBCNetWork_e94a8f4d_Rx
          Meg_ResDiag_oDBCNetWork_5467f8e5_Tx
            Meg_ResDiag_oDBCNetWork_1336e721_Tx (PduRDestPdu): PduRDestPduRef=EcucPduCollection/Meg_ResDiag_oDBCNetWork_1336e721_Tx
            PduRSrcPdu_9c32056b (PduRSrcPdu): PduRSrcPduRef=EcucPduCollection/Meg_ResDiag_oDBCNetWork_5467f8e5_Tx
          SupD_Button_Control_oDBCNetWork_2fe6ff3f_Rx
            SupD_Button_Control_oDBCNetWork_2fe6ff3f_Rx_c1d3fa7d_Rx (PduRDestPdu): PduRDestPduRef=EcucPduCollection/SupD_Button_Control_oDBCNetWork_09fc4743_Rx
            PduRSrcPdu_c1d3fa7d (PduRSrcPdu): PduRSrcPduRef=EcucPduCollection/SupD_Button_Control_oDBCNetWork_2fe6ff3f_Rx
          SupD_Led_Control_oDBCNetWork_36fcc7ec_Rx
            SupD_Led_Control_oDBCNetWork_36fcc7ec_Rx_9f4997ea_Rx (PduRDestPdu): PduRDestPduRef=EcucPduCollection/SupD_Led_Control_oDBCNetWork_80cdf82b_Rx
            PduRSrcPdu_9f4997ea (PduRSrcPdu): PduRSrcPduRef=EcucPduCollection/SupD_Led_Control_oDBCNetWork_36fcc7ec_Rx
          SupD_Led_CtrlMode_oDBCNetWork_8feda945_Rx
            SupD_Led_CtrlMode_oDBCNetWork_8feda945_Rx_dde6d85a_Rx (PduRDestPdu): PduRDestPduRef=EcucPduCollection/SupD_Led_CtrlMode_oDBCNetWork_a6b9686f_Rx
            PduRSrcPdu_dde6d85a (PduRSrcPdu): PduRSrcPduRef=EcucPduCollection/SupD_Led_CtrlMode_oDBCNetWork_8feda945_Rx
          SupE_Function_1_oDBCNetWork_b8177f3a_Rx
            SupE_Function_1_oDBCNetWork_b8177f3a_Rx_ed7c8ba9_Rx (PduRDestPdu): PduRDestPduRef=EcucPduCollection/SupE_Function_1_oDBCNetWork_582198e2_Rx
            PduRSrcPdu_ed7c8ba9 (PduRSrcPdu): PduRSrcPduRef=EcucPduCollection/SupE_Function_1_oDBCNetWork_b8177f3a_Rx
          SupF_Angle_oDBCNetWork_afae1504_Tx
            SupF_Angle_oDBCNetWork_73452188_Tx (PduRDestPdu): PduRDestPduRef=EcucPduCollection/SupF_Angle_oDBCNetWork_73452188_Tx
            PduRSrcPdu_735ccce2 (PduRSrcPdu): PduRSrcPduRef=EcucPduCollection/SupF_Angle_oDBCNetWork_afae1504_Tx
          SupF_Button_State_oDBCNetWork_e1c0e29d_Tx
            SupF_Button_State_oDBCNetWork_4aab92e3_Tx (PduRDestPdu): PduRDestPduRef=EcucPduCollection/SupF_Button_State_oDBCNetWork_4aab92e3_Tx
            PduRSrcPdu_59d653d2 (PduRSrcPdu): PduRSrcPduRef=EcucPduCollection/SupF_Button_State_oDBCNetWork_e1c0e29d_Tx
          SupF_ComError_oDBCNetWork_f4af97d3_Tx
            SupF_ComError_oDBCNetWork_d2a44cd7_Tx (PduRDestPdu): PduRDestPduRef=EcucPduCollection/SupF_ComError_oDBCNetWork_d2a44cd7_Tx
            PduRSrcPdu_eb554e6b (PduRSrcPdu): PduRSrcPduRef=EcucPduCollection/SupF_ComError_oDBCNetWork_f4af97d3_Tx
          SupF_Function_1_oDBCNetWork_003f31ca_Tx
            SupF_Function_1_oDBCNetWork_c66f379c_Tx (PduRDestPdu): PduRDestPduRef=EcucPduCollection/SupF_Function_1_oDBCNetWork_c66f379c_Tx
            PduRSrcPdu_866e7b89 (PduRSrcPdu): PduRSrcPduRef=EcucPduCollection/SupF_Function_1_oDBCNetWork_003f31ca_Tx
          SupF_Led_State_oDBCNetWork_35eef7d2_Tx
            SupF_Led_State_oDBCNetWork_e9fc4e73_Tx (PduRDestPdu): PduRDestPduRef=EcucPduCollection/SupF_Led_State_oDBCNetWork_e9fc4e73_Tx
            PduRSrcPdu_74524a59 (PduRSrcPdu): PduRSrcPduRef=EcucPduCollection/SupF_Led_State_oDBCNetWork_35eef7d2_Tx
          SupF_PowerMode_oDBCNetWork_c1c74254_Tx
            SupF_PowerMode_oDBCNetWork_9f0609f7_Tx (PduRDestPdu): PduRDestPduRef=EcucPduCollection/SupF_PowerMode_oDBCNetWork_9f0609f7_Tx
            PduRSrcPdu_7cf5c8f1 (PduRSrcPdu): PduRSrcPduRef=EcucPduCollection/SupF_PowerMode_oDBCNetWork_c1c74254_Tx
